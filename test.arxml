AUTOSAR XML (schema 4-3-0)
package /ARRoot
  ecuc value collection MyEcu
