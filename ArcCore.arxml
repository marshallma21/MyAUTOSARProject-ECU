AUTOSAR XML (schema 4-3-0)
standard types defined: boolean, uint8, uint16, uint32, sint8, sint16, sint32, float32, float64, void, sint64, uint64
package /ArcCore/Platform/BaseTypes
  base type utf8: category=FIXED_LENGTH, base-type-size=8, base-type-encoding=UTF-8, native-declaration=uint8
  base type ucs2: category=FIXED_LENGTH, base-type-size=16, base-type-encoding=UCS-2, native-declaration=uint16
package /ArcCore/Platform/ImplementationDataTypes
  8 x impl type, all with category=DATA_REFERENCE:
    ConstVoidPtr: sw-pointer-target-props={target-category=VALUE, base-type=void, sw-impl-policy=CONST}
    VoidPtr: sw-pointer-target-props={target-category=VALUE, base-type=void}
    uint16Ptr: sw-pointer-target-props={target-category=TYPE_REFERENCE, implementation-data-type=uint16}
    constUint32Ptr: sw-pointer-target-props={target-category=TYPE_REFERENCE, implementation-data-type=uint32, sw-impl-policy=CONST}
    constUint8Ptr: sw-pointer-target-props={target-category=TYPE_REFERENCE, implementation-data-type=uint8, sw-impl-policy=CONST}
    uint32Ptr: sw-pointer-target-props={target-category=TYPE_REFERENCE, implementation-data-type=uint32}
    uint8Ptr: sw-pointer-target-props={target-category=TYPE_REFERENCE, implementation-data-type=uint8}
    constUint16Ptr: sw-pointer-target-props={target-category=TYPE_REFERENCE, implementation-data-type=uint16, sw-impl-policy=CONST}
package /ArcCore/Services/IoHwAb
  impl type IoHwAb_SignalType_: implementation-data-type=uint32
  app type dummy_IoHwAb_SignalType_: category=VALUE
  data type mapping set dummyMappingSet: data-type-map{application-data-type=dummy_IoHwAb_SignalType_, implementation-data-type=IoHwAb_SignalType_}
  impl type SignalQuality: compu {0=IOHWAB_INIVAL, 1=IOHWAB_ERR, 2=IOHWAB_BAD, 3=IOHWAB_GOOD}, implementation-data-type=uint8
  impl type DigitalLevel: compu {0=IOHWAB_LOW, 1=IOHWAB_HIGH}, implementation-data-type=uint8
  impl type AnalogValue: implementation-data-type=sint32
  impl type DutyCycle: implementation-data-type=uint32
  impl type Frequency: implementation-data-type=uint32
  6 x client server interface, all with is-service=true:
    DigitalServiceRead
      operation Read: possible-error=[DigitalServiceRead/E_OK, DigitalServiceRead/E_NOT_OK]
        arg Level: type=DigitalLevel, direction=OUT
        arg Quality: type=SignalQuality, direction=OUT
      error E_OK: error-code=0
      error E_NOT_OK: error-code=1
    DigitalServiceWrite
      operation Write: possible-error=[DigitalServiceWrite/E_OK, DigitalServiceWrite/E_NOT_OK]
        arg Level: type=DigitalLevel, direction=IN
      error E_OK: error-code=0
      error E_NOT_OK: error-code=1
    DigitalServiceWriteReadback
      operation WriteReadback: possible-error=[DigitalServiceWriteReadback/E_OK, DigitalServiceWriteReadback/E_NOT_OK]
        arg Level: type=DigitalLevel, direction=IN
        arg Quality: type=SignalQuality, direction=OUT
      error E_OK: error-code=0
      error E_NOT_OK: error-code=1
    AnalogServiceRead
      operation Read: possible-error=[AnalogServiceRead/E_OK, AnalogServiceRead/E_NOT_OK]
        arg Value: type=AnalogValue, direction=OUT
        arg Quality: type=SignalQuality, direction=OUT
      error E_OK: error-code=0
      error E_NOT_OK: error-code=1
    PwmServiceSetDuty
      operation Set: possible-error=[PwmServiceSetDuty/E_OK, PwmServiceSetDuty/E_NOT_OK]
        arg DutyValue: type=DutyCycle, direction=IN
        arg Quality: type=SignalQuality, direction=OUT
      error E_OK: error-code=0
      error E_NOT_OK: error-code=1
    PwmServiceSetDutyFreq
      operation Set: possible-error=[PwmServiceSetDutyFreq/E_OK, PwmServiceSetDutyFreq/E_NOT_OK]
        arg DutyValue: type=DutyCycle, direction=IN
        arg FrequencyValue: type=Frequency, direction=IN
        arg Quality: type=SignalQuality, direction=OUT
      error E_OK: error-code=0
      error E_NOT_OK: error-code=1
