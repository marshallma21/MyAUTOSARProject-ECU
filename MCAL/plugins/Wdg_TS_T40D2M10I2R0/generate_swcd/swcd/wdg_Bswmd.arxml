AUTOSAR XML (schema 4-0-3)
package /AUTOSAR_Wdg/BswModuleDescriptions
  bsw module description Wdg: module-id=102
    provided-entrys:
      Wdg_GetVersionInfo
      Wdg_Init
      Wdg_SetMode
      Wdg_SetTriggerCondition
      Wdg_Cbk_GptNotification
      Wdg_Wdog{0..3}_Isr
    bsw internal behavior InternalBehavior_0
      6 x exclusive area:
        WDG_EXCLUSIVE_AREA_{00..05}
      5 x bsw called entity:
        Wdg_GetVersionInfo: implemented-entry=Wdg_GetVersionInfo
        Wdg_Init: can-enter-exclusive-area=[WDG_EXCLUSIVE_AREA_00, WDG_EXCLUSIVE_AREA_01, WDG_EXCLUSIVE_AREA_02, WDG_EXCLUSIVE_AREA_03, WDG_EXCLUSIVE_AREA_04, WDG_EXCLUSIVE_AREA_05], implemented-entry=Wdg_Init
        Wdg_SetMode: implemented-entry=Wdg_SetMode
        Wdg_SetTriggerCondition: implemented-entry=Wdg_SetTriggerCondition
        Wdg_Cbk_GptNotification: implemented-entry=Wdg_Cbk_GptNotification
      4 x bsw interrupt entity, all with interrupt-category=CAT-2, interrupt-source=Hardware:
        Wdg_Wdog{0..3}_Isr: implemented-entry=Wdg_Wdog{0..3}_Isr
package /AUTOSAR_Wdg/BswModuleEntrys
  4 x bsw module entry, all with service-id=0, is-reentrant=false, is-synchronous=true, call-type=INTERRUPT, execution-context=INTERRUPT-CAT-2, sw-service-impl-policy=STANDARD:
    Wdg_Wdog{0..3}_Isr
package /Wdg_T40D2M10I2R0/Implementations
  bsw implementation BswImplementation_0: programming-language=C, sw-version=4.2.2, vendor-id=43, ar-release-version=4.2.2, behavior=InternalBehavior_0, vendor-specific-module-def=Wdg
    code-descriptors:
      code Files
        artifact-descriptors:
          short-label=config::Wdg.xdm, category=SWCFG
          short-label=doc::AUTOSAR_MCAL_WDG_IM.pdf, category=SWDOC
          short-label=doc::AUTOSAR_MCAL_WDG_UM.pdf, category=SWDOC
          short-label=include::Reg_eSys_Wdog.h, category=SWHDR
          short-label=include::Reg_eSys_Wdog_defines.h, category=SWHDR
          short-label=include::Wdg.h, category=SWHDR
          short-label=include::Wdg_Channel.h, category=SWHDR
          short-label=include::Wdg_EnvCfg.h, category=SWHDR
          short-label=include::Wdg_IPW.h, category=SWHDR
          short-label=include::Wdg_IPW_Types.h, category=SWHDR
          short-label=include::Wdg_Irq.h, category=SWHDR
          short-label=include::Wdg_Wdog.h, category=SWHDR
          short-label=include::Wdg_Wdog_Types.h, category=SWHDR
          short-label=src::Wdg.c, category=SWSRC
          short-label=src::Wdg_Channel.c, category=SWSRC
          short-label=src::Wdg_Wdog.c, category=SWSRC
          short-label=src::Wdg_Wdog_Isr.c, category=SWSRC
    compiler GHS_Compiler:
      name=Green Hills
      options=-cpu=cortexm4 -cpu=cortexm0plus -ansi -Osize -dual_debug -G --no_exceptions -Wundef -Wimplicit-int -Wshadow -Wtrigraphs -Wall --prototype_errors --incorrect_pragma_warnings -noslashcomment -preprocess_assembly_files -nostartfile --short_enum -c --no_commons -keeptempfiles -list -DAUTOSAR_OS_NOT_USED -DDISABLE_MCAL_INTERMODULE_ASR_CHECK -DGHS
      vendor=Green Hills
      version=Green Hills Multi 7.1.4 / Compiler 2017.1.4
    compiler IAR_Compiler: name=IAR Compiler, options=--cpu=Cortex-M4 --cpu=Cortex-M0+ --cpu_mode=thumb --endian=little -Ohz -c --no_clustering --no_mem_idioms --no_explicit_zero_opt --debug --diag_suppress=Pa050 -DAUTOSAR_OS_NOT_USED -DIAR --require_prototypes --no_wrap_diagnostics --no_system_include -e, vendor=IAR Systems, version=IAR: V8.11.2
    generated-artifacts:
      5 x dependency on artifact, all with usages=COMPILE:
        Wdg_Cfg_h: artifact-descriptor={short-label=generate::include::Wdg_Cfg.h, category=SWHDR}
        Wdg_CfgExt_c: artifact-descriptor={short-label=generate::src::Wdg_CfgExt.c, category=SWSRC}
        Wdg_Lcfg_c: artifact-descriptor={short-label=generate_LT::src::Wdg_Lcfg.c, category=SWSRC}
        Wdg_PBcfg_c: artifact-descriptor={short-label=generate_PB::src::Wdg_PBcfg.c, category=SWSRC}
        Wdg_Cfg_c: artifact-descriptor={short-label=generate_PC::src::Wdg_Cfg.c, category=SWSRC}
    linker GHS_Linker: name=Green Hills, options=-Mn -delete -v -ignore_debug_references -map -keepmap -lstartup -lsys -larch -lansi -L(/lib/thumb2) -lutf8_s32, vendor=Green Hills, version=Green Hills Multi 7.1.4 / Compiler 2017.1.4
    linker IAR_Linker: name=IAR Compiler, options=--cpu=Cortex-M4 --cpu=Cortex-M0+ --map filename --no_library_search --entry _start --enable_stack_usage --skip_dynamic_initialization --no_wrap_diagnostics --config, vendor=IAR Systems, version=IAR: V8.11.2
    resource consumption ResourceConsumption
      9 x memory section:
        WDG_CODE: alignment=UNSPECIFIED, sw-addrmethod=CODE, symbol=CODE
        WDG_CONFIG_DATA_UNSPECIFIED: alignment=UNSPECIFIED, sw-addrmethod=CONFIG_DATA, symbol=CONFIG_DATA_UNSPECIFIED
        WDG_CONST_32: alignment=32, sw-addrmethod=CONST, symbol=CONST_32
        WDG_CONST_8: alignment=8, sw-addrmethod=CONST, symbol=CONST_8
        WDG_CONST_UNSPECIFIED: alignment=UNSPECIFIED, sw-addrmethod=CONST, symbol=CONST_UNSPECIFIED
        WDG_RAMCODE: alignment=UNSPECIFIED, sw-addrmethod=RAMCODE, symbol=RAMCODE
        WDG_VAR_INIT_16: alignment=16, sw-addrmethod=VAR_INIT, symbol=VAR_INIT_16
        WDG_VAR_INIT_UNSPECIFIED: alignment=UNSPECIFIED, sw-addrmethod=VAR_INIT, symbol=VAR_INIT_UNSPECIFIED
        WDG_VAR_NO_INIT_UNSPECIFIED: alignment=UNSPECIFIED, sw-addrmethod=VAR_NO_INIT, symbol=VAR_NO_INIT_UNSPECIFIED
