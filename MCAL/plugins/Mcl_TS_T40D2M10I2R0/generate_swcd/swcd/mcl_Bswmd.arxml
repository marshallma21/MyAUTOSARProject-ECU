AUTOSAR XML (schema 4-0-3)
package /AUTOSAR_Mcl/BswModuleDescriptions
  bsw module description Mcl: module-id=255
    provided-entrys:
      FTM_0_CH_0_CH_1_ISR
      FTM_0_CH_2_CH_3_ISR
      FTM_0_CH_4_CH_5_ISR
      FTM_0_CH_6_CH_7_ISR
      FTM_0_FAULT_ISR
      FTM_0_ISR
      FTM_0_OVF_ISR
      FTM_1_CH_0_CH_1_ISR
      FTM_1_CH_2_CH_3_ISR
      FTM_1_CH_4_CH_5_ISR
      FTM_1_CH_6_CH_7_ISR
      FTM_1_FAULT_ISR
      FTM_1_ISR
      FTM_1_OVF_ISR
      FTM_2_CH_0_CH_1_ISR
      FTM_2_CH_2_CH_3_ISR
      FTM_2_CH_4_CH_5_ISR
      FTM_2_CH_6_CH_7_ISR
      FTM_2_FAULT_ISR
      FTM_2_ISR
      FTM_2_OVF_ISR
      FTM_3_CH_0_CH_1_ISR
      FTM_3_CH_2_CH_3_ISR
      FTM_3_CH_4_CH_5_ISR
      FTM_3_CH_6_CH_7_ISR
      FTM_3_FAULT_ISR
      FTM_3_ISR
      FTM_3_OVF_ISR
      FTM_4_CH_0_CH_1_ISR
      FTM_4_CH_2_CH_3_ISR
      FTM_4_CH_4_CH_5_ISR
      FTM_4_CH_6_CH_7_ISR
      FTM_4_FAULT_ISR
      FTM_4_OVF_ISR
      FTM_5_CH_0_CH_1_ISR
      FTM_5_CH_2_CH_3_ISR
      FTM_5_CH_4_CH_5_ISR
      FTM_5_CH_6_CH_7_ISR
      FTM_5_FAULT_ISR
      FTM_5_OVF_ISR
      FTM_6_CH_0_CH_1_ISR
      FTM_6_CH_2_CH_3_ISR
      FTM_6_CH_4_CH_5_ISR
      FTM_6_CH_6_CH_7_ISR
      FTM_6_FAULT_ISR
      FTM_6_OVF_ISR
      FTM_7_CH_0_CH_1_ISR
      FTM_7_CH_2_CH_3_ISR
      FTM_7_CH_4_CH_5_ISR
      FTM_7_CH_6_CH_7_ISR
      FTM_7_FAULT_ISR
      FTM_7_OVF_ISR
      LPIT_0_CH_{0..3}_ISR
      LPTMR_0_CH_0_ISR
      MCL_DMA0_CH_COMPLETE_ISR
      MCL_DMA0_ERROR_ISR
      MCL_DMA1_CH_COMPLETE_ISR
      MCL_DMA1_ERROR_ISR
      MCL_DMA_CH_0_ISR
      MCL_DMA_CH_{100..109}_ISR
      MCL_DMA_CH_10_ISR
      MCL_DMA_CH_{110..119}_ISR
      MCL_DMA_CH_11_ISR
      MCL_DMA_CH_{120..127}_ISR
      MCL_DMA_CH_{12..19}_ISR
      MCL_DMA_CH_1_ISR
      MCL_DMA_CH_{20..29}_ISR
      MCL_DMA_CH_2_ISR
      MCL_DMA_CH_{30..39}_ISR
      MCL_DMA_CH_3_ISR
      MCL_DMA_CH_{40..49}_ISR
      MCL_DMA_CH_4_ISR
      MCL_DMA_CH_{50..59}_ISR
      MCL_DMA_CH_5_ISR
      MCL_DMA_CH_{60..69}_ISR
      MCL_DMA_CH_6_ISR
      MCL_DMA_CH_{70..79}_ISR
      MCL_DMA_CH_7_ISR
      MCL_DMA_CH_{80..89}_ISR
      MCL_DMA_CH_8_ISR
      MCL_DMA_CH_{90..99}_ISR
      MCL_DMA_CH_9_ISR
      MCL_DMA_CH_MIXED_96_127_COMPLETE_ISR
      MCL_DMA_ERROR_ISR
      MCL_DMA_GROUP0_COMPLETE_ISR
    bsw internal behavior InternalBehavior_0
      38 x exclusive area:
        MCL_EXCLUSIVE_AREA_{12..49}
      192 x bsw interrupt entity, all with interrupt-category=CAT-2, interrupt-source=Hardware:
        FTM_0_CH_0_CH_1_ISR: implemented-entry=FTM_0_CH_0_CH_1_ISR
        FTM_0_CH_2_CH_3_ISR: implemented-entry=FTM_0_CH_2_CH_3_ISR
        FTM_0_CH_4_CH_5_ISR: implemented-entry=FTM_0_CH_4_CH_5_ISR
        FTM_0_CH_6_CH_7_ISR: implemented-entry=FTM_0_CH_6_CH_7_ISR
        FTM_0_FAULT_ISR: implemented-entry=FTM_0_FAULT_ISR
        FTM_0_ISR: implemented-entry=FTM_0_ISR
        FTM_0_OVF_ISR: implemented-entry=FTM_0_OVF_ISR
        FTM_1_CH_0_CH_1_ISR: implemented-entry=FTM_1_CH_0_CH_1_ISR
        FTM_1_CH_2_CH_3_ISR: implemented-entry=FTM_1_CH_2_CH_3_ISR
        FTM_1_CH_4_CH_5_ISR: implemented-entry=FTM_1_CH_4_CH_5_ISR
        FTM_1_CH_6_CH_7_ISR: implemented-entry=FTM_1_CH_6_CH_7_ISR
        FTM_1_FAULT_ISR: implemented-entry=FTM_1_FAULT_ISR
        FTM_1_ISR: implemented-entry=FTM_1_ISR
        FTM_1_OVF_ISR: implemented-entry=FTM_1_OVF_ISR
        FTM_2_CH_0_CH_1_ISR: implemented-entry=FTM_2_CH_0_CH_1_ISR
        FTM_2_CH_2_CH_3_ISR: implemented-entry=FTM_2_CH_2_CH_3_ISR
        FTM_2_CH_4_CH_5_ISR: implemented-entry=FTM_2_CH_4_CH_5_ISR
        FTM_2_CH_6_CH_7_ISR: implemented-entry=FTM_2_CH_6_CH_7_ISR
        FTM_2_FAULT_ISR: implemented-entry=FTM_2_FAULT_ISR
        FTM_2_ISR: implemented-entry=FTM_2_ISR
        FTM_2_OVF_ISR: implemented-entry=FTM_2_OVF_ISR
        FTM_3_CH_0_CH_1_ISR: implemented-entry=FTM_3_CH_0_CH_1_ISR
        FTM_3_CH_2_CH_3_ISR: implemented-entry=FTM_3_CH_2_CH_3_ISR
        FTM_3_CH_4_CH_5_ISR: implemented-entry=FTM_3_CH_4_CH_5_ISR
        FTM_3_CH_6_CH_7_ISR: implemented-entry=FTM_3_CH_6_CH_7_ISR
        FTM_3_FAULT_ISR: implemented-entry=FTM_3_FAULT_ISR
        FTM_3_ISR: implemented-entry=FTM_3_ISR
        FTM_3_OVF_ISR: implemented-entry=FTM_3_OVF_ISR
        FTM_4_CH_0_CH_1_ISR: implemented-entry=FTM_4_CH_0_CH_1_ISR
        FTM_4_CH_2_CH_3_ISR: implemented-entry=FTM_4_CH_2_CH_3_ISR
        FTM_4_CH_4_CH_5_ISR: implemented-entry=FTM_4_CH_4_CH_5_ISR
        FTM_4_CH_6_CH_7_ISR: implemented-entry=FTM_4_CH_6_CH_7_ISR
        FTM_4_FAULT_ISR: implemented-entry=FTM_4_FAULT_ISR
        FTM_4_OVF_ISR: implemented-entry=FTM_4_OVF_ISR
        FTM_5_CH_0_CH_1_ISR: implemented-entry=FTM_5_CH_0_CH_1_ISR
        FTM_5_CH_2_CH_3_ISR: implemented-entry=FTM_5_CH_2_CH_3_ISR
        FTM_5_CH_4_CH_5_ISR: implemented-entry=FTM_5_CH_4_CH_5_ISR
        FTM_5_CH_6_CH_7_ISR: implemented-entry=FTM_5_CH_6_CH_7_ISR
        FTM_5_FAULT_ISR: implemented-entry=FTM_5_FAULT_ISR
        FTM_5_OVF_ISR: implemented-entry=FTM_5_OVF_ISR
        FTM_6_CH_0_CH_1_ISR: implemented-entry=FTM_6_CH_0_CH_1_ISR
        FTM_6_CH_2_CH_3_ISR: implemented-entry=FTM_6_CH_2_CH_3_ISR
        FTM_6_CH_4_CH_5_ISR: implemented-entry=FTM_6_CH_4_CH_5_ISR
        FTM_6_CH_6_CH_7_ISR: implemented-entry=FTM_6_CH_6_CH_7_ISR
        FTM_6_FAULT_ISR: implemented-entry=FTM_6_FAULT_ISR
        FTM_6_OVF_ISR: implemented-entry=FTM_6_OVF_ISR
        FTM_7_CH_0_CH_1_ISR: implemented-entry=FTM_7_CH_0_CH_1_ISR
        FTM_7_CH_2_CH_3_ISR: implemented-entry=FTM_7_CH_2_CH_3_ISR
        FTM_7_CH_4_CH_5_ISR: implemented-entry=FTM_7_CH_4_CH_5_ISR
        FTM_7_CH_6_CH_7_ISR: implemented-entry=FTM_7_CH_6_CH_7_ISR
        FTM_7_FAULT_ISR: implemented-entry=FTM_7_FAULT_ISR
        FTM_7_OVF_ISR: implemented-entry=FTM_7_OVF_ISR
        LPIT_0_CH_{0..3}_ISR: implemented-entry=LPIT_0_CH_{0..3}_ISR
        LPTMR_0_CH_0_ISR: implemented-entry=LPTMR_0_CH_0_ISR
        MCL_DMA0_CH_COMPLETE_ISR: implemented-entry=MCL_DMA0_CH_COMPLETE_ISR
        MCL_DMA0_ERROR_ISR: implemented-entry=MCL_DMA0_ERROR_ISR
        MCL_DMA1_CH_COMPLETE_ISR: implemented-entry=MCL_DMA1_CH_COMPLETE_ISR
        MCL_DMA1_ERROR_ISR: implemented-entry=MCL_DMA1_ERROR_ISR
        MCL_DMA_CH_0_ISR: implemented-entry=MCL_DMA_CH_0_ISR
        MCL_DMA_CH_{100..109}_ISR: implemented-entry=MCL_DMA_CH_{100..109}_ISR
        MCL_DMA_CH_10_ISR: implemented-entry=MCL_DMA_CH_10_ISR
        MCL_DMA_CH_{110..119}_ISR: implemented-entry=MCL_DMA_CH_{110..119}_ISR
        MCL_DMA_CH_11_ISR: implemented-entry=MCL_DMA_CH_11_ISR
        MCL_DMA_CH_{120..127}_ISR: implemented-entry=MCL_DMA_CH_{120..127}_ISR
        MCL_DMA_CH_{12..19}_ISR: implemented-entry=MCL_DMA_CH_{12..19}_ISR
        MCL_DMA_CH_1_ISR: implemented-entry=MCL_DMA_CH_1_ISR
        MCL_DMA_CH_{20..29}_ISR: implemented-entry=MCL_DMA_CH_{20..29}_ISR
        MCL_DMA_CH_2_ISR: implemented-entry=MCL_DMA_CH_2_ISR
        MCL_DMA_CH_{30..39}_ISR: implemented-entry=MCL_DMA_CH_{30..39}_ISR
        MCL_DMA_CH_3_ISR: implemented-entry=MCL_DMA_CH_3_ISR
        MCL_DMA_CH_{40..49}_ISR: implemented-entry=MCL_DMA_CH_{40..49}_ISR
        MCL_DMA_CH_4_ISR: implemented-entry=MCL_DMA_CH_4_ISR
        MCL_DMA_CH_{50..59}_ISR: implemented-entry=MCL_DMA_CH_{50..59}_ISR
        MCL_DMA_CH_5_ISR: implemented-entry=MCL_DMA_CH_5_ISR
        MCL_DMA_CH_{60..69}_ISR: implemented-entry=MCL_DMA_CH_{60..69}_ISR
        MCL_DMA_CH_6_ISR: implemented-entry=MCL_DMA_CH_6_ISR
        MCL_DMA_CH_{70..79}_ISR: implemented-entry=MCL_DMA_CH_{70..79}_ISR
        MCL_DMA_CH_7_ISR: implemented-entry=MCL_DMA_CH_7_ISR
        MCL_DMA_CH_{80..89}_ISR: implemented-entry=MCL_DMA_CH_{80..89}_ISR
        MCL_DMA_CH_8_ISR: implemented-entry=MCL_DMA_CH_8_ISR
        MCL_DMA_CH_{90..99}_ISR: implemented-entry=MCL_DMA_CH_{90..99}_ISR
        MCL_DMA_CH_9_ISR: implemented-entry=MCL_DMA_CH_9_ISR
        MCL_DMA_CH_MIXED_96_127_COMPLETE_ISR: implemented-entry=MCL_DMA_CH_MIXED_96_127_COMPLETE_ISR
        MCL_DMA_ERROR_ISR: implemented-entry=MCL_DMA_ERROR_ISR
        MCL_DMA_GROUP0_COMPLETE_ISR: implemented-entry=MCL_DMA_GROUP0_COMPLETE_ISR
package /AUTOSAR_Mcl/BswModuleEntrys
  192 x bsw module entry, all with service-id=0, is-reentrant=false, is-synchronous=true, call-type=INTERRUPT, execution-context=INTERRUPT-CAT-2, sw-service-impl-policy=STANDARD:
    FTM_0_CH_0_CH_1_ISR
    FTM_0_CH_2_CH_3_ISR
    FTM_0_CH_4_CH_5_ISR
    FTM_0_CH_6_CH_7_ISR
    FTM_0_FAULT_ISR
    FTM_0_ISR
    FTM_0_OVF_ISR
    FTM_1_CH_0_CH_1_ISR
    FTM_1_CH_2_CH_3_ISR
    FTM_1_CH_4_CH_5_ISR
    FTM_1_CH_6_CH_7_ISR
    FTM_1_FAULT_ISR
    FTM_1_ISR
    FTM_1_OVF_ISR
    FTM_2_CH_0_CH_1_ISR
    FTM_2_CH_2_CH_3_ISR
    FTM_2_CH_4_CH_5_ISR
    FTM_2_CH_6_CH_7_ISR
    FTM_2_FAULT_ISR
    FTM_2_ISR
    FTM_2_OVF_ISR
    FTM_3_CH_0_CH_1_ISR
    FTM_3_CH_2_CH_3_ISR
    FTM_3_CH_4_CH_5_ISR
    FTM_3_CH_6_CH_7_ISR
    FTM_3_FAULT_ISR
    FTM_3_ISR
    FTM_3_OVF_ISR
    FTM_4_CH_0_CH_1_ISR
    FTM_4_CH_2_CH_3_ISR
    FTM_4_CH_4_CH_5_ISR
    FTM_4_CH_6_CH_7_ISR
    FTM_4_FAULT_ISR
    FTM_4_OVF_ISR
    FTM_5_CH_0_CH_1_ISR
    FTM_5_CH_2_CH_3_ISR
    FTM_5_CH_4_CH_5_ISR
    FTM_5_CH_6_CH_7_ISR
    FTM_5_FAULT_ISR
    FTM_5_OVF_ISR
    FTM_6_CH_0_CH_1_ISR
    FTM_6_CH_2_CH_3_ISR
    FTM_6_CH_4_CH_5_ISR
    FTM_6_CH_6_CH_7_ISR
    FTM_6_FAULT_ISR
    FTM_6_OVF_ISR
    FTM_7_CH_0_CH_1_ISR
    FTM_7_CH_2_CH_3_ISR
    FTM_7_CH_4_CH_5_ISR
    FTM_7_CH_6_CH_7_ISR
    FTM_7_FAULT_ISR
    FTM_7_OVF_ISR
    LPIT_0_CH_{0..3}_ISR
    LPTMR_0_CH_0_ISR
    MCL_DMA0_CH_COMPLETE_ISR
    MCL_DMA0_ERROR_ISR
    MCL_DMA1_CH_COMPLETE_ISR
    MCL_DMA1_ERROR_ISR
    MCL_DMA_CH_0_ISR
    MCL_DMA_CH_{100..109}_ISR
    MCL_DMA_CH_10_ISR
    MCL_DMA_CH_{110..119}_ISR
    MCL_DMA_CH_11_ISR
    MCL_DMA_CH_{120..127}_ISR
    MCL_DMA_CH_{12..19}_ISR
    MCL_DMA_CH_1_ISR
    MCL_DMA_CH_{20..29}_ISR
    MCL_DMA_CH_2_ISR
    MCL_DMA_CH_{30..39}_ISR
    MCL_DMA_CH_3_ISR
    MCL_DMA_CH_{40..49}_ISR
    MCL_DMA_CH_4_ISR
    MCL_DMA_CH_{50..59}_ISR
    MCL_DMA_CH_5_ISR
    MCL_DMA_CH_{60..69}_ISR
    MCL_DMA_CH_6_ISR
    MCL_DMA_CH_{70..79}_ISR
    MCL_DMA_CH_7_ISR
    MCL_DMA_CH_{80..89}_ISR
    MCL_DMA_CH_8_ISR
    MCL_DMA_CH_{90..99}_ISR
    MCL_DMA_CH_9_ISR
    MCL_DMA_CH_MIXED_96_127_COMPLETE_ISR
    MCL_DMA_ERROR_ISR
    MCL_DMA_GROUP0_COMPLETE_ISR
package /Mcl_T40D2M10I2R0/Implementations
  bsw implementation BswImplementation_0: programming-language=C, sw-version=4.2.2, vendor-id=43, ar-release-version=4.2.2, behavior=InternalBehavior_0, vendor-specific-module-def=Mcl
    code-descriptors:
      code Files
        artifact-descriptors:
          short-label=config::Mcl.xdm, category=SWCFG
          short-label=doc::AUTOSAR_MCAL_MCL_IM.pdf, category=SWDOC
          short-label=doc::AUTOSAR_MCAL_MCL_UM.pdf, category=SWDOC
          short-label=include::CDD_Mcl.h, category=SWHDR
          short-label=include::Ftm_Common.h, category=SWHDR
          short-label=include::Ftm_Common_Types.h, category=SWHDR
          short-label=include::Mcl.h, category=SWHDR
          short-label=include::Mcl_Dma.h, category=SWHDR
          short-label=include::Mcl_DmaMux.h, category=SWHDR
          short-label=include::Mcl_DmaMux_Types.h, category=SWHDR
          short-label=include::Mcl_Dma_Types.h, category=SWHDR
          short-label=include::Mcl_EnvCfg.h, category=SWHDR
          short-label=include::Mcl_FlexIO_Common.h, category=SWHDR
          short-label=include::Mcl_FlexIO_Common_Types.h, category=SWHDR
          short-label=include::Mcl_IPW.h, category=SWHDR
          short-label=include::Mcl_IPW_Notif.h, category=SWHDR
          short-label=include::Mcl_IPW_Types.h, category=SWHDR
          short-label=include::Mcl_Lmem.h, category=SWHDR
          short-label=include::Mcl_Lmem_Types.h, category=SWHDR
          short-label=include::Mcl_Notif.h, category=SWHDR
          short-label=include::Mcl_TrgMux.h, category=SWHDR
          short-label=include::Mcl_TrgMux_Types.h, category=SWHDR
          short-label=include::Mcl_Types.h, category=SWHDR
          short-label=include::Reg_eSys_Dma.h, category=SWHDR
          short-label=include::Reg_eSys_DmaMux.h, category=SWHDR
          short-label=include::Reg_eSys_FlexIO.h, category=SWHDR
          short-label=include::Reg_eSys_Ftm.h, category=SWHDR
          short-label=include::Reg_eSys_Lmem.h, category=SWHDR
          short-label=include::Reg_eSys_LPit.h, category=SWHDR
          short-label=include::Reg_eSys_Lptmr.h, category=SWHDR
          short-label=include::Reg_eSys_TrgMux.h, category=SWHDR
          short-label=src::CDD_Mcl.c, category=SWSRC
          short-label=src::Ftm_Common.c, category=SWSRC
          short-label=src::LPit_Common.c, category=SWSRC
          short-label=src::Lptmr_Common.c, category=SWSRC
          short-label=src::Mcl_Dma.c, category=SWSRC
          short-label=src::Mcl_DmaMux.c, category=SWSRC
          short-label=src::Mcl_Dma_Irq.c, category=SWSRC
          short-label=src::Mcl_FlexIO_Common.c, category=SWSRC
          short-label=src::Mcl_FlexIO_Irq.c, category=SWSRC
          short-label=src::Mcl_IPW.c, category=SWSRC
          short-label=src::Mcl_Lmem.c, category=SWSRC
          short-label=src::Mcl_TrgMux.c, category=SWSRC
    compiler GHS_Compiler:
      name=Green Hills
      options=-cpu=cortexm4 -cpu=cortexm0plus -ansi -Osize -dual_debug -G --no_exceptions -Wundef -Wimplicit-int -Wshadow -Wtrigraphs -Wall --prototype_errors --incorrect_pragma_warnings -noslashcomment -preprocess_assembly_files -nostartfile --short_enum -c --no_commons -keeptempfiles -list -DAUTOSAR_OS_NOT_USED -DDISABLE_MCAL_INTERMODULE_ASR_CHECK -DGHS
      vendor=Green Hills
      version=Green Hills Multi 7.1.4 / Compiler 2017.1.4
    compiler IAR_Compiler: name=IAR Compiler, options=--cpu=Cortex-M4 --cpu=Cortex-M0+ --cpu_mode=thumb --endian=little -Ohz -c --no_clustering --no_mem_idioms --no_explicit_zero_opt --debug --diag_suppress=Pa050 -DAUTOSAR_OS_NOT_USED -DIAR --require_prototypes --no_wrap_diagnostics --no_system_include -e, vendor=IAR Systems, version=IAR: V8.11.2
    generated-artifacts:
      dependency on artifact CDD_Mcl_PBcfg_c: artifact-descriptor={short-label=generate_PB::src::CDD_Mcl_PBcfg.c, category=SWSRC}, usages=COMPILE
      dependency on artifact CDD_Mcl_Cfg_h: artifact-descriptor={short-label=generate_PC::include::CDD_Mcl_Cfg.h, category=SWHDR}, usages=COMPILE
      dependency on artifact CDD_Mcl_Cfg_c: artifact-descriptor={short-label=generate_PC::src::CDD_Mcl_Cfg.c, category=SWSRC}, usages=COMPILE
    linker GHS_Linker: name=Green Hills, options=-Mn -delete -v -ignore_debug_references -map -keepmap -lstartup -lsys -larch -lansi -L(/lib/thumb2) -lutf8_s32, vendor=Green Hills, version=Green Hills Multi 7.1.4 / Compiler 2017.1.4
    linker IAR_Linker: name=IAR Compiler, options=--cpu=Cortex-M4 --cpu=Cortex-M0+ --map filename --no_library_search --entry _start --enable_stack_usage --skip_dynamic_initialization --no_wrap_diagnostics --config, vendor=IAR Systems, version=IAR: V8.11.2
    resource consumption ResourceConsumption
      7 x memory section:
        MCL_CODE: alignment=UNSPECIFIED, sw-addrmethod=CODE, symbol=CODE
        MCL_CONFIG_DATA_UNSPECIFIED: alignment=UNSPECIFIED, sw-addrmethod=CONFIG_DATA, symbol=CONFIG_DATA_UNSPECIFIED
        MCL_CONST_32: alignment=32, sw-addrmethod=CONST, symbol=CONST_32
        MCL_CONST_UNSPECIFIED: alignment=UNSPECIFIED, sw-addrmethod=CONST, symbol=CONST_UNSPECIFIED
        MCL_VAR_INIT_8: alignment=8, sw-addrmethod=VAR_INIT, symbol=VAR_INIT_8
        MCL_VAR_INIT_UNSPECIFIED: alignment=UNSPECIFIED, sw-addrmethod=VAR_INIT, symbol=VAR_INIT_UNSPECIFIED
        MCL_VAR_NO_INIT_UNSPECIFIED: alignment=UNSPECIFIED, sw-addrmethod=VAR_NO_INIT, symbol=VAR_NO_INIT_UNSPECIFIED
