AUTOSAR XML (schema 4-0-3)
package /AUTOSAR_Gpt/BswModuleDescriptions
  bsw module description Gpt: module-id=100
    provided-entrys:
      Gpt_CheckWakeup
      Gpt_DeInit
      Gpt_DisableNotification
      Gpt_DisableWakeup
      Gpt_EnableNotification
      Gpt_EnableWakeup
      Gpt_GetTimeElapsed
      Gpt_GetTimeRemaining
      Gpt_GetVersionInfo
      Gpt_Init
      Gpt_SetMode
      Gpt_StartTimer
      Gpt_StopTimer
      Gpt_SRTC_0_Ch_0_ISR
    bsw internal behavior InternalBehavior_0
      25 x exclusive area:
        GPT_EXCLUSIVE_AREA_{00..08}
        GPT_EXCLUSIVE_AREA_{14..29}
      13 x bsw called entity:
        Gpt_CheckWakeup: implemented-entry=Gpt_CheckWakeup
        Gpt_DeInit: implemented-entry=Gpt_DeInit
        Gpt_DisableNotification: implemented-entry=Gpt_DisableNotification
        Gpt_DisableWakeup: implemented-entry=Gpt_DisableWakeup
        Gpt_EnableNotification: implemented-entry=Gpt_EnableNotification
        Gpt_EnableWakeup: implemented-entry=Gpt_EnableWakeup
        Gpt_GetTimeElapsed: implemented-entry=Gpt_GetTimeElapsed
        Gpt_GetTimeRemaining: implemented-entry=Gpt_GetTimeRemaining
        Gpt_GetVersionInfo: implemented-entry=Gpt_GetVersionInfo
        Gpt_Init: can-enter-exclusive-area=[GPT_EXCLUSIVE_AREA_00, GPT_EXCLUSIVE_AREA_01, GPT_EXCLUSIVE_AREA_02, GPT_EXCLUSIVE_AREA_03, GPT_EXCLUSIVE_AREA_04, GPT_EXCLUSIVE_AREA_05, GPT_EXCLUSIVE_AREA_06, GPT_EXCLUSIVE_AREA_07, GPT_EXCLUSIVE_AREA_08, GPT_EXCLUSIVE_AREA_14, GPT_EXCLUSIVE_AREA_15, GPT_EXCLUSIVE_AREA_16, GPT_EXCLUSIVE_AREA_17, GPT_EXCLUSIVE_AREA_18, GPT_EXCLUSIVE_AREA_19, GPT_EXCLUSIVE_AREA_20, GPT_EXCLUSIVE_AREA_21, GPT_EXCLUSIVE_AREA_22, GPT_EXCLUSIVE_AREA_23, GPT_EXCLUSIVE_AREA_24, GPT_EXCLUSIVE_AREA_25, GPT_EXCLUSIVE_AREA_26, GPT_EXCLUSIVE_AREA_27, GPT_EXCLUSIVE_AREA_28, GPT_EXCLUSIVE_AREA_29], implemented-entry=Gpt_Init
        Gpt_SetMode: implemented-entry=Gpt_SetMode
        Gpt_StartTimer: implemented-entry=Gpt_StartTimer
        Gpt_StopTimer: implemented-entry=Gpt_StopTimer
      bsw interrupt entity Gpt_SRTC_0_Ch_0_ISR: implemented-entry=Gpt_SRTC_0_Ch_0_ISR, interrupt-category=CAT-2, interrupt-source=Hardware
package /AUTOSAR_Gpt/BswModuleEntrys
  bsw module entry Gpt_SRTC_0_Ch_0_ISR: service-id=0, is-reentrant=false, is-synchronous=true, call-type=INTERRUPT, execution-context=INTERRUPT-CAT-2, sw-service-impl-policy=STANDARD
package /Gpt_T40D2M10I2R0/Implementations
  bsw implementation BswImplementation_0: programming-language=C, sw-version=4.2.2, vendor-id=43, ar-release-version=4.2.2, behavior=InternalBehavior_0, vendor-specific-module-def=Gpt
    code-descriptors:
      code Files
        artifact-descriptors:
          short-label=config::Gpt.xdm, category=SWCFG
          short-label=doc::AUTOSAR_MCAL_GPT_IM.pdf, category=SWDOC
          short-label=doc::AUTOSAR_MCAL_GPT_UM.pdf, category=SWDOC
          short-label=include::Gpt.h, category=SWHDR
          short-label=include::Gpt_EnvCfg.h, category=SWHDR
          short-label=include::Gpt_Ftm.h, category=SWHDR
          short-label=include::Gpt_Ftm_Types.h, category=SWHDR
          short-label=include::Gpt_Ipw.h, category=SWHDR
          short-label=include::Gpt_Ipw_Irq.h, category=SWHDR
          short-label=include::Gpt_Ipw_Types.h, category=SWHDR
          short-label=include::Gpt_Irq.h, category=SWHDR
          short-label=include::Gpt_LPit.h, category=SWHDR
          short-label=include::Gpt_LPit_Types.h, category=SWHDR
          short-label=include::Gpt_Lptmr.h, category=SWHDR
          short-label=include::Gpt_Lptmr_Types.h, category=SWHDR
          short-label=include::Gpt_SRtc.h, category=SWHDR
          short-label=include::Gpt_SRtc_Types.h, category=SWHDR
          short-label=include::Reg_eSys_SRtc.h, category=SWHDR
          short-label=src::Gpt.c, category=SWSRC
          short-label=src::Gpt_Ftm.c, category=SWSRC
          short-label=src::Gpt_Ipw.c, category=SWSRC
          short-label=src::Gpt_LPit.c, category=SWSRC
          short-label=src::Gpt_Lptmr.c, category=SWSRC
          short-label=src::Gpt_SRtc.c, category=SWSRC
    compiler GHS_Compiler:
      name=Green Hills
      options=-cpu=cortexm4 -cpu=cortexm0plus -ansi -Osize -dual_debug -G --no_exceptions -Wundef -Wimplicit-int -Wshadow -Wtrigraphs -Wall --prototype_errors --incorrect_pragma_warnings -noslashcomment -preprocess_assembly_files -nostartfile --short_enum -c --no_commons -keeptempfiles -list -DAUTOSAR_OS_NOT_USED -DDISABLE_MCAL_INTERMODULE_ASR_CHECK -DGHS
      vendor=Green Hills
      version=Green Hills Multi 7.1.4 / Compiler 2017.1.4
    compiler IAR_Compiler: name=IAR Compiler, options=--cpu=Cortex-M4 --cpu=Cortex-M0+ --cpu_mode=thumb --endian=little -Ohz -c --no_clustering --no_mem_idioms --no_explicit_zero_opt --debug --diag_suppress=Pa050 -DAUTOSAR_OS_NOT_USED -DIAR --require_prototypes --no_wrap_diagnostics --no_system_include -e, vendor=IAR Systems, version=IAR: V8.11.2
    generated-artifacts:
      dependency on artifact Gpt_PBcfg_c: artifact-descriptor={short-label=generate_PB::src::Gpt_PBcfg.c, category=SWSRC}, usages=COMPILE
      dependency on artifact Gpt_Cfg_h: artifact-descriptor={short-label=generate_PC::include::Gpt_Cfg.h, category=SWHDR}, usages=COMPILE
      dependency on artifact Gpt_Cfg_c: artifact-descriptor={short-label=generate_PC::src::Gpt_Cfg.c, category=SWSRC}, usages=COMPILE
    linker GHS_Linker: name=Green Hills, options=-Mn -delete -v -ignore_debug_references -map -keepmap -lstartup -lsys -larch -lansi -L(/lib/thumb2) -lutf8_s32, vendor=Green Hills, version=Green Hills Multi 7.1.4 / Compiler 2017.1.4
    linker IAR_Linker: name=IAR Compiler, options=--cpu=Cortex-M4 --cpu=Cortex-M0+ --map filename --no_library_search --entry _start --enable_stack_usage --skip_dynamic_initialization --no_wrap_diagnostics --config, vendor=IAR Systems, version=IAR: V8.11.2
    resource consumption ResourceConsumption
      5 x memory section:
        GPT_CODE: alignment=UNSPECIFIED, sw-addrmethod=CODE, symbol=CODE
        GPT_CONFIG_DATA_UNSPECIFIED: alignment=UNSPECIFIED, sw-addrmethod=CONFIG_DATA, symbol=CONFIG_DATA_UNSPECIFIED
        GPT_VAR_INIT_32: alignment=32, sw-addrmethod=VAR_INIT, symbol=VAR_INIT_32
        GPT_VAR_INIT_UNSPECIFIED: alignment=UNSPECIFIED, sw-addrmethod=VAR_INIT, symbol=VAR_INIT_UNSPECIFIED
        GPT_VAR_NO_INIT_UNSPECIFIED: alignment=UNSPECIFIED, sw-addrmethod=VAR_NO_INIT, symbol=VAR_NO_INIT_UNSPECIFIED
