AUTOSAR XML (schema 4-0-3)
package /AUTOSAR_Spi/BswModuleDescriptions
  bsw module description Spi: module-id=83
    provided-entrys:
      Spi_AsyncTransmit
      Spi_Cancel
      Spi_DeInit
      Spi_GetHWUnitStatus
      Spi_GetJobResult
      Spi_GetSequenceResult
      Spi_GetStatus
      Spi_GetVersionInfo
      Spi_Init
      Spi_ReadIB
      Spi_SetAsyncMode
      Spi_SetupEB
      Spi_SyncTransmit
      Spi_WriteIB
    bsw internal behavior InternalBehavior_0
      7 x exclusive area:
        SPI_EXCLUSIVE_AREA_{01..07}
      14 x bsw called entity:
        Spi_AsyncTransmit: implemented-entry=Spi_AsyncTransmit
        Spi_Cancel: implemented-entry=Spi_Cancel
        Spi_DeInit: implemented-entry=Spi_DeInit
        Spi_GetHWUnitStatus: implemented-entry=Spi_GetHWUnitStatus
        Spi_GetJobResult: implemented-entry=Spi_GetJobResult
        Spi_GetSequenceResult: implemented-entry=Spi_GetSequenceResult
        Spi_GetStatus: implemented-entry=Spi_GetStatus
        Spi_GetVersionInfo: implemented-entry=Spi_GetVersionInfo
        Spi_Init: can-enter-exclusive-area=[SPI_EXCLUSIVE_AREA_01, SPI_EXCLUSIVE_AREA_02, SPI_EXCLUSIVE_AREA_03, SPI_EXCLUSIVE_AREA_04, SPI_EXCLUSIVE_AREA_05, SPI_EXCLUSIVE_AREA_06, SPI_EXCLUSIVE_AREA_07], implemented-entry=Spi_Init
        Spi_ReadIB: implemented-entry=Spi_ReadIB
        Spi_SetAsyncMode: implemented-entry=Spi_SetAsyncMode
        Spi_SetupEB: implemented-entry=Spi_SetupEB
        Spi_SyncTransmit: implemented-entry=Spi_SyncTransmit
        Spi_WriteIB: implemented-entry=Spi_WriteIB
package /Spi_T40D2M10I2R0/Implementations
  bsw implementation BswImplementation_0: programming-language=C, sw-version=4.2.2, vendor-id=43, ar-release-version=4.2.2, behavior=InternalBehavior_0, vendor-specific-module-def=Spi
    code-descriptors:
      code Files
        artifact-descriptors:
          short-label=config::Spi.xdm, category=SWCFG
          short-label=doc::AUTOSAR_MCAL_SPI_IM.pdf, category=SWDOC
          short-label=doc::AUTOSAR_MCAL_SPI_UM.pdf, category=SWDOC
          short-label=include::Reg_eSys_FlexIOSPI.h, category=SWHDR
          short-label=include::Reg_eSys_LPspi.h, category=SWHDR
          short-label=include::Spi.h, category=SWHDR
          short-label=include::Spi_FlexIO.h, category=SWHDR
          short-label=include::Spi_IPW.h, category=SWHDR
          short-label=include::Spi_IPW_Types.h, category=SWHDR
          short-label=include::Spi_LPspi.h, category=SWHDR
          short-label=src::Spi.c, category=SWSRC
          short-label=src::Spi_FlexIO.c, category=SWSRC
          short-label=src::Spi_FlexIO_Irq.c, category=SWSRC
          short-label=src::Spi_IPW.c, category=SWSRC
          short-label=src::Spi_LPspi.c, category=SWSRC
          short-label=src::Spi_LPspi_Irq.c, category=SWSRC
    compiler IAR_Compiler: name=IAR Compiler, options=--cpu=Cortex-M4 --cpu=Cortex-M0+ --cpu_mode=thumb --endian=little -Ohz -c --no_clustering --no_mem_idioms --no_explicit_zero_opt --debug --diag_suppress=Pa050 -DAUTOSAR_OS_NOT_USED -DIAR --require_prototypes --no_wrap_diagnostics --no_system_include -e, vendor=IAR Systems, version=IAR: V8.11.2
    compiler GHS_Compiler:
      name=Green Hills
      options=-cpu=cortexm4 -cpu=cortexm0plus -ansi -Osize -dual_debug -G --no_exceptions -Wundef -Wimplicit-int -Wshadow -Wtrigraphs -Wall --prototype_errors --incorrect_pragma_warnings -noslashcomment -preprocess_assembly_files -nostartfile --short_enum -c --no_commons -keeptempfiles -list -DAUTOSAR_OS_NOT_USED -DDISABLE_MCAL_INTERMODULE_ASR_CHECK -DGHS
      vendor=Green Hills
      version=Green Hills Multi 7.1.4 / Compiler 2017.1.4
    generated-artifacts:
      dependency on artifact Spi_PBcfg_c: artifact-descriptor={short-label=generate_PB::src::Spi_PBcfg.c, category=SWSRC}, usages=COMPILE
      dependency on artifact Spi_Cfg_h: artifact-descriptor={short-label=generate_PC::include::Spi_Cfg.h, category=SWHDR}, usages=COMPILE
      dependency on artifact Spi_Cfg_c: artifact-descriptor={short-label=generate_PC::src::Spi_Cfg.c, category=SWSRC}, usages=COMPILE
    linker IAR_Linker: name=IAR Compiler, options=--cpu=Cortex-M4 --cpu=Cortex-M0+ --map filename --no_library_search --entry _start --enable_stack_usage --skip_dynamic_initialization --no_wrap_diagnostics --config, vendor=IAR Systems, version=IAR: V8.11.2
    linker GHS_Linker: name=Green Hills, options=-Mn -delete -v -ignore_debug_references -map -keepmap -lstartup -lsys -larch -lansi -L(/lib/thumb2) -lutf8_s32, vendor=Green Hills, version=Green Hills Multi 7.1.4 / Compiler 2017.1.4
    resource consumption ResourceConsumption
      6 x memory section:
        SPI_CODE: alignment=UNSPECIFIED, sw-addrmethod=CODE, symbol=CODE
        SPI_CONFIG_DATA_UNSPECIFIED: alignment=UNSPECIFIED, sw-addrmethod=CONFIG_DATA, symbol=CONFIG_DATA_UNSPECIFIED
        SPI_CONST_32: alignment=32, sw-addrmethod=CONST, symbol=CONST_32
        SPI_VAR_INIT_UNSPECIFIED: alignment=UNSPECIFIED, sw-addrmethod=VAR_INIT, symbol=VAR_INIT_UNSPECIFIED
        SPI_VAR_NO_INIT_32: alignment=32, sw-addrmethod=VAR_NO_INIT, symbol=VAR_NO_INIT_32
        SPI_VAR_NO_INIT_UNSPECIFIED: alignment=UNSPECIFIED, sw-addrmethod=VAR_NO_INIT, symbol=VAR_NO_INIT_UNSPECIFIED
