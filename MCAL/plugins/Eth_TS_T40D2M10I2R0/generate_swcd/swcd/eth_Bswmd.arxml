AUTOSAR XML (schema 4-0-3)
package /AUTOSAR_Eth/BswModuleDescriptions
  bsw module description Eth: module-id=88
    provided-entrys:
      Eth_EnableEgressTimeStamp
      Eth_GetControllerMode
      Eth_GetCurrentTime
      Eth_GetEgressTimeStamp
      Eth_GetEtherStats
      Eth_GetIngressTimeStamp
      Eth_GetPhysAddr
      Eth_GetVersionInfo
      Eth_Init
      Eth_MainFunction
      Eth_Receive
      Eth_SetControllerMode
      Eth_SetCorrectionTime
      Eth_SetGlobalTime
      Eth_SetPhysAddr
      Eth_TxConfirmation
      Eth_ControllerInit
      Eth_GetCounterState
      Eth_ProvideTxBuffer
      Eth_ReadMii
      Eth_RxIrqHdlr_0
      Eth_Transmit
      Eth_TxIrqHdlr_0
      Eth_WriteMii
      Eth_RxIrqHdlr_0
      Eth_RxIrqHdlr_1
      Eth_TxIrqHdlr_0
      Eth_TxIrqHdlr_1
    bsw internal behavior InternalBehavior_0
      exclusive area ETH_EXCLUSIVE_AREA_{00..02}
      24 x bsw called entity:
        Eth_EnableEgressTimeStamp: implemented-entry=Eth_EnableEgressTimeStamp
        Eth_GetControllerMode: implemented-entry=Eth_GetControllerMode
        Eth_GetCurrentTime: implemented-entry=Eth_GetCurrentTime
        Eth_GetEgressTimeStamp: implemented-entry=Eth_GetEgressTimeStamp
        Eth_GetEtherStats: implemented-entry=Eth_GetEtherStats
        Eth_GetIngressTimeStamp: implemented-entry=Eth_GetIngressTimeStamp
        Eth_GetPhysAddr: implemented-entry=Eth_GetPhysAddr
        Eth_GetVersionInfo: implemented-entry=Eth_GetVersionInfo
        Eth_Init: can-enter-exclusive-area=[ETH_EXCLUSIVE_AREA_00, ETH_EXCLUSIVE_AREA_01, ETH_EXCLUSIVE_AREA_02], implemented-entry=Eth_Init
        Eth_MainFunction: implemented-entry=Eth_MainFunction
        Eth_Receive: implemented-entry=Eth_Receive
        Eth_SetControllerMode: implemented-entry=Eth_SetControllerMode
        Eth_SetCorrectionTime: implemented-entry=Eth_SetCorrectionTime
        Eth_SetGlobalTime: implemented-entry=Eth_SetGlobalTime
        Eth_SetPhysAddr: implemented-entry=Eth_SetPhysAddr
        Eth_TxConfirmation: implemented-entry=Eth_TxConfirmation
        Eth_ControllerInit: implemented-entry=Eth_ControllerInit
        Eth_GetCounterState: implemented-entry=Eth_GetCounterState
        Eth_ProvideTxBuffer: implemented-entry=Eth_ProvideTxBuffer
        Eth_ReadMii: implemented-entry=Eth_ReadMii
        Eth_RxIrqHdlr_0: implemented-entry=Eth_RxIrqHdlr_0
        Eth_Transmit: implemented-entry=Eth_Transmit
        Eth_TxIrqHdlr_0: implemented-entry=Eth_TxIrqHdlr_0
        Eth_WriteMii: implemented-entry=Eth_WriteMii
      4 x bsw interrupt entity, all with interrupt-category=CAT-2, interrupt-source=Hardware:
        Eth_RxIrqHdlr_0: implemented-entry=Eth_RxIrqHdlr_0
        Eth_RxIrqHdlr_1: implemented-entry=Eth_RxIrqHdlr_1
        Eth_TxIrqHdlr_0: implemented-entry=Eth_TxIrqHdlr_0
        Eth_TxIrqHdlr_1: implemented-entry=Eth_TxIrqHdlr_1
      bsw timing event EthTimingEvent_MainFunction: starts-on-event=Eth_MainFunction, period=0
package /AUTOSAR_Eth/BswModuleEntrys
  4 x bsw module entry, all with service-id=0, is-reentrant=false, is-synchronous=true, call-type=INTERRUPT, execution-context=INTERRUPT-CAT-2, sw-service-impl-policy=STANDARD:
    Eth_RxIrqHdlr_0
    Eth_RxIrqHdlr_1
    Eth_TxIrqHdlr_0
    Eth_TxIrqHdlr_1
package /Eth_T40D2M10I2R0/Implementations
  bsw implementation BswImplementation_0: programming-language=C, sw-version=4.2.2, vendor-id=43, ar-release-version=4.2.2, behavior=InternalBehavior_0, vendor-specific-module-def=Eth
    code-descriptors:
      code Files
        artifact-descriptors:
          short-label=config::Eth.xdm, category=SWCFG
          short-label=doc::AUTOSAR_MCAL_ETH_IM.pdf, category=SWDOC
          short-label=doc::AUTOSAR_MCAL_ETH_UM.pdf, category=SWDOC
          short-label=include::Eth.h, category=SWHDR
          short-label=include::Eth_Enet.h, category=SWHDR
          short-label=include::Eth_Enet_Counters.h, category=SWHDR
          short-label=include::Eth_Ipw.h, category=SWHDR
          short-label=include::Eth_Irq.h, category=SWHDR
          short-label=src::Eth.c, category=SWSRC
          short-label=src::Eth_Buffers.c, category=SWSRC
          short-label=src::Eth_Enet.c, category=SWSRC
          short-label=src::Eth_Ipw.c, category=SWSRC
          short-label=src::Eth_Irq.c, category=SWSRC
    compiler GHS_Compiler:
      name=Green Hills
      options=-cpu=cortexm4 -cpu=cortexm0plus -ansi -Osize -dual_debug -G --no_exceptions -Wundef -Wimplicit-int -Wshadow -Wtrigraphs -Wall --prototype_errors --incorrect_pragma_warnings -noslashcomment -preprocess_assembly_files -nostartfile --short_enum -c --no_commons -keeptempfiles -list -DAUTOSAR_OS_NOT_USED -DDISABLE_MCAL_INTERMODULE_ASR_CHECK -DGHS
      vendor=Green Hills
      version=Green Hills Multi 7.1.4 / Compiler 2017.1.4
    compiler IAR_Compiler: name=IAR Compiler, options=--cpu=Cortex-M4 --cpu=Cortex-M0+ --cpu_mode=thumb --endian=little -Ohz -c --no_clustering --no_mem_idioms --no_explicit_zero_opt --debug --diag_suppress=Pa050 -DAUTOSAR_OS_NOT_USED -DIAR --require_prototypes --no_wrap_diagnostics --no_system_include -e, vendor=IAR Systems, version=IAR: V8.11.2
    generated-artifacts:
      dependency on artifact Eth_Cfg_h: artifact-descriptor={short-label=generate::include::Eth_Cfg.h, category=SWHDR}, usages=COMPILE
      dependency on artifact Eth_Cfg_c: artifact-descriptor={short-label=generate::src::Eth_Cfg.c, category=SWSRC}, usages=COMPILE
      dependency on artifact Eth_PBcfg_c: artifact-descriptor={short-label=generate::src::Eth_PBcfg.c, category=SWSRC}, usages=COMPILE
    linker GHS_Linker: name=Green Hills, options=-Mn -delete -v -ignore_debug_references -map -keepmap -lstartup -lsys -larch -lansi -L(/lib/thumb2) -lutf8_s32, vendor=Green Hills, version=Green Hills Multi 7.1.4 / Compiler 2017.1.4
    linker IAR_Linker: name=IAR Compiler, options=--cpu=Cortex-M4 --cpu=Cortex-M0+ --map filename --no_library_search --entry _start --enable_stack_usage --skip_dynamic_initialization --no_wrap_diagnostics --config, vendor=IAR Systems, version=IAR: V8.11.2
    resource consumption ResourceConsumption
      13 x memory section:
        ETH_CODE: alignment=UNSPECIFIED, sw-addrmethod=CODE, symbol=CODE
        ETH_CONFIG_DATA_UNSPECIFIED: alignment=UNSPECIFIED, sw-addrmethod=CONFIG_DATA, symbol=CONFIG_DATA_UNSPECIFIED
        ETH_CONST_16: alignment=16, sw-addrmethod=CONST, symbol=CONST_16
        ETH_CONST_32: alignment=32, sw-addrmethod=CONST, symbol=CONST_32
        ETH_CONST_UNSPECIFIED: alignment=UNSPECIFIED, sw-addrmethod=CONST, symbol=CONST_UNSPECIFIED
        ETH_VAR_INIT_16: alignment=16, sw-addrmethod=VAR_INIT, symbol=VAR_INIT_16
        ETH_VAR_INIT_32: alignment=32, sw-addrmethod=VAR_INIT, symbol=VAR_INIT_32
        ETH_VAR_INIT_8: alignment=8, sw-addrmethod=VAR_INIT, symbol=VAR_INIT_8
        ETH_VAR_INIT_BOOLEAN: alignment=BOOLEAN, sw-addrmethod=VAR_INIT, symbol=VAR_INIT_BOOLEAN
        ETH_VAR_INIT_UNSPECIFIED: alignment=UNSPECIFIED, sw-addrmethod=VAR_INIT, symbol=VAR_INIT_UNSPECIFIED
        ETH_VAR_NO_INIT_8: alignment=8, sw-addrmethod=VAR_NO_INIT, symbol=VAR_NO_INIT_8
        ETH_VAR_NO_INIT_UNSPECIFIED: alignment=UNSPECIFIED, sw-addrmethod=VAR_NO_INIT, symbol=VAR_NO_INIT_UNSPECIFIED
        ETH_VAR_NO_INIT_UNSPECIFIED_NO_CACHEABLE: alignment=CACHEABLE, sw-addrmethod=VAR_NO_INIT_UNSPECIFIED_NO, symbol=VAR_NO_INIT_UNSPECIFIED_NO_CACHEABLE
