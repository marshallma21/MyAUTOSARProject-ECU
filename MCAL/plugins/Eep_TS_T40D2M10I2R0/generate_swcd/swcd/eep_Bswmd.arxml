AUTOSAR XML (schema 4-0-3)
package /AUTOSAR_Eep/BswModuleDescriptions
  bsw module description Eep: module-id=90
    provided-entrys:
      Eep_Cancel
      Eep_Compare
      Eep_Erase
      Eep_GetJobResult
      Eep_GetStatus
      Eep_GetVersionInfo
      Eep_Init
      Eep_MainFunction
      Eep_QuickWrite
      Eep_Read
      Eep_ReportDemErrors
      Eep_ReportDemPasses
      Eep_SetMode
      Eep_Write
    bsw internal behavior InternalBehavior_0
      9 x exclusive area:
        EEP_EXCLUSIVE_AREA_{01..09}
      14 x bsw called entity:
        Eep_Cancel: implemented-entry=Eep_Cancel
        Eep_Compare: implemented-entry=Eep_Compare
        Eep_Erase: implemented-entry=Eep_Erase
        Eep_GetJobResult: implemented-entry=Eep_GetJobResult
        Eep_GetStatus: implemented-entry=Eep_GetStatus
        Eep_GetVersionInfo: implemented-entry=Eep_GetVersionInfo
        Eep_Init: can-enter-exclusive-area=[EEP_EXCLUSIVE_AREA_01, EEP_EXCLUSIVE_AREA_02, EEP_EXCLUSIVE_AREA_03, EEP_EXCLUSIVE_AREA_04, EEP_EXCLUSIVE_AREA_05, EEP_EXCLUSIVE_AREA_06, EEP_EXCLUSIVE_AREA_07, EEP_EXCLUSIVE_AREA_08, EEP_EXCLUSIVE_AREA_09], implemented-entry=Eep_Init
        Eep_MainFunction: implemented-entry=Eep_MainFunction
        Eep_QuickWrite: implemented-entry=Eep_QuickWrite
        Eep_Read: implemented-entry=Eep_Read
        Eep_ReportDemErrors: implemented-entry=Eep_ReportDemErrors
        Eep_ReportDemPasses: implemented-entry=Eep_ReportDemPasses
        Eep_SetMode: implemented-entry=Eep_SetMode
        Eep_Write: implemented-entry=Eep_Write
      bsw timing event EepTimingEvent_MainFunction: starts-on-event=Eep_MainFunction, period=0.001
package /Eep_T40D2M10I2R0/Implementations
  bsw implementation BswImplementation_0: programming-language=C, sw-version=4.2.2, vendor-id=43, ar-release-version=4.2.2, behavior=InternalBehavior_0, vendor-specific-module-def=Eep
    code-descriptors:
      code Files
        artifact-descriptors:
          short-label=config::Eep.xdm, category=SWCFG
          short-label=doc::AUTOSAR_MCAL_EEP_IM.pdf, category=SWDOC
          short-label=doc::AUTOSAR_MCAL_EEP_UM.pdf, category=SWDOC
          short-label=include::Eep.h, category=SWHDR
          short-label=include::Eep_Api.h, category=SWHDR
          short-label=include::Eep_InternalTypes.h, category=SWHDR
          short-label=include::Eep_Types.h, category=SWHDR
          short-label=include::Reg_eSys_Ftfc.h, category=SWHDR
          short-label=src::Eep.c, category=SWSRC
          short-label=src::Eep_Ac.c, category=SWSRC
    compiler GHS_Compiler:
      name=Green Hills
      options=-cpu=cortexm4 -cpu=cortexm0plus -ansi -Osize -dual_debug -G --no_exceptions -Wundef -Wimplicit-int -Wshadow -Wtrigraphs -Wall --prototype_errors --incorrect_pragma_warnings -noslashcomment -preprocess_assembly_files -nostartfile --short_enum -c --no_commons -keeptempfiles -list -DAUTOSAR_OS_NOT_USED -DDISABLE_MCAL_INTERMODULE_ASR_CHECK -DGHS
      vendor=Green Hills
      version=Green Hills Multi 7.1.4 / Compiler 2017.1.4
    compiler IAR_Compiler: name=IAR Compiler, options=--cpu=Cortex-M4 --cpu=Cortex-M0+ --cpu_mode=thumb --endian=little -Ohz -c --no_clustering --no_mem_idioms --no_explicit_zero_opt --debug --diag_suppress=Pa050 -DAUTOSAR_OS_NOT_USED -DIAR --require_prototypes --no_wrap_diagnostics --no_system_include -e, vendor=IAR Systems, version=IAR: V8.11.2
    generated-artifacts:
      dependency on artifact Eep_PBcfg_c: artifact-descriptor={short-label=generate_PB::src::Eep_PBcfg.c, category=SWSRC}, usages=COMPILE
      dependency on artifact Eep_Cfg_h: artifact-descriptor={short-label=generate_PC::include::Eep_Cfg.h, category=SWHDR}, usages=COMPILE
      dependency on artifact Eep_Cfg_c: artifact-descriptor={short-label=generate_PC::src::Eep_Cfg.c, category=SWSRC}, usages=COMPILE
    linker GHS_Linker: name=Green Hills, options=-Mn -delete -v -ignore_debug_references -map -keepmap -lstartup -lsys -larch -lansi -L(/lib/thumb2) -lutf8_s32, vendor=Green Hills, version=Green Hills Multi 7.1.4 / Compiler 2017.1.4
    linker IAR_Linker: name=IAR Compiler, options=--cpu=Cortex-M4 --cpu=Cortex-M0+ --map filename --no_library_search --entry _start --enable_stack_usage --skip_dynamic_initialization --no_wrap_diagnostics --config, vendor=IAR Systems, version=IAR: V8.11.2
    resource consumption ResourceConsumption
      10 x memory section:
        EEP_CODE: alignment=UNSPECIFIED, sw-addrmethod=CODE, symbol=CODE
        EEP_CODE_AC: alignment=AC, sw-addrmethod=CODE, symbol=CODE_AC
        EEP_CONFIG_DATA_UNSPECIFIED: alignment=UNSPECIFIED, sw-addrmethod=CONFIG_DATA, symbol=CONFIG_DATA_UNSPECIFIED
        EEP_CONST_32: alignment=32, sw-addrmethod=CONST, symbol=CONST_32
        EEP_CONST_8: alignment=8, sw-addrmethod=CONST, symbol=CONST_8
        EEP_VAR_INIT_16: alignment=16, sw-addrmethod=VAR_INIT, symbol=VAR_INIT_16
        EEP_VAR_INIT_32: alignment=32, sw-addrmethod=VAR_INIT, symbol=VAR_INIT_32
        EEP_VAR_INIT_8: alignment=8, sw-addrmethod=VAR_INIT, symbol=VAR_INIT_8
        EEP_VAR_INIT_BOOLEAN: alignment=BOOLEAN, sw-addrmethod=VAR_INIT, symbol=VAR_INIT_BOOLEAN
        EEP_VAR_INIT_UNSPECIFIED: alignment=UNSPECIFIED, sw-addrmethod=VAR_INIT, symbol=VAR_INIT_UNSPECIFIED
