AUTOSAR XML (schema 4-0-3)
package /AUTOSAR_Crcu/BswModuleDescriptions
  bsw module description Crcu: module-id=255
    bsw internal behavior InternalBehavior_0
      exclusive area CRCU_EXCLUSIVE_AREA_00
      exclusive area CRCU_EXCLUSIVE_AREA_01
package /Crcu_T40D2M10I2R0/Implementations
  bsw implementation BswImplementation_0: programming-language=C, sw-version=4.2.2, vendor-id=43, ar-release-version=4.2.2, behavior=InternalBehavior_0, vendor-specific-module-def=Crcu
    code-descriptors:
      code Files
        artifact-descriptors:
          short-label=config::Crcu.xdm, category=SWCFG
          short-label=doc::AUTOSAR_MCAL_CRCU_IM.pdf, category=SWDOC
          short-label=doc::AUTOSAR_MCAL_CRCU_UM.pdf, category=SWDOC
          short-label=include::CDD_Crcu.h, category=SWHDR
          short-label=include::Crcu.h, category=SWHDR
          short-label=include::Crcu_Crcv2.h, category=SWHDR
          short-label=include::Crcu_Crcv2_Types.h, category=SWHDR
          short-label=include::Crcu_Ipw.h, category=SWHDR
          short-label=include::Crcu_Ipw_Types.h, category=SWHDR
          short-label=include::Crcu_Reg_eSys_Crcv2.h, category=SWHDR
          short-label=include::Crcu_Types.h, category=SWHDR
          short-label=src::CDD_Crcu.c, category=SWSRC
          short-label=src::Crcu_Crcv2.c, category=SWSRC
          short-label=src::Crcu_Ipw.c, category=SWSRC
    compiler IAR_Compiler: name=IAR Compiler, options=--cpu=Cortex-M4 --cpu=Cortex-M0+ --cpu_mode=thumb --endian=little -Ohz -c --no_clustering --no_mem_idioms --no_explicit_zero_opt --debug --diag_suppress=Pa050 -DAUTOSAR_OS_NOT_USED -DIAR --require_prototypes --no_wrap_diagnostics --no_system_include -e, vendor=IAR Systems, version=IAR: V8.11.2
    compiler GHS_Compiler:
      name=Green Hills
      options=-cpu=cortexm4 -cpu=cortexm0plus -ansi -Osize -dual_debug -G --no_exceptions -Wundef -Wimplicit-int -Wshadow -Wtrigraphs -Wall --prototype_errors --incorrect_pragma_warnings -noslashcomment -preprocess_assembly_files -nostartfile --short_enum -c --no_commons -keeptempfiles -list -DAUTOSAR_OS_NOT_USED -DDISABLE_MCAL_INTERMODULE_ASR_CHECK -DGHS
      vendor=Green Hills
      version=Green Hills Multi 7.1.4 / Compiler 2017.1.4
    generated-artifacts:
      dependency on artifact CDD_Crcu_PBcfg_c: artifact-descriptor={short-label=generate_PB::src::CDD_Crcu_PBcfg.c, category=SWSRC}, usages=COMPILE
      dependency on artifact CDD_Crcu_Cfg_h: artifact-descriptor={short-label=generate_PC::include::CDD_Crcu_Cfg.h, category=SWHDR}, usages=COMPILE
      dependency on artifact CDD_Crcu_Cfg_c: artifact-descriptor={short-label=generate_PC::src::CDD_Crcu_Cfg.c, category=SWSRC}, usages=COMPILE
    linker IAR_Linker: name=IAR Compiler, options=--cpu=Cortex-M4 --cpu=Cortex-M0+ --map filename --no_library_search --entry _start --enable_stack_usage --skip_dynamic_initialization --no_wrap_diagnostics --config, vendor=IAR Systems, version=IAR: V8.11.2
    linker GHS_Linker: name=Green Hills, options=-Mn -delete -v -ignore_debug_references -map -keepmap -lstartup -lsys -larch -lansi -L(/lib/thumb2) -lutf8_s32, vendor=Green Hills, version=Green Hills Multi 7.1.4 / Compiler 2017.1.4
    resource consumption ResourceConsumption
      7 x memory section:
        CRCU_CODE: alignment=UNSPECIFIED, sw-addrmethod=CODE, symbol=CODE
        CRCU_CONFIG_DATA_UNSPECIFIED: alignment=UNSPECIFIED, sw-addrmethod=CONFIG_DATA, symbol=CONFIG_DATA_UNSPECIFIED
        CRCU_CONST_32: alignment=32, sw-addrmethod=CONST, symbol=CONST_32
        CRCU_CONST_8: alignment=8, sw-addrmethod=CONST, symbol=CONST_8
        CRCU_CONST_UNSPECIFIED: alignment=UNSPECIFIED, sw-addrmethod=CONST, symbol=CONST_UNSPECIFIED
        CRCU_VAR_INIT_UNSPECIFIED: alignment=UNSPECIFIED, sw-addrmethod=VAR_INIT, symbol=VAR_INIT_UNSPECIFIED
        CRCU_VAR_NO_INIT_UNSPECIFIED: alignment=UNSPECIFIED, sw-addrmethod=VAR_NO_INIT, symbol=VAR_NO_INIT_UNSPECIFIED
