AUTOSAR XML (schema 4-0-3)
package /AUTOSAR_Fee/BswModuleDescriptions
  bsw module description Fee: module-id=21
    provided-entrys:
      Fee_Cancel
      Fee_EraseImmediateBlock
      Fee_ForceSwapOnNextWrite
      Fee_GetJobResult
      Fee_GetRunTimeInfo
      Fee_GetStatus
      Fee_GetVersionInfo
      Fee_Init
      Fee_InvalidateBlock
      Fee_JobEndNotification
      Fee_JobErrorNotification
      Fee_MainFunction
      Fee_Read
      Fee_SetMode
      Fee_Write
    bsw internal behavior InternalBehavior_0
      4 x exclusive area:
        FEE_EXCLUSIVE_AREA_{00..03}
      15 x bsw called entity:
        Fee_Cancel: implemented-entry=Fee_Cancel
        Fee_EraseImmediateBlock: implemented-entry=Fee_EraseImmediateBlock
        Fee_ForceSwapOnNextWrite: implemented-entry=Fee_ForceSwapOnNextWrite
        Fee_GetJobResult: implemented-entry=Fee_GetJobResult
        Fee_GetRunTimeInfo: implemented-entry=Fee_GetRunTimeInfo
        Fee_GetStatus: implemented-entry=Fee_GetStatus
        Fee_GetVersionInfo: implemented-entry=Fee_GetVersionInfo
        Fee_Init: can-enter-exclusive-area=[FEE_EXCLUSIVE_AREA_00, FEE_EXCLUSIVE_AREA_01, FEE_EXCLUSIVE_AREA_02, FEE_EXCLUSIVE_AREA_03], implemented-entry=Fee_Init
        Fee_InvalidateBlock: implemented-entry=Fee_InvalidateBlock
        Fee_JobEndNotification: implemented-entry=Fee_JobEndNotification
        Fee_JobErrorNotification: implemented-entry=Fee_JobErrorNotification
        Fee_MainFunction: implemented-entry=Fee_MainFunction
        Fee_Read: implemented-entry=Fee_Read
        Fee_SetMode: implemented-entry=Fee_SetMode
        Fee_Write: implemented-entry=Fee_Write
      bsw timing event FeeTimingEvent_MainFunction: starts-on-event=Fee_MainFunction, period=5.0E-3
package /Fee_T40D2M10I2R0/Implementations
  bsw implementation BswImplementation_0: programming-language=C, sw-version=4.2.2, vendor-id=43, ar-release-version=4.2.2, behavior=InternalBehavior_0, vendor-specific-module-def=Fee
    code-descriptors:
      code Files
        artifact-descriptors:
          short-label=config::Fee.xdm, category=SWCFG
          short-label=doc::AUTOSAR_MCAL_FEE_IM.pdf, category=SWDOC
          short-label=doc::AUTOSAR_MCAL_FEE_UM.pdf, category=SWDOC
          short-label=include::Fee.h, category=SWHDR
          short-label=include::Fee_Cbk.h, category=SWHDR
          short-label=include::Fee_InternalTypes.h, category=SWHDR
          short-label=include::Fee_Types.h, category=SWHDR
          short-label=src::Fee.c, category=SWSRC
    compiler GHS_Compiler:
      name=Green Hills
      options=-cpu=cortexm4 -cpu=cortexm0plus -ansi -Osize -dual_debug -G --no_exceptions -Wundef -Wimplicit-int -Wshadow -Wtrigraphs -Wall --prototype_errors --incorrect_pragma_warnings -noslashcomment -preprocess_assembly_files -nostartfile --short_enum -c --no_commons -keeptempfiles -list -DAUTOSAR_OS_NOT_USED -DDISABLE_MCAL_INTERMODULE_ASR_CHECK -DGHS
      vendor=Green Hills
      version=Green Hills Multi 7.1.4 / Compiler 2017.1.4
    compiler IAR_Compiler: name=IAR Compiler, options=--cpu=Cortex-M4 --cpu=Cortex-M0+ --cpu_mode=thumb --endian=little -Ohz -c --no_clustering --no_mem_idioms --no_explicit_zero_opt --debug --diag_suppress=Pa050 -DAUTOSAR_OS_NOT_USED -DIAR --require_prototypes --no_wrap_diagnostics --no_system_include -e, vendor=IAR Systems, version=IAR: V8.11.2
    generated-artifacts:
      dependency on artifact Fee_Cfg_h: artifact-descriptor={short-label=generate_PC::include::Fee_Cfg.h, category=SWHDR}, usages=COMPILE
      dependency on artifact Fee_Cfg_c: artifact-descriptor={short-label=generate_PC::src::Fee_Cfg.c, category=SWSRC}, usages=COMPILE
    linker GHS_Linker: name=Green Hills, options=-Mn -delete -v -ignore_debug_references -map -keepmap -lstartup -lsys -larch -lansi -L(/lib/thumb2) -lutf8_s32, vendor=Green Hills, version=Green Hills Multi 7.1.4 / Compiler 2017.1.4
    linker IAR_Linker: name=IAR Compiler, options=--cpu=Cortex-M4 --cpu=Cortex-M0+ --map filename --no_library_search --entry _start --enable_stack_usage --skip_dynamic_initialization --no_wrap_diagnostics --config, vendor=IAR Systems, version=IAR: V8.11.2
    resource consumption ResourceConsumption
      7 x memory section:
        FEE_CODE: alignment=UNSPECIFIED, sw-addrmethod=CODE, symbol=CODE
        FEE_CONST_UNSPECIFIED: alignment=UNSPECIFIED, sw-addrmethod=CONST, symbol=CONST_UNSPECIFIED
        FEE_VAR_INIT_16: alignment=16, sw-addrmethod=VAR_INIT, symbol=VAR_INIT_16
        FEE_VAR_INIT_32: alignment=32, sw-addrmethod=VAR_INIT, symbol=VAR_INIT_32
        FEE_VAR_INIT_8: alignment=8, sw-addrmethod=VAR_INIT, symbol=VAR_INIT_8
        FEE_VAR_INIT_UNSPECIFIED: alignment=UNSPECIFIED, sw-addrmethod=VAR_INIT, symbol=VAR_INIT_UNSPECIFIED
        FEE_VAR_NO_INIT_UNSPECIFIED: alignment=UNSPECIFIED, sw-addrmethod=VAR_NO_INIT, symbol=VAR_NO_INIT_UNSPECIFIED
