AUTOSAR XML (schema 4-0-3)
package /AUTOSAR_I2c/BswModuleDescriptions
  bsw module description I2c: module-id=255
    provided-entrys:
      I2C_AsyncTransmit
      I2C_Deinit
      I2C_GetStatus
      I2C_GetVersionInfo
      I2C_Init
      I2C_SyncTransmit
      I2c_LPI2C_0_MasterIsr
      I2c_LPI2C_0_SlaveIsr
      I2c_LPI2C_1_MasterIsr
      I2c_LPI2C_1_SlaveIsr
      I2c_LPI2C_Isr_LPI2C_0
      I2c_LPI2C_Isr_LPI2C_1
    bsw internal behavior InternalBehavior_0
      4 x exclusive area:
        I2C_EXCLUSIVE_AREA_{00..03}
      6 x bsw called entity:
        I2C_AsyncTransmit: implemented-entry=I2C_AsyncTransmit
        I2C_Deinit: implemented-entry=I2C_Deinit
        I2C_GetStatus: implemented-entry=I2C_GetStatus
        I2C_GetVersionInfo: implemented-entry=I2C_GetVersionInfo
        I2C_Init: implemented-entry=I2C_Init
        I2C_SyncTransmit: implemented-entry=I2C_SyncTransmit
      6 x bsw interrupt entity, all with interrupt-category=CAT-2, interrupt-source=Hardware:
        I2c_LPI2C_0_MasterIsr: implemented-entry=I2c_LPI2C_0_MasterIsr
        I2c_LPI2C_0_SlaveIsr: implemented-entry=I2c_LPI2C_0_SlaveIsr
        I2c_LPI2C_1_MasterIsr: implemented-entry=I2c_LPI2C_1_MasterIsr
        I2c_LPI2C_1_SlaveIsr: implemented-entry=I2c_LPI2C_1_SlaveIsr
        I2c_LPI2C_Isr_LPI2C_0: implemented-entry=I2c_LPI2C_Isr_LPI2C_0
        I2c_LPI2C_Isr_LPI2C_1: implemented-entry=I2c_LPI2C_Isr_LPI2C_1
package /AUTOSAR_I2c/BswModuleEntrys
  6 x bsw module entry, all with service-id=0, is-reentrant=false, is-synchronous=true, call-type=INTERRUPT, execution-context=INTERRUPT-CAT-2, sw-service-impl-policy=STANDARD:
    I2c_LPI2C_0_MasterIsr
    I2c_LPI2C_0_SlaveIsr
    I2c_LPI2C_1_MasterIsr
    I2c_LPI2C_1_SlaveIsr
    I2c_LPI2C_Isr_LPI2C_0
    I2c_LPI2C_Isr_LPI2C_1
package /I2c_T40D2M10I2R0/Implementations
  bsw implementation BswImplementation_0: programming-language=C, sw-version=4.2.2, vendor-id=43, ar-release-version=4.2.2, behavior=InternalBehavior_0, vendor-specific-module-def=I2c
    code-descriptors:
      code Files
        artifact-descriptors:
          short-label=config::I2c.xdm, category=SWCFG
          short-label=doc::AUTOSAR_MCAL_I2C_IM.pdf, category=SWDOC
          short-label=doc::AUTOSAR_MCAL_I2C_UM.pdf, category=SWDOC
          short-label=include::CDD_I2c.h, category=SWHDR
          short-label=include::I2c_FlexIO.h, category=SWHDR
          short-label=include::I2c_FlexIO_Types.h, category=SWHDR
          short-label=include::I2c_Ipw.h, category=SWHDR
          short-label=include::I2c_Ipw_Types.h, category=SWHDR
          short-label=include::I2c_LPI2C.h, category=SWHDR
          short-label=include::I2c_LPI2C_Types.h, category=SWHDR
          short-label=include::I2c_Types.h, category=SWHDR
          short-label=include::Reg_eSys_LPI2C.h, category=SWHDR
          short-label=src::CDD_I2c.c, category=SWSRC
          short-label=src::I2c_FlexIO.c, category=SWSRC
          short-label=src::I2c_Ipw.c, category=SWSRC
          short-label=src::I2c_LPI2C.c, category=SWSRC
          short-label=src::I2c_LPI2C_Irq.c, category=SWSRC
    compiler GHS_Compiler:
      name=Green Hills
      options=-cpu=cortexm4 -cpu=cortexm0plus -ansi -Osize -dual_debug -G --no_exceptions -Wundef -Wimplicit-int -Wshadow -Wtrigraphs -Wall --prototype_errors --incorrect_pragma_warnings -noslashcomment -preprocess_assembly_files -nostartfile --short_enum -c --no_commons -keeptempfiles -list -DAUTOSAR_OS_NOT_USED -DDISABLE_MCAL_INTERMODULE_ASR_CHECK -DGHS
      vendor=Green Hills
      version=Green Hills Multi 7.1.4 / Compiler 2017.1.4
    compiler IAR_Compiler: name=IAR Compiler, options=--cpu=Cortex-M4 --cpu=Cortex-M0+ --cpu_mode=thumb --endian=little -Ohz -c --no_clustering --no_mem_idioms --no_explicit_zero_opt --debug --diag_suppress=Pa050 -DAUTOSAR_OS_NOT_USED -DIAR --require_prototypes --no_wrap_diagnostics --no_system_include -e, vendor=IAR Systems, version=IAR: V8.11.2
    generated-artifacts:
      dependency on artifact CDD_I2c_PBcfg_c: artifact-descriptor={short-label=generate_PB::src::CDD_I2c_PBcfg.c, category=SWSRC}, usages=COMPILE
      dependency on artifact CDD_I2c_Cfg_h: artifact-descriptor={short-label=generate_PC::include::CDD_I2c_Cfg.h, category=SWHDR}, usages=COMPILE
      dependency on artifact CDD_I2c_Cfg_c: artifact-descriptor={short-label=generate_PC::src::CDD_I2c_Cfg.c, category=SWSRC}, usages=COMPILE
    linker GHS_Linker: name=Green Hills, options=-Mn -delete -v -ignore_debug_references -map -keepmap -lstartup -lsys -larch -lansi -L(/lib/thumb2) -lutf8_s32, vendor=Green Hills, version=Green Hills Multi 7.1.4 / Compiler 2017.1.4
    linker IAR_Linker: name=IAR Compiler, options=--cpu=Cortex-M4 --cpu=Cortex-M0+ --map filename --no_library_search --entry _start --enable_stack_usage --skip_dynamic_initialization --no_wrap_diagnostics --config, vendor=IAR Systems, version=IAR: V8.11.2
    resource consumption ResourceConsumption
      9 x memory section:
        I2C_CODE: alignment=UNSPECIFIED, sw-addrmethod=CODE, symbol=CODE
        I2C_CONFIG_DATA_UNSPECIFIED: alignment=UNSPECIFIED, sw-addrmethod=CONFIG_DATA, symbol=CONFIG_DATA_UNSPECIFIED
        I2C_CONST_32: alignment=32, sw-addrmethod=CONST, symbol=CONST_32
        I2C_CONST_UNSPECIFIED: alignment=UNSPECIFIED, sw-addrmethod=CONST, symbol=CONST_UNSPECIFIED
        I2C_VAR_INIT_8: alignment=8, sw-addrmethod=VAR_INIT, symbol=VAR_INIT_8
        I2C_VAR_INIT_UNSPECIFIED: alignment=UNSPECIFIED, sw-addrmethod=VAR_INIT, symbol=VAR_INIT_UNSPECIFIED
        I2C_VAR_NO_INIT_8: alignment=8, sw-addrmethod=VAR_NO_INIT, symbol=VAR_NO_INIT_8
        I2C_VAR_NO_INIT_BOOLEAN: alignment=BOOLEAN, sw-addrmethod=VAR_NO_INIT, symbol=VAR_NO_INIT_BOOLEAN
        I2C_VAR_NO_INIT_UNSPECIFIED: alignment=UNSPECIFIED, sw-addrmethod=VAR_NO_INIT, symbol=VAR_NO_INIT_UNSPECIFIED
