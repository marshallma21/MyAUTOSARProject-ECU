AUTOSAR XML (schema 4-0-3)
package /AUTOSAR_Mcem/BswModuleDescriptions
  bsw module description Mcem: module-id=0
    bsw internal behavior InternalBehavior_0
package /Mcem_T40D2M10I2R0/Implementations
  bsw implementation BswImplementation_0: programming-language=C, sw-version=4.2.2, vendor-id=43, ar-release-version=4.2.2, behavior=InternalBehavior_0, vendor-specific-module-def=Mcem
    code-descriptors:
      code Files
        artifact-descriptors:
          short-label=config::Mcem.xdm, category=SWCFG
          short-label=doc::AUTOSAR_MCAL_MCEM_IM.pdf, category=SWDOC
          short-label=doc::AUTOSAR_MCAL_MCEM_UM.pdf, category=SWDOC
          short-label=include::CDD_Mcem.h, category=SWHDR
          short-label=include::CDD_Mcem_IrqHandler.h, category=SWHDR
          short-label=include::CDD_Mcem_Types.h, category=SWHDR
          short-label=include::Mcem.h, category=SWHDR
          short-label=include::Mcem_Eirm.h, category=SWHDR
          short-label=include::Mcem_Eirm_Types.h, category=SWHDR
          short-label=include::Mcem_IPW.h, category=SWHDR
          short-label=include::Mcem_IPW_Types.h, category=SWHDR
          short-label=include::Reg_eSys_Eirm.h, category=SWHDR
          short-label=src::CDD_Mcem.c, category=SWSRC
          short-label=src::Mcem_Eirm.c, category=SWSRC
          short-label=src::Mcem_Eirm_Irq.c, category=SWSRC
          short-label=src::Mcem_IPW.c, category=SWSRC
    compiler GHS_Compiler:
      name=Green Hills
      options=-cpu=cortexm4 -cpu=cortexm0plus -ansi -Osize -dual_debug -G --no_exceptions -Wundef -Wimplicit-int -Wshadow -Wtrigraphs -Wall --prototype_errors --incorrect_pragma_warnings -noslashcomment -preprocess_assembly_files -nostartfile --short_enum -c --no_commons -keeptempfiles -list -DAUTOSAR_OS_NOT_USED -DDISABLE_MCAL_INTERMODULE_ASR_CHECK -DGHS
      vendor=Green Hills
      version=Green Hills Multi 7.1.4 / Compiler 2017.1.4
    compiler IAR_Compiler: name=IAR Compiler, options=--cpu=Cortex-M4 --cpu=Cortex-M0+ --cpu_mode=thumb --endian=little -Ohz -c --no_clustering --no_mem_idioms --no_explicit_zero_opt --debug --diag_suppress=Pa050 -DAUTOSAR_OS_NOT_USED -DIAR --require_prototypes --no_wrap_diagnostics --no_system_include -e, vendor=IAR Systems, version=IAR: V8.11.2
    generated-artifacts:
      dependency on artifact CDD_Mcem_PBcfg_c: artifact-descriptor={short-label=generate_PB::src::CDD_Mcem_PBcfg.c, category=SWSRC}, usages=COMPILE
      dependency on artifact CDD_Mcem_Cfg_h: artifact-descriptor={short-label=generate_PC::include::CDD_Mcem_Cfg.h, category=SWHDR}, usages=COMPILE
      dependency on artifact CDD_Mcem_Cfg_c: artifact-descriptor={short-label=generate_PC::src::CDD_Mcem_Cfg.c, category=SWSRC}, usages=COMPILE
    linker GHS_Linker: name=Green Hills, options=-Mn -delete -v -ignore_debug_references -map -keepmap -lstartup -lsys -larch -lansi -L(/lib/thumb2) -lutf8_s32, vendor=Green Hills, version=Green Hills Multi 7.1.4 / Compiler 2017.1.4
    linker IAR_Linker: name=IAR Compiler, options=--cpu=Cortex-M4 --cpu=Cortex-M0+ --map filename --no_library_search --entry _start --enable_stack_usage --skip_dynamic_initialization --no_wrap_diagnostics --config, vendor=IAR Systems, version=IAR: V8.11.2
    resource consumption ResourceConsumption
      5 x memory section:
        MCEM_CODE: alignment=UNSPECIFIED, sw-addrmethod=CODE, symbol=CODE
        MCEM_CONFIG_DATA_UNSPECIFIED: alignment=UNSPECIFIED, sw-addrmethod=CONFIG_DATA, symbol=CONFIG_DATA_UNSPECIFIED
        MCEM_CONST_UNSPECIFIED: alignment=UNSPECIFIED, sw-addrmethod=CONST, symbol=CONST_UNSPECIFIED
        MCEM_VAR_INIT_UNSPECIFIED: alignment=UNSPECIFIED, sw-addrmethod=VAR_INIT, symbol=VAR_INIT_UNSPECIFIED
        MCEM_VAR_NO_INIT_32: alignment=32, sw-addrmethod=VAR_NO_INIT, symbol=VAR_NO_INIT_32
