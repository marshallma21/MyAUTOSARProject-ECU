AUTOSAR XML (schema 4-0-3)
package /AUTOSAR_Can/BswModuleDescriptions
  bsw module description Can: module-id=80
    provided-entrys:
      Can_AbortMb
      Can_ChangeBaudrate
      Can_CheckBaudrate
      Can_CheckWakeup
      Can_DisableControllerInterrupts
      Can_DummyRead
      Can_EnableControllerInterrupts
      Can_GetVersionInfo
      Can_Init
      Can_MainFunction_BusOff
      Can_MainFunction_CheckMRAF
      Can_MainFunction_Mode
      Can_MainFunction_Read
      Can_MainFunction_Read_0
      Can_MainFunction_Read_1
      Can_MainFunction_Read_10
      Can_MainFunction_Read_{2..9}
      Can_MainFunction_Wakeup
      Can_MainFunction_Write
      Can_MainFunction_Write_0
      Can_MainFunction_Write_1
      Can_MainFunction_Write_10
      Can_MainFunction_Write_{2..9}
      Can_SetClockMode
      Can_SetControllerMode
      Can_Write
    bsw internal behavior InternalBehavior_0
      12 x exclusive area:
        CAN_EXCLUSIVE_AREA_{00..09}
        CAN_EXCLUSIVE_AREA_11
        CAN_EXCLUSIVE_AREA_13
      40 x bsw called entity:
        Can_AbortMb: implemented-entry=Can_AbortMb
        Can_ChangeBaudrate: implemented-entry=Can_ChangeBaudrate
        Can_CheckBaudrate: implemented-entry=Can_CheckBaudrate
        Can_CheckWakeup: implemented-entry=Can_CheckWakeup
        Can_DisableControllerInterrupts: implemented-entry=Can_DisableControllerInterrupts
        Can_DummyRead: implemented-entry=Can_DummyRead
        Can_EnableControllerInterrupts: implemented-entry=Can_EnableControllerInterrupts
        Can_GetVersionInfo: implemented-entry=Can_GetVersionInfo
        Can_Init: can-enter-exclusive-area=[CAN_EXCLUSIVE_AREA_00, CAN_EXCLUSIVE_AREA_01, CAN_EXCLUSIVE_AREA_02, CAN_EXCLUSIVE_AREA_03, CAN_EXCLUSIVE_AREA_04, CAN_EXCLUSIVE_AREA_05, CAN_EXCLUSIVE_AREA_06, CAN_EXCLUSIVE_AREA_07, CAN_EXCLUSIVE_AREA_08, CAN_EXCLUSIVE_AREA_09, CAN_EXCLUSIVE_AREA_11, CAN_EXCLUSIVE_AREA_13], implemented-entry=Can_Init
        Can_MainFunction_BusOff: implemented-entry=Can_MainFunction_BusOff
        Can_MainFunction_CheckMRAF: implemented-entry=Can_MainFunction_CheckMRAF
        Can_MainFunction_Mode: implemented-entry=Can_MainFunction_Mode
        Can_MainFunction_Read: implemented-entry=Can_MainFunction_Read
        Can_MainFunction_Read_0: implemented-entry=Can_MainFunction_Read_0
        Can_MainFunction_Read_1: implemented-entry=Can_MainFunction_Read_1
        Can_MainFunction_Read_10: implemented-entry=Can_MainFunction_Read_10
        Can_MainFunction_Read_{2..9}: implemented-entry=Can_MainFunction_Read_{2..9}
        Can_MainFunction_Wakeup: implemented-entry=Can_MainFunction_Wakeup
        Can_MainFunction_Write: implemented-entry=Can_MainFunction_Write
        Can_MainFunction_Write_0: implemented-entry=Can_MainFunction_Write_0
        Can_MainFunction_Write_1: implemented-entry=Can_MainFunction_Write_1
        Can_MainFunction_Write_10: implemented-entry=Can_MainFunction_Write_10
        Can_MainFunction_Write_{2..9}: implemented-entry=Can_MainFunction_Write_{2..9}
        Can_SetClockMode: implemented-entry=Can_SetClockMode
        Can_SetControllerMode: implemented-entry=Can_SetControllerMode
        Can_Write: implemented-entry=Can_Write
      6 x bsw timing event:
        CanBusOffTimingEvent_MainFunction: starts-on-event=Can_MainFunction_BusOff, period=0.001
        CanCheckMRAFTimingEvent_MainFunction: starts-on-event=Can_MainFunction_CheckMRAF, period=0.001
        CanModeTimingEvent_MainFunction: starts-on-event=Can_MainFunction_Mode, period=0.001
        CanReadTimingEvent_MainFunction: starts-on-event=Can_MainFunction_Read, period=0.001
        CanWakeupTimingEvent_MainFunction: starts-on-event=Can_MainFunction_Wakeup, period=0.0010
        CanWriteTimingEvent_MainFunction: starts-on-event=Can_MainFunction_Write, period=0.001
package /Can_T40D2M10I2R0/Implementations
  bsw implementation BswImplementation_0: programming-language=C, sw-version=4.2.2, vendor-id=43, ar-release-version=4.2.2, behavior=InternalBehavior_0, vendor-specific-module-def=Can
    code-descriptors:
      code Files
        artifact-descriptors:
          short-label=config::Can.xdm, category=SWCFG
          short-label=doc::AUTOSAR_MCAL_CAN_IM.pdf, category=SWDOC
          short-label=doc::AUTOSAR_MCAL_CAN_UM.pdf, category=SWDOC
          short-label=include::Can.h, category=SWHDR
          short-label=include::Can_Flexcan.h, category=SWHDR
          short-label=include::Can_IPW.h, category=SWHDR
          short-label=include::Reg_eSys_FlexCan.h, category=SWHDR
          short-label=src::Can.c, category=SWSRC
          short-label=src::Can_Flexcan.c, category=SWSRC
          short-label=src::Can_Irq.c, category=SWSRC
    compiler GHS_Compiler:
      name=Green Hills
      options=-cpu=cortexm4 -cpu=cortexm0plus -ansi -Osize -dual_debug -G --no_exceptions -Wundef -Wimplicit-int -Wshadow -Wtrigraphs -Wall --prototype_errors --incorrect_pragma_warnings -noslashcomment -preprocess_assembly_files -nostartfile --short_enum -c --no_commons -keeptempfiles -list -DAUTOSAR_OS_NOT_USED -DDISABLE_MCAL_INTERMODULE_ASR_CHECK -DGHS
      vendor=Green Hills
      version=Green Hills Multi 7.1.4 / Compiler 2017.1.4
    compiler IAR_Compiler: name=IAR Compiler, options=--cpu=Cortex-M4 --cpu=Cortex-M0+ --cpu_mode=thumb --endian=little -Ohz -c --no_clustering --no_mem_idioms --no_explicit_zero_opt --debug --diag_suppress=Pa050 -DAUTOSAR_OS_NOT_USED -DIAR --require_prototypes --no_wrap_diagnostics --no_system_include -e, vendor=IAR Systems, version=IAR: V8.11.2
    generated-artifacts:
      dependency on artifact Can_PBcfg_c: artifact-descriptor={short-label=generate_PB::src::Can_PBcfg.c, category=SWSRC}, usages=COMPILE
      dependency on artifact Can_Cfg_h: artifact-descriptor={short-label=generate_PC::include::Can_Cfg.h, category=SWHDR}, usages=COMPILE
      dependency on artifact Can_Cfg_c: artifact-descriptor={short-label=generate_PC::src::Can_Cfg.c, category=SWSRC}, usages=COMPILE
    linker GHS_Linker: name=Green Hills, options=-Mn -delete -v -ignore_debug_references -map -keepmap -lstartup -lsys -larch -lansi -L(/lib/thumb2) -lutf8_s32, vendor=Green Hills, version=Green Hills Multi 7.1.4 / Compiler 2017.1.4
    linker IAR_Linker: name=IAR Compiler, options=--cpu=Cortex-M4 --cpu=Cortex-M0+ --map filename --no_library_search --entry _start --enable_stack_usage --skip_dynamic_initialization --no_wrap_diagnostics --config, vendor=IAR Systems, version=IAR: V8.11.2
    resource consumption ResourceConsumption
      5 x memory section, all with alignment=UNSPECIFIED:
        CAN_CODE: sw-addrmethod=CODE, symbol=CODE
        CAN_CONFIG_DATA_UNSPECIFIED: sw-addrmethod=CONFIG_DATA, symbol=CONFIG_DATA_UNSPECIFIED
        CAN_CONST_UNSPECIFIED: sw-addrmethod=CONST, symbol=CONST_UNSPECIFIED
        CAN_VAR_INIT_UNSPECIFIED: sw-addrmethod=VAR_INIT, symbol=VAR_INIT_UNSPECIFIED
        CAN_VAR_NO_INIT_UNSPECIFIED: sw-addrmethod=VAR_NO_INIT, symbol=VAR_NO_INIT_UNSPECIFIED
