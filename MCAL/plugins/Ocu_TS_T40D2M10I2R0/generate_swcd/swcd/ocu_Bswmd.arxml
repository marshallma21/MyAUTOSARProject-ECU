AUTOSAR XML (schema 4-0-3)
package /AUTOSAR_Ocu/BswModuleDescriptions
  bsw module description Ocu: module-id=125
    provided-entrys:
      Ocu_DeInit
      Ocu_DisableNotification
      Ocu_EnableNotification
      Ocu_GetCounter
      Ocu_GetVersionInfo
      Ocu_Init
      Ocu_SetPinAction
      Ocu_SetPinState
      Ocu_StartChannel
      Ocu_StopChannel
      Ocu_SetAbsoluteThreshold
      Ocu_SetRelativeThreshold
    bsw internal behavior InternalBehavior_0
      8 x exclusive area:
        OCU_EXCLUSIVE_AREA_{08..15}
      12 x bsw called entity:
        Ocu_DeInit: implemented-entry=Ocu_DeInit
        Ocu_DisableNotification: implemented-entry=Ocu_DisableNotification
        Ocu_EnableNotification: implemented-entry=Ocu_EnableNotification
        Ocu_GetCounter: implemented-entry=Ocu_GetCounter
        Ocu_GetVersionInfo: implemented-entry=Ocu_GetVersionInfo
        Ocu_Init: can-enter-exclusive-area=[OCU_EXCLUSIVE_AREA_08, OCU_EXCLUSIVE_AREA_09, OCU_EXCLUSIVE_AREA_10, OCU_EXCLUSIVE_AREA_11, OCU_EXCLUSIVE_AREA_12, OCU_EXCLUSIVE_AREA_13, OCU_EXCLUSIVE_AREA_14, OCU_EXCLUSIVE_AREA_15], implemented-entry=Ocu_Init
        Ocu_SetPinAction: implemented-entry=Ocu_SetPinAction
        Ocu_SetPinState: implemented-entry=Ocu_SetPinState
        Ocu_StartChannel: implemented-entry=Ocu_StartChannel
        Ocu_StopChannel: implemented-entry=Ocu_StopChannel
        Ocu_SetAbsoluteThreshold: implemented-entry=Ocu_SetAbsoluteThreshold
        Ocu_SetRelativeThreshold: implemented-entry=Ocu_SetRelativeThreshold
package /Ocu_T40D2M10I2R0/Implementations
  bsw implementation BswImplementation_0: programming-language=C, sw-version=4.2.2, vendor-id=43, ar-release-version=4.2.2, behavior=InternalBehavior_0, vendor-specific-module-def=Ocu
    code-descriptors:
      code Files
        artifact-descriptors:
          short-label=config::Ocu.xdm, category=SWCFG
          short-label=doc::AUTOSAR_MCAL_OCU_IM.pdf, category=SWDOC
          short-label=doc::AUTOSAR_MCAL_OCU_UM.pdf, category=SWDOC
          short-label=include::Ocu.h, category=SWHDR
          short-label=include::Ocu_EnvCfg.h, category=SWHDR
          short-label=include::Ocu_Ftm.h, category=SWHDR
          short-label=include::Ocu_Ftm_Irq.h, category=SWHDR
          short-label=include::Ocu_Ftm_Types.h, category=SWHDR
          short-label=include::Ocu_Ipw.h, category=SWHDR
          short-label=include::Ocu_Ipw_Irq.h, category=SWHDR
          short-label=include::Ocu_Ipw_Types.h, category=SWHDR
          short-label=include::Ocu_Irq.h, category=SWHDR
          short-label=include::Ocu_Types.h, category=SWHDR
          short-label=src::Ocu.c, category=SWSRC
          short-label=src::Ocu_Ftm.c, category=SWSRC
          short-label=src::Ocu_Ipw.c, category=SWSRC
    compiler IAR_Compiler: name=IAR Compiler, options=--cpu=Cortex-M4 --cpu=Cortex-M0+ --cpu_mode=thumb --endian=little -Ohz -c --no_clustering --no_mem_idioms --no_explicit_zero_opt --debug --diag_suppress=Pa050 -DAUTOSAR_OS_NOT_USED -DIAR --require_prototypes --no_wrap_diagnostics --no_system_include -e, vendor=IAR Systems, version=IAR: V8.11.2
    compiler GHS_Compiler:
      name=Green Hills
      options=-cpu=cortexm4 -cpu=cortexm0plus -ansi -Osize -dual_debug -G --no_exceptions -Wundef -Wimplicit-int -Wshadow -Wtrigraphs -Wall --prototype_errors --incorrect_pragma_warnings -noslashcomment -preprocess_assembly_files -nostartfile --short_enum -c --no_commons -keeptempfiles -list -DAUTOSAR_OS_NOT_USED -DDISABLE_MCAL_INTERMODULE_ASR_CHECK -DGHS
      vendor=Green Hills
      version=Green Hills Multi 7.1.4 / Compiler 2017.1.4
    generated-artifacts:
      dependency on artifact Ocu_PBcfg_c: artifact-descriptor={short-label=generate_PB::src::Ocu_PBcfg.c, category=SWSRC}, usages=COMPILE
      dependency on artifact Ocu_Cfg_h: artifact-descriptor={short-label=generate_PC::include::Ocu_Cfg.h, category=SWHDR}, usages=COMPILE
    linker IAR_Linker: name=IAR Compiler, options=--cpu=Cortex-M4 --cpu=Cortex-M0+ --map filename --no_library_search --entry _start --enable_stack_usage --skip_dynamic_initialization --no_wrap_diagnostics --config, vendor=IAR Systems, version=IAR: V8.11.2
    linker GHS_Linker: name=Green Hills, options=-Mn -delete -v -ignore_debug_references -map -keepmap -lstartup -lsys -larch -lansi -L(/lib/thumb2) -lutf8_s32, vendor=Green Hills, version=Green Hills Multi 7.1.4 / Compiler 2017.1.4
    resource consumption ResourceConsumption
      6 x memory section:
        OCU_CODE: alignment=UNSPECIFIED, sw-addrmethod=CODE, symbol=CODE
        OCU_CONFIG_DATA_UNSPECIFIED: alignment=UNSPECIFIED, sw-addrmethod=CONFIG_DATA, symbol=CONFIG_DATA_UNSPECIFIED
        OCU_VAR_INIT_UNSPECIFIED: alignment=UNSPECIFIED, sw-addrmethod=VAR_INIT, symbol=VAR_INIT_UNSPECIFIED
        OCU_VAR_NO_INIT_8: alignment=8, sw-addrmethod=VAR_NO_INIT, symbol=VAR_NO_INIT_8
        OCU_VAR_NO_INIT_BOOLEAN: alignment=BOOLEAN, sw-addrmethod=VAR_NO_INIT, symbol=VAR_NO_INIT_BOOLEAN
        OCU_VAR_NO_INIT_UNSPECIFIED: alignment=UNSPECIFIED, sw-addrmethod=VAR_NO_INIT, symbol=VAR_NO_INIT_UNSPECIFIED
