AUTOSAR XML (schema 4-0-3)
package /AUTOSAR_Lin/BswModuleDescriptions
  bsw module description Lin: module-id=82
    provided-entrys:
      Lin_CheckWakeup
      Lin_GetStatus
      Lin_GetVersionInfo
      Lin_GoToSleep
      Lin_GoToSleepInternal
      Lin_Init
      Lin_SendFrame
      Lin_Wakeup
      Lin_WakeupInternal
      Lin_LPUART_Isr_LPUART_{0..3}
      Lin_LPUART_IsrError_LPUART_{0..3}
      Lin_LPUART_IsrTxRx_LPUART_{0..3}
    bsw internal behavior InternalBehavior_0
      38 x exclusive area:
        LIN_EXCLUSIVE_AREA_{00..25}
        LIN_EXCLUSIVE_AREA_27
        LIN_EXCLUSIVE_AREA_{32..42}
      9 x bsw called entity:
        Lin_CheckWakeup: implemented-entry=Lin_CheckWakeup
        Lin_GetStatus: implemented-entry=Lin_GetStatus
        Lin_GetVersionInfo: implemented-entry=Lin_GetVersionInfo
        Lin_GoToSleep: implemented-entry=Lin_GoToSleep
        Lin_GoToSleepInternal: implemented-entry=Lin_GoToSleepInternal
        Lin_Init: can-enter-exclusive-area=[LIN_EXCLUSIVE_AREA_00, LIN_EXCLUSIVE_AREA_01, LIN_EXCLUSIVE_AREA_02, LIN_EXCLUSIVE_AREA_03, LIN_EXCLUSIVE_AREA_04, LIN_EXCLUSIVE_AREA_05, LIN_EXCLUSIVE_AREA_06, LIN_EXCLUSIVE_AREA_07, LIN_EXCLUSIVE_AREA_08, LIN_EXCLUSIVE_AREA_09, LIN_EXCLUSIVE_AREA_10, LIN_EXCLUSIVE_AREA_11, LIN_EXCLUSIVE_AREA_12, LIN_EXCLUSIVE_AREA_13, LIN_EXCLUSIVE_AREA_14, LIN_EXCLUSIVE_AREA_15, LIN_EXCLUSIVE_AREA_16, LIN_EXCLUSIVE_AREA_17, LIN_EXCLUSIVE_AREA_18, LIN_EXCLUSIVE_AREA_19, LIN_EXCLUSIVE_AREA_20, LIN_EXCLUSIVE_AREA_21, LIN_EXCLUSIVE_AREA_22, LIN_EXCLUSIVE_AREA_23, LIN_EXCLUSIVE_AREA_24, LIN_EXCLUSIVE_AREA_25, LIN_EXCLUSIVE_AREA_27, LIN_EXCLUSIVE_AREA_32, LIN_EXCLUSIVE_AREA_33, LIN_EXCLUSIVE_AREA_34, LIN_EXCLUSIVE_AREA_35, LIN_EXCLUSIVE_AREA_36, LIN_EXCLUSIVE_AREA_37, LIN_EXCLUSIVE_AREA_38, LIN_EXCLUSIVE_AREA_39, LIN_EXCLUSIVE_AREA_40, LIN_EXCLUSIVE_AREA_41, LIN_EXCLUSIVE_AREA_42], implemented-entry=Lin_Init
        Lin_SendFrame: implemented-entry=Lin_SendFrame
        Lin_Wakeup: implemented-entry=Lin_Wakeup
        Lin_WakeupInternal: implemented-entry=Lin_WakeupInternal
      12 x bsw interrupt entity, all with interrupt-category=CAT-2, interrupt-source=Hardware:
        Lin_LPUART_Isr_LPUART_{0..3}: implemented-entry=Lin_LPUART_Isr_LPUART_{0..3}
        Lin_LPUART_IsrError_LPUART_{0..3}: implemented-entry=Lin_LPUART_IsrError_LPUART_{0..3}
        Lin_LPUART_IsrTxRx_LPUART_{0..3}: implemented-entry=Lin_LPUART_IsrTxRx_LPUART_{0..3}
package /AUTOSAR_Lin/BswModuleEntrys
  12 x bsw module entry, all with service-id=0, is-reentrant=false, is-synchronous=true, call-type=INTERRUPT, execution-context=INTERRUPT-CAT-2, sw-service-impl-policy=STANDARD:
    Lin_LPUART_Isr_LPUART_{0..3}
    Lin_LPUART_IsrError_LPUART_{0..3}
    Lin_LPUART_IsrTxRx_LPUART_{0..3}
package /Lin_T40D2M10I2R0/Implementations
  bsw implementation BswImplementation_0: programming-language=C, sw-version=4.2.2, vendor-id=43, ar-release-version=4.2.2, behavior=InternalBehavior_0, vendor-specific-module-def=Lin
    code-descriptors:
      code Files
        artifact-descriptors:
          short-label=config::Lin.xdm, category=SWCFG
          short-label=doc::AUTOSAR_MCAL_LIN_IM.pdf, category=SWDOC
          short-label=doc::AUTOSAR_MCAL_LIN_UM.pdf, category=SWDOC
          short-label=include::Lin.h, category=SWHDR
          short-label=include::Lin_FlexIO.h, category=SWHDR
          short-label=include::Lin_IPW.h, category=SWHDR
          short-label=include::Lin_LPUART.h, category=SWHDR
          short-label=include::Lin_NonASR.h, category=SWHDR
          short-label=include::Reg_eSys_LPUART.h, category=SWHDR
          short-label=src::Lin.c, category=SWSRC
          short-label=src::Lin_FlexIO.c, category=SWSRC
          short-label=src::Lin_IPW.c, category=SWSRC
          short-label=src::Lin_LPUART.c, category=SWSRC
          short-label=src::Lin_LPUART_Irq.c, category=SWSRC
          short-label=src::Lin_NonASR.c, category=SWSRC
    compiler GHS_Compiler:
      name=Green Hills
      options=-cpu=cortexm4 -cpu=cortexm0plus -ansi -Osize -dual_debug -G --no_exceptions -Wundef -Wimplicit-int -Wshadow -Wtrigraphs -Wall --prototype_errors --incorrect_pragma_warnings -noslashcomment -preprocess_assembly_files -nostartfile --short_enum -c --no_commons -keeptempfiles -list -DAUTOSAR_OS_NOT_USED -DDISABLE_MCAL_INTERMODULE_ASR_CHECK -DGHS
      vendor=Green Hills
      version=Green Hills Multi 7.1.4 / Compiler 2017.1.4
    compiler IAR_Compiler: name=IAR Compiler, options=--cpu=Cortex-M4 --cpu=Cortex-M0+ --cpu_mode=thumb --endian=little -Ohz -c --no_clustering --no_mem_idioms --no_explicit_zero_opt --debug --diag_suppress=Pa050 -DAUTOSAR_OS_NOT_USED -DIAR --require_prototypes --no_wrap_diagnostics --no_system_include -e, vendor=IAR Systems, version=IAR: V8.11.2
    generated-artifacts:
      dependency on artifact Lin_PBcfg_c: artifact-descriptor={short-label=generate_PB::src::Lin_PBcfg.c, category=SWSRC}, usages=COMPILE
      dependency on artifact Lin_Cfg_h: artifact-descriptor={short-label=generate_PC::include::Lin_Cfg.h, category=SWHDR}, usages=COMPILE
      dependency on artifact Lin_Cfg_c: artifact-descriptor={short-label=generate_PC::src::Lin_Cfg.c, category=SWSRC}, usages=COMPILE
    linker GHS_Linker: name=Green Hills, options=-Mn -delete -v -ignore_debug_references -map -keepmap -lstartup -lsys -larch -lansi -L(/lib/thumb2) -lutf8_s32, vendor=Green Hills, version=Green Hills Multi 7.1.4 / Compiler 2017.1.4
    linker IAR_Linker: name=IAR Compiler, options=--cpu=Cortex-M4 --cpu=Cortex-M0+ --map filename --no_library_search --entry _start --enable_stack_usage --skip_dynamic_initialization --no_wrap_diagnostics --config, vendor=IAR Systems, version=IAR: V8.11.2
    resource consumption ResourceConsumption
      8 x memory section:
        LIN_CODE: alignment=UNSPECIFIED, sw-addrmethod=CODE, symbol=CODE
        LIN_CONFIG_DATA_UNSPECIFIED: alignment=UNSPECIFIED, sw-addrmethod=CONFIG_DATA, symbol=CONFIG_DATA_UNSPECIFIED
        LIN_CONST_32: alignment=32, sw-addrmethod=CONST, symbol=CONST_32
        LIN_CONST_UNSPECIFIED: alignment=UNSPECIFIED, sw-addrmethod=CONST, symbol=CONST_UNSPECIFIED
        LIN_VAR_INIT_8: alignment=8, sw-addrmethod=VAR_INIT, symbol=VAR_INIT_8
        LIN_VAR_INIT_UNSPECIFIED: alignment=UNSPECIFIED, sw-addrmethod=VAR_INIT, symbol=VAR_INIT_UNSPECIFIED
        LIN_VAR_NO_INIT_8: alignment=8, sw-addrmethod=VAR_NO_INIT, symbol=VAR_NO_INIT_8
        LIN_VAR_NO_INIT_UNSPECIFIED: alignment=UNSPECIFIED, sw-addrmethod=VAR_NO_INIT, symbol=VAR_NO_INIT_UNSPECIFIED
