AUTOSAR XML (schema 4-0-3)
package /AUTOSAR_Dio/BswModuleDescriptions
  bsw module description Dio: module-id=120
    provided-entrys:
      Dio_FlipChannel
      Dio_GetVersionInfo
      Dio_MaskedWritePort
      Dio_ReadChannel
      Dio_ReadChannelGroup
      Dio_ReadPort
      Dio_ValidateChannelForRead
      Dio_ValidateChannelForWrite
      Dio_ValidateChannelGroupForRead
      Dio_ValidateChannelGroupForWrite
      Dio_ValidateChannelLevel
      Dio_ValidatePortForRead
      Dio_ValidatePortForWrite
      Dio_WriteChannel
      Dio_WriteChannelGroup
      Dio_WritePort
      Dio_Init
    bsw internal behavior InternalBehavior_0
      17 x bsw called entity:
        Dio_FlipChannel: implemented-entry=Dio_FlipChannel
        Dio_GetVersionInfo: implemented-entry=Dio_GetVersionInfo
        Dio_MaskedWritePort: implemented-entry=Dio_MaskedWritePort
        Dio_ReadChannel: implemented-entry=Dio_ReadChannel
        Dio_ReadChannelGroup: implemented-entry=Dio_ReadChannelGroup
        Dio_ReadPort: implemented-entry=Dio_ReadPort
        Dio_ValidateChannelForRead: implemented-entry=Dio_ValidateChannelForRead
        Dio_ValidateChannelForWrite: implemented-entry=Dio_ValidateChannelForWrite
        Dio_ValidateChannelGroupForRead: implemented-entry=Dio_ValidateChannelGroupForRead
        Dio_ValidateChannelGroupForWrite: implemented-entry=Dio_ValidateChannelGroupForWrite
        Dio_ValidateChannelLevel: implemented-entry=Dio_ValidateChannelLevel
        Dio_ValidatePortForRead: implemented-entry=Dio_ValidatePortForRead
        Dio_ValidatePortForWrite: implemented-entry=Dio_ValidatePortForWrite
        Dio_WriteChannel: implemented-entry=Dio_WriteChannel
        Dio_WriteChannelGroup: implemented-entry=Dio_WriteChannelGroup
        Dio_WritePort: implemented-entry=Dio_WritePort
        Dio_Init: implemented-entry=Dio_Init
package /Dio_T40D2M10I2R0/Implementations
  bsw implementation BswImplementation_0: programming-language=C, sw-version=4.2.2, vendor-id=43, ar-release-version=4.2.2, behavior=InternalBehavior_0, vendor-specific-module-def=Dio
    code-descriptors:
      code Files
        artifact-descriptors:
          short-label=config::Dio.xdm, category=SWCFG
          short-label=doc::AUTOSAR_MCAL_DIO_IM.pdf, category=SWDOC
          short-label=doc::AUTOSAR_MCAL_DIO_UM.pdf, category=SWDOC
          short-label=include::Dio.h, category=SWHDR
          short-label=include::Dio_EnvCfg.h, category=SWHDR
          short-label=include::Dio_Gpio.h, category=SWHDR
          short-label=include::Dio_Ipw.h, category=SWHDR
          short-label=include::Reg_eSys_Gpio.h, category=SWHDR
          short-label=src::Dio.c, category=SWSRC
          short-label=src::Dio_Gpio.c, category=SWSRC
    compiler GHS_Compiler:
      name=Green Hills
      options=-cpu=cortexm4 -cpu=cortexm0plus -ansi -Osize -dual_debug -G --no_exceptions -Wundef -Wimplicit-int -Wshadow -Wtrigraphs -Wall --prototype_errors --incorrect_pragma_warnings -noslashcomment -preprocess_assembly_files -nostartfile --short_enum -c --no_commons -keeptempfiles -list -DAUTOSAR_OS_NOT_USED -DDISABLE_MCAL_INTERMODULE_ASR_CHECK -DGHS
      vendor=Green Hills
      version=Green Hills Multi 7.1.4 / Compiler 2017.1.4
    compiler IAR_Compiler: name=IAR Compiler, options=--cpu=Cortex-M4 --cpu=Cortex-M0+ --cpu_mode=thumb --endian=little -Ohz -c --no_clustering --no_mem_idioms --no_explicit_zero_opt --debug --diag_suppress=Pa050 -DAUTOSAR_OS_NOT_USED -DIAR --require_prototypes --no_wrap_diagnostics --no_system_include -e, vendor=IAR Systems, version=IAR: V8.11.2
    generated-artifacts:
      dependency on artifact Dio_Cfg_h: artifact-descriptor={short-label=generate_PC::include::Dio_Cfg.h, category=SWHDR}, usages=COMPILE
      dependency on artifact Dio_Cfg_c: artifact-descriptor={short-label=generate_PC::src::Dio_Cfg.c, category=SWSRC}, usages=COMPILE
    linker GHS_Linker: name=Green Hills, options=-Mn -delete -v -ignore_debug_references -map -keepmap -lstartup -lsys -larch -lansi -L(/lib/thumb2) -lutf8_s32, vendor=Green Hills, version=Green Hills Multi 7.1.4 / Compiler 2017.1.4
    linker IAR_Linker: name=IAR Compiler, options=--cpu=Cortex-M4 --cpu=Cortex-M0+ --map filename --no_library_search --entry _start --enable_stack_usage --skip_dynamic_initialization --no_wrap_diagnostics --config, vendor=IAR Systems, version=IAR: V8.11.2
    resource consumption ResourceConsumption
      memory section DIO_CODE: alignment=UNSPECIFIED, sw-addrmethod=CODE, symbol=CODE
      memory section DIO_CONFIG_DATA_UNSPECIFIED: alignment=UNSPECIFIED, sw-addrmethod=CONFIG_DATA, symbol=CONFIG_DATA_UNSPECIFIED
