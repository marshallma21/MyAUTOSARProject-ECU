AUTOSAR XML (schema 4-0-3)
package /AUTOSAR_Pwm/BswModuleDescriptions
  bsw module description Pwm: module-id=121
    provided-entrys:
      Pwm_DeInit
      Pwm_DisableNotification
      Pwm_DisableReloadNotification
      Pwm_EnableNotification
      Pwm_EnableReloadNotification
      Pwm_ForceOutputToZero
      Pwm_GetChannelState
      Pwm_GetOutputState
      Pwm_GetVersionInfo
      Pwm_Init
      Pwm_SetDutyCycle
      Pwm_SetOutputToIdle
      Pwm_SetPeriodAndDuty
    bsw internal behavior InternalBehavior_0
      18 x exclusive area:
        PWM_EXCLUSIVE_AREA_{00..12}
        PWM_EXCLUSIVE_AREA_{47..51}
      13 x bsw called entity:
        Pwm_DeInit: implemented-entry=Pwm_DeInit
        Pwm_DisableNotification: implemented-entry=Pwm_DisableNotification
        Pwm_DisableReloadNotification: implemented-entry=Pwm_DisableReloadNotification
        Pwm_EnableNotification: implemented-entry=Pwm_EnableNotification
        Pwm_EnableReloadNotification: implemented-entry=Pwm_EnableReloadNotification
        Pwm_ForceOutputToZero: implemented-entry=Pwm_ForceOutputToZero
        Pwm_GetChannelState: implemented-entry=Pwm_GetChannelState
        Pwm_GetOutputState: implemented-entry=Pwm_GetOutputState
        Pwm_GetVersionInfo: implemented-entry=Pwm_GetVersionInfo
        Pwm_Init: can-enter-exclusive-area=[PWM_EXCLUSIVE_AREA_00, PWM_EXCLUSIVE_AREA_01, PWM_EXCLUSIVE_AREA_02, PWM_EXCLUSIVE_AREA_03, PWM_EXCLUSIVE_AREA_04, PWM_EXCLUSIVE_AREA_05, PWM_EXCLUSIVE_AREA_06, PWM_EXCLUSIVE_AREA_07, PWM_EXCLUSIVE_AREA_08, PWM_EXCLUSIVE_AREA_09, PWM_EXCLUSIVE_AREA_10, PWM_EXCLUSIVE_AREA_11, PWM_EXCLUSIVE_AREA_12, PWM_EXCLUSIVE_AREA_47, PWM_EXCLUSIVE_AREA_48, PWM_EXCLUSIVE_AREA_49, PWM_EXCLUSIVE_AREA_50, PWM_EXCLUSIVE_AREA_51], implemented-entry=Pwm_Init
        Pwm_SetDutyCycle: implemented-entry=Pwm_SetDutyCycle
        Pwm_SetOutputToIdle: implemented-entry=Pwm_SetOutputToIdle
        Pwm_SetPeriodAndDuty: implemented-entry=Pwm_SetPeriodAndDuty
package /Pwm_T40D2M10I2R0/Implementations
  bsw implementation BswImplementation_0: programming-language=C, sw-version=4.2.2, vendor-id=43, ar-release-version=4.2.2, behavior=InternalBehavior_0, vendor-specific-module-def=Pwm
    code-descriptors:
      code Files
        artifact-descriptors:
          short-label=config::Pwm.xdm, category=SWCFG
          short-label=doc::AUTOSAR_MCAL_PWM_IM.pdf, category=SWDOC
          short-label=doc::AUTOSAR_MCAL_PWM_UM.pdf, category=SWDOC
          short-label=include::Pwm.h, category=SWHDR
          short-label=include::Pwm_EnvCfg.h, category=SWHDR
          short-label=include::Pwm_FlexIO.h, category=SWHDR
          short-label=include::Pwm_FlexIO_Types.h, category=SWHDR
          short-label=include::Pwm_Ftm.h, category=SWHDR
          short-label=include::Pwm_Ftm_Irq.h, category=SWHDR
          short-label=include::Pwm_Ftm_Types.h, category=SWHDR
          short-label=include::Pwm_Ipw.h, category=SWHDR
          short-label=include::Pwm_Ipw_Notif.h, category=SWHDR
          short-label=include::Pwm_Ipw_Types.h, category=SWHDR
          short-label=include::Pwm_Notif.h, category=SWHDR
          short-label=include::Pwm_Types.h, category=SWHDR
          short-label=src::Pwm.c, category=SWSRC
          short-label=src::Pwm_FlexIO.c, category=SWSRC
          short-label=src::Pwm_Ftm.c, category=SWSRC
          short-label=src::Pwm_Ipw.c, category=SWSRC
    compiler GHS_Compiler:
      name=Green Hills
      options=-cpu=cortexm4 -cpu=cortexm0plus -ansi -Osize -dual_debug -G --no_exceptions -Wundef -Wimplicit-int -Wshadow -Wtrigraphs -Wall --prototype_errors --incorrect_pragma_warnings -noslashcomment -preprocess_assembly_files -nostartfile --short_enum -c --no_commons -keeptempfiles -list -DAUTOSAR_OS_NOT_USED -DDISABLE_MCAL_INTERMODULE_ASR_CHECK -DGHS
      vendor=Green Hills
      version=Green Hills Multi 7.1.4 / Compiler 2017.1.4
    compiler IAR_Compiler: name=IAR Compiler, options=--cpu=Cortex-M4 --cpu=Cortex-M0+ --cpu_mode=thumb --endian=little -Ohz -c --no_clustering --no_mem_idioms --no_explicit_zero_opt --debug --diag_suppress=Pa050 -DAUTOSAR_OS_NOT_USED -DIAR --require_prototypes --no_wrap_diagnostics --no_system_include -e, vendor=IAR Systems, version=IAR: V8.11.2
    generated-artifacts:
      dependency on artifact Pwm_PBcfg_c: artifact-descriptor={short-label=generate_PB::src::Pwm_PBcfg.c, category=SWSRC}, usages=COMPILE
      dependency on artifact Pwm_Cfg_h: artifact-descriptor={short-label=generate_PC::include::Pwm_Cfg.h, category=SWHDR}, usages=COMPILE
    linker GHS_Linker: name=Green Hills, options=-Mn -delete -v -ignore_debug_references -map -keepmap -lstartup -lsys -larch -lansi -L(/lib/thumb2) -lutf8_s32, vendor=Green Hills, version=Green Hills Multi 7.1.4 / Compiler 2017.1.4
    linker IAR_Linker: name=IAR Compiler, options=--cpu=Cortex-M4 --cpu=Cortex-M0+ --map filename --no_library_search --entry _start --enable_stack_usage --skip_dynamic_initialization --no_wrap_diagnostics --config, vendor=IAR Systems, version=IAR: V8.11.2
    resource consumption ResourceConsumption
      6 x memory section:
        PWM_CODE: alignment=UNSPECIFIED, sw-addrmethod=CODE, symbol=CODE
        PWM_CONFIG_DATA_UNSPECIFIED: alignment=UNSPECIFIED, sw-addrmethod=CONFIG_DATA, symbol=CONFIG_DATA_UNSPECIFIED
        PWM_VAR_INIT_UNSPECIFIED: alignment=UNSPECIFIED, sw-addrmethod=VAR_INIT, symbol=VAR_INIT_UNSPECIFIED
        PWM_VAR_NO_INIT_16: alignment=16, sw-addrmethod=VAR_NO_INIT, symbol=VAR_NO_INIT_16
        PWM_VAR_NO_INIT_8: alignment=8, sw-addrmethod=VAR_NO_INIT, symbol=VAR_NO_INIT_8
        PWM_VAR_NO_INIT_UNSPECIFIED: alignment=UNSPECIFIED, sw-addrmethod=VAR_NO_INIT, symbol=VAR_NO_INIT_UNSPECIFIED
