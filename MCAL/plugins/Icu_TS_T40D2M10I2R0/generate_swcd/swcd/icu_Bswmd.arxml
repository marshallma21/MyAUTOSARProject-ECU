AUTOSAR XML (schema 4-0-3)
package /AUTOSAR_Icu/BswModuleDescriptions
  bsw module description Icu: module-id=122
    provided-entrys:
      Icu_CheckWakeup
      Icu_DeInit
      Icu_DisableEdgeCount
      Icu_DisableEdgeDetection
      Icu_DisableNotification
      Icu_DisableWakeup
      Icu_EnableEdgeCount
      Icu_EnableEdgeDetection
      Icu_EnableNotification
      Icu_EnableWakeup
      Icu_GetCaptureRegisterValue
      Icu_GetDutyCycleValues
      Icu_GetEdgeNumbers
      Icu_GetInputState
      Icu_GetTimeElapsed
      Icu_GetTimestampIndex
      Icu_Init
      Icu_ResetEdgeCount
      Icu_SetActivationCondition
      Icu_SetMode
      Icu_StartSignalMeasurement
      Icu_StartTimestamp
      Icu_StopSignalMeasurement
      Icu_StopTimestamp
      Icu_GetVersionInfo
      ICU_EXT_IRQ_SINGLE_INTERRUPT
      ICU_PORT_CI_A_EXT_IRQ_ISR
      ICU_PORT_CI_B_EXT_IRQ_ISR
      ICU_PORT_CI_C_EXT_IRQ_ISR
      ICU_PORT_CI_D_EXT_IRQ_ISR
      ICU_PORT_CI_E_EXT_IRQ_ISR
      ICU_PORT_CI_F_EXT_IRQ_ISR
      ICU_PORT_CI_G_EXT_IRQ_ISR
      ICU_PORT_CI_H_EXT_IRQ_ISR
      ICU_PORT_CI_J_EXT_IRQ_ISR
      ICU_PORT_CI_K_EXT_IRQ_ISR
      ICU_PORT_CI_L_EXT_IRQ_ISR
    bsw internal behavior InternalBehavior_0
      46 x exclusive area:
        ICU_EXCLUSIVE_AREA_{00..40}
        ICU_EXCLUSIVE_AREA_{60..64}
      25 x bsw called entity:
        Icu_CheckWakeup: implemented-entry=Icu_CheckWakeup
        Icu_DeInit: implemented-entry=Icu_DeInit
        Icu_DisableEdgeCount: implemented-entry=Icu_DisableEdgeCount
        Icu_DisableEdgeDetection: implemented-entry=Icu_DisableEdgeDetection
        Icu_DisableNotification: implemented-entry=Icu_DisableNotification
        Icu_DisableWakeup: implemented-entry=Icu_DisableWakeup
        Icu_EnableEdgeCount: implemented-entry=Icu_EnableEdgeCount
        Icu_EnableEdgeDetection: implemented-entry=Icu_EnableEdgeDetection
        Icu_EnableNotification: implemented-entry=Icu_EnableNotification
        Icu_EnableWakeup: implemented-entry=Icu_EnableWakeup
        Icu_GetCaptureRegisterValue: implemented-entry=Icu_GetCaptureRegisterValue
        Icu_GetDutyCycleValues: implemented-entry=Icu_GetDutyCycleValues
        Icu_GetEdgeNumbers: implemented-entry=Icu_GetEdgeNumbers
        Icu_GetInputState: implemented-entry=Icu_GetInputState
        Icu_GetTimeElapsed: implemented-entry=Icu_GetTimeElapsed
        Icu_GetTimestampIndex: implemented-entry=Icu_GetTimestampIndex
        Icu_Init: can-enter-exclusive-area=[ICU_EXCLUSIVE_AREA_00, ICU_EXCLUSIVE_AREA_01, ICU_EXCLUSIVE_AREA_02, ICU_EXCLUSIVE_AREA_03, ICU_EXCLUSIVE_AREA_04, ICU_EXCLUSIVE_AREA_05, ICU_EXCLUSIVE_AREA_06, ICU_EXCLUSIVE_AREA_07, ICU_EXCLUSIVE_AREA_08, ICU_EXCLUSIVE_AREA_09, ICU_EXCLUSIVE_AREA_10, ICU_EXCLUSIVE_AREA_11, ICU_EXCLUSIVE_AREA_12, ICU_EXCLUSIVE_AREA_13, ICU_EXCLUSIVE_AREA_14, ICU_EXCLUSIVE_AREA_15, ICU_EXCLUSIVE_AREA_16, ICU_EXCLUSIVE_AREA_17, ICU_EXCLUSIVE_AREA_18, ICU_EXCLUSIVE_AREA_19, ICU_EXCLUSIVE_AREA_20, ICU_EXCLUSIVE_AREA_21, ICU_EXCLUSIVE_AREA_22, ICU_EXCLUSIVE_AREA_23, ICU_EXCLUSIVE_AREA_24, ICU_EXCLUSIVE_AREA_25, ICU_EXCLUSIVE_AREA_26, ICU_EXCLUSIVE_AREA_27, ICU_EXCLUSIVE_AREA_28, ICU_EXCLUSIVE_AREA_29, ICU_EXCLUSIVE_AREA_30, ICU_EXCLUSIVE_AREA_31, ICU_EXCLUSIVE_AREA_32, ICU_EXCLUSIVE_AREA_33, ICU_EXCLUSIVE_AREA_34, ICU_EXCLUSIVE_AREA_35, ICU_EXCLUSIVE_AREA_36, ICU_EXCLUSIVE_AREA_37, ICU_EXCLUSIVE_AREA_38, ICU_EXCLUSIVE_AREA_39, ICU_EXCLUSIVE_AREA_40, ICU_EXCLUSIVE_AREA_60, ICU_EXCLUSIVE_AREA_61, ICU_EXCLUSIVE_AREA_62, ICU_EXCLUSIVE_AREA_63, ICU_EXCLUSIVE_AREA_64], implemented-entry=Icu_Init
        Icu_ResetEdgeCount: implemented-entry=Icu_ResetEdgeCount
        Icu_SetActivationCondition: implemented-entry=Icu_SetActivationCondition
        Icu_SetMode: implemented-entry=Icu_SetMode
        Icu_StartSignalMeasurement: implemented-entry=Icu_StartSignalMeasurement
        Icu_StartTimestamp: implemented-entry=Icu_StartTimestamp
        Icu_StopSignalMeasurement: implemented-entry=Icu_StopSignalMeasurement
        Icu_StopTimestamp: implemented-entry=Icu_StopTimestamp
        Icu_GetVersionInfo: implemented-entry=Icu_GetVersionInfo
      12 x bsw interrupt entity, all with interrupt-category=CAT-2, interrupt-source=Hardware:
        ICU_EXT_IRQ_SINGLE_INTERRUPT: implemented-entry=ICU_EXT_IRQ_SINGLE_INTERRUPT
        ICU_PORT_CI_A_EXT_IRQ_ISR: implemented-entry=ICU_PORT_CI_A_EXT_IRQ_ISR
        ICU_PORT_CI_B_EXT_IRQ_ISR: implemented-entry=ICU_PORT_CI_B_EXT_IRQ_ISR
        ICU_PORT_CI_C_EXT_IRQ_ISR: implemented-entry=ICU_PORT_CI_C_EXT_IRQ_ISR
        ICU_PORT_CI_D_EXT_IRQ_ISR: implemented-entry=ICU_PORT_CI_D_EXT_IRQ_ISR
        ICU_PORT_CI_E_EXT_IRQ_ISR: implemented-entry=ICU_PORT_CI_E_EXT_IRQ_ISR
        ICU_PORT_CI_F_EXT_IRQ_ISR: implemented-entry=ICU_PORT_CI_F_EXT_IRQ_ISR
        ICU_PORT_CI_G_EXT_IRQ_ISR: implemented-entry=ICU_PORT_CI_G_EXT_IRQ_ISR
        ICU_PORT_CI_H_EXT_IRQ_ISR: implemented-entry=ICU_PORT_CI_H_EXT_IRQ_ISR
        ICU_PORT_CI_J_EXT_IRQ_ISR: implemented-entry=ICU_PORT_CI_J_EXT_IRQ_ISR
        ICU_PORT_CI_K_EXT_IRQ_ISR: implemented-entry=ICU_PORT_CI_K_EXT_IRQ_ISR
        ICU_PORT_CI_L_EXT_IRQ_ISR: implemented-entry=ICU_PORT_CI_L_EXT_IRQ_ISR
package /AUTOSAR_Icu/BswModuleEntrys
  12 x bsw module entry, all with service-id=0, is-reentrant=false, is-synchronous=true, call-type=INTERRUPT, execution-context=INTERRUPT-CAT-2, sw-service-impl-policy=STANDARD:
    ICU_EXT_IRQ_SINGLE_INTERRUPT
    ICU_PORT_CI_A_EXT_IRQ_ISR
    ICU_PORT_CI_B_EXT_IRQ_ISR
    ICU_PORT_CI_C_EXT_IRQ_ISR
    ICU_PORT_CI_D_EXT_IRQ_ISR
    ICU_PORT_CI_E_EXT_IRQ_ISR
    ICU_PORT_CI_F_EXT_IRQ_ISR
    ICU_PORT_CI_G_EXT_IRQ_ISR
    ICU_PORT_CI_H_EXT_IRQ_ISR
    ICU_PORT_CI_J_EXT_IRQ_ISR
    ICU_PORT_CI_K_EXT_IRQ_ISR
    ICU_PORT_CI_L_EXT_IRQ_ISR
package /Icu_T40D2M10I2R0/Implementations
  bsw implementation BswImplementation_0: programming-language=C, sw-version=4.2.2, vendor-id=43, ar-release-version=4.2.2, behavior=InternalBehavior_0, vendor-specific-module-def=Icu
    code-descriptors:
      code Files
        artifact-descriptors:
          short-label=config::Icu.xdm, category=SWCFG
          short-label=doc::AUTOSAR_MCAL_ICU_IM.pdf, category=SWDOC
          short-label=doc::AUTOSAR_MCAL_ICU_UM.pdf, category=SWDOC
          short-label=include::Icu.h, category=SWHDR
          short-label=include::Icu_EnvCfg.h, category=SWHDR
          short-label=include::Icu_Ftm.h, category=SWHDR
          short-label=include::Icu_Ftm_Irq.h, category=SWHDR
          short-label=include::Icu_Ftm_Types.h, category=SWHDR
          short-label=include::Icu_Ipw.h, category=SWHDR
          short-label=include::Icu_Ipw_Irq.h, category=SWHDR
          short-label=include::Icu_Ipw_Types.h, category=SWHDR
          short-label=include::Icu_Irq.h, category=SWHDR
          short-label=include::Icu_LPit.h, category=SWHDR
          short-label=include::Icu_LPit_Types.h, category=SWHDR
          short-label=include::Icu_Lptmr.h, category=SWHDR
          short-label=include::Icu_Lptmr_Types.h, category=SWHDR
          short-label=include::Icu_Port_Ci.h, category=SWHDR
          short-label=include::Icu_Port_Ci_Types.h, category=SWHDR
          short-label=include::Icu_Reg_eSys_Port_Ci.h, category=SWHDR
          short-label=include::Icu_Types.h, category=SWHDR
          short-label=src::Icu.c, category=SWSRC
          short-label=src::Icu_Ftm.c, category=SWSRC
          short-label=src::Icu_Ipw.c, category=SWSRC
          short-label=src::Icu_LPit.c, category=SWSRC
          short-label=src::Icu_Lptmr.c, category=SWSRC
          short-label=src::Icu_Port_Ci.c, category=SWSRC
          short-label=src::Icu_Port_Ci_Irq.c, category=SWSRC
    compiler IAR_Compiler: name=IAR Compiler, options=--cpu=Cortex-M4 --cpu=Cortex-M0+ --cpu_mode=thumb --endian=little -Ohz -c --no_clustering --no_mem_idioms --no_explicit_zero_opt --debug --diag_suppress=Pa050 -DAUTOSAR_OS_NOT_USED -DIAR --require_prototypes --no_wrap_diagnostics --no_system_include -e, vendor=IAR Systems, version=IAR: V8.11.2
    compiler GHS_Compiler:
      name=Green Hills
      options=-cpu=cortexm4 -cpu=cortexm0plus -ansi -Osize -dual_debug -G --no_exceptions -Wundef -Wimplicit-int -Wshadow -Wtrigraphs -Wall --prototype_errors --incorrect_pragma_warnings -noslashcomment -preprocess_assembly_files -nostartfile --short_enum -c --no_commons -keeptempfiles -list -DAUTOSAR_OS_NOT_USED -DDISABLE_MCAL_INTERMODULE_ASR_CHECK -DGHS
      vendor=Green Hills
      version=Green Hills Multi 7.1.4 / Compiler 2017.1.4
    generated-artifacts:
      4 x dependency on artifact, all with usages=COMPILE:
        Icu_Cfg_h: artifact-descriptor={short-label=generate::include::Icu_Cfg.h, category=SWHDR}
        Icu_DmaNotification_c: artifact-descriptor={short-label=generate::src::Icu_DmaNotification.c, category=SWSRC}
        Icu_PBcfg_c: artifact-descriptor={short-label=generate_PB::src::Icu_PBcfg.c, category=SWSRC}
        Icu_Cfg_c: artifact-descriptor={short-label=generate_PC::src::Icu_Cfg.c, category=SWSRC}
    linker IAR_Linker: name=IAR Compiler, options=--cpu=Cortex-M4 --cpu=Cortex-M0+ --map filename --no_library_search --entry _start --enable_stack_usage --skip_dynamic_initialization --no_wrap_diagnostics --config, vendor=IAR Systems, version=IAR: V8.11.2
    linker GHS_Linker: name=Green Hills, options=-Mn -delete -v -ignore_debug_references -map -keepmap -lstartup -lsys -larch -lansi -L(/lib/thumb2) -lutf8_s32, vendor=Green Hills, version=Green Hills Multi 7.1.4 / Compiler 2017.1.4
    resource consumption ResourceConsumption
      9 x memory section:
        ICU_CODE: alignment=UNSPECIFIED, sw-addrmethod=CODE, symbol=CODE
        ICU_CONFIG_DATA_UNSPECIFIED: alignment=UNSPECIFIED, sw-addrmethod=CONFIG_DATA, symbol=CONFIG_DATA_UNSPECIFIED
        ICU_CONST_32: alignment=32, sw-addrmethod=CONST, symbol=CONST_32
        ICU_VAR_INIT_16: alignment=16, sw-addrmethod=VAR_INIT, symbol=VAR_INIT_16
        ICU_VAR_INIT_32: alignment=32, sw-addrmethod=VAR_INIT, symbol=VAR_INIT_32
        ICU_VAR_INIT_8: alignment=8, sw-addrmethod=VAR_INIT, symbol=VAR_INIT_8
        ICU_VAR_INIT_UNSPECIFIED: alignment=UNSPECIFIED, sw-addrmethod=VAR_INIT, symbol=VAR_INIT_UNSPECIFIED
        ICU_VAR_NO_INIT_UNSPECIFIED: alignment=UNSPECIFIED, sw-addrmethod=VAR_NO_INIT, symbol=VAR_NO_INIT_UNSPECIFIED
        ICU_VAR_NO_INIT_UNSPECIFIED_NO_CACHEABLE: alignment=CACHEABLE, sw-addrmethod=VAR_NO_INIT_UNSPECIFIED_NO, symbol=VAR_NO_INIT_UNSPECIFIED_NO_CACHEABLE
