AUTOSAR XML (schema 4-0-3)
package /AUTOSAR_Port/BswModuleDescriptions
  bsw module description Port: module-id=124
    provided-entrys:
      Port_GetVersionInfo
      Port_Init
      Port_RefreshPortDirection
      Port_Set2PinsDirection
      Port_SetPinDirection
      Port_SetPinMode
    bsw internal behavior InternalBehavior_0
      5 x exclusive area:
        PORT_EXCLUSIVE_AREA_{00..04}
      6 x bsw called entity:
        Port_GetVersionInfo: implemented-entry=Port_GetVersionInfo
        Port_Init: can-enter-exclusive-area=[PORT_EXCLUSIVE_AREA_00, PORT_EXCLUSIVE_AREA_01, PORT_EXCLUSIVE_AREA_02, PORT_EXCLUSIVE_AREA_03, PORT_EXCLUSIVE_AREA_04], implemented-entry=Port_Init
        Port_RefreshPortDirection: implemented-entry=Port_RefreshPortDirection
        Port_Set2PinsDirection: implemented-entry=Port_Set2PinsDirection
        Port_SetPinDirection: implemented-entry=Port_SetPinDirection
        Port_SetPinMode: implemented-entry=Port_SetPinMode
package /Port_T40D2M10I2R0/Implementations
  bsw implementation BswImplementation_0: programming-language=C, sw-version=4.2.2, vendor-id=43, ar-release-version=4.2.2, behavior=InternalBehavior_0, recommended-configuration=PortRecConfiguration_JtagPins, vendor-specific-module-def=Port
    code-descriptors:
      code Files
        artifact-descriptors:
          short-label=config::Port.xdm, category=SWCFG
          short-label=config_ext::PortRecConfiguration_JtagPins.xdm, category=SWCFG
          short-label=doc::AUTOSAR_MCAL_PORT_IM.pdf, category=SWDOC
          short-label=doc::AUTOSAR_MCAL_PORT_UM.pdf, category=SWDOC
          short-label=include::Port.h, category=SWHDR
          short-label=include::Port_EnvCfg.h, category=SWHDR
          short-label=include::Port_Ipw.h, category=SWHDR
          short-label=include::Port_Port_Ci.h, category=SWHDR
          short-label=include::Port_Port_Ci_Types.h, category=SWHDR
          short-label=include::Port_Reg_eSys_Port_Ci.h, category=SWHDR
          short-label=include::Reg_eSys_Gpio.h, category=SWHDR
          short-label=src::Port.c, category=SWSRC
          short-label=src::Port_Ipw.c, category=SWSRC
          short-label=src::Port_Port_Ci.c, category=SWSRC
    compiler IAR_Compiler: name=IAR Compiler, options=--cpu=Cortex-M4 --cpu=Cortex-M0+ --cpu_mode=thumb --endian=little -Ohz -c --no_clustering --no_mem_idioms --no_explicit_zero_opt --debug --diag_suppress=Pa050 -DAUTOSAR_OS_NOT_USED -DIAR --require_prototypes --no_wrap_diagnostics --no_system_include -e, vendor=IAR Systems, version=IAR: V8.11.2
    compiler GHS_Compiler:
      name=Green Hills
      options=-cpu=cortexm4 -cpu=cortexm0plus -ansi -Osize -dual_debug -G --no_exceptions -Wundef -Wimplicit-int -Wshadow -Wtrigraphs -Wall --prototype_errors --incorrect_pragma_warnings -noslashcomment -preprocess_assembly_files -nostartfile --short_enum -c --no_commons -keeptempfiles -list -DAUTOSAR_OS_NOT_USED -DDISABLE_MCAL_INTERMODULE_ASR_CHECK -DGHS
      vendor=Green Hills
      version=Green Hills Multi 7.1.4 / Compiler 2017.1.4
    generated-artifacts:
      dependency on artifact Port_PBcfg_c: artifact-descriptor={short-label=generate_PB::src::Port_PBcfg.c, category=SWSRC}, usages=COMPILE
      dependency on artifact Port_Cfg_h: artifact-descriptor={short-label=generate_PC::include::Port_Cfg.h, category=SWHDR}, usages=COMPILE
      dependency on artifact Port_Cfg_c: artifact-descriptor={short-label=generate_PC::src::Port_Cfg.c, category=SWSRC}, usages=COMPILE
    linker IAR_Linker: name=IAR Compiler, options=--cpu=Cortex-M4 --cpu=Cortex-M0+ --map filename --no_library_search --entry _start --enable_stack_usage --skip_dynamic_initialization --no_wrap_diagnostics --config, vendor=IAR Systems, version=IAR: V8.11.2
    linker GHS_Linker: name=Green Hills, options=-Mn -delete -v -ignore_debug_references -map -keepmap -lstartup -lsys -larch -lansi -L(/lib/thumb2) -lutf8_s32, vendor=Green Hills, version=Green Hills Multi 7.1.4 / Compiler 2017.1.4
    resource consumption ResourceConsumption
      6 x memory section:
        PORT_CODE: alignment=UNSPECIFIED, sw-addrmethod=CODE, symbol=CODE
        PORT_CONFIG_DATA_16: alignment=16, sw-addrmethod=CONFIG_DATA, symbol=CONFIG_DATA_16
        PORT_CONFIG_DATA_UNSPECIFIED: alignment=UNSPECIFIED, sw-addrmethod=CONFIG_DATA, symbol=CONFIG_DATA_UNSPECIFIED
        PORT_CONST_16: alignment=16, sw-addrmethod=CONST, symbol=CONST_16
        PORT_VAR_INIT_UNSPECIFIED: alignment=UNSPECIFIED, sw-addrmethod=VAR_INIT, symbol=VAR_INIT_UNSPECIFIED
        PORT_VAR_NO_INIT_16: alignment=16, sw-addrmethod=VAR_NO_INIT, symbol=VAR_NO_INIT_16
