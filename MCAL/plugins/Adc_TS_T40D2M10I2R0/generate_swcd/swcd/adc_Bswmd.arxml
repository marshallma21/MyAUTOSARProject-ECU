AUTOSAR XML (schema 4-0-3)
package /AUTOSAR_Adc/BswModuleDescriptions
  bsw module description Adc: module-id=123
    provided-entrys:
      Adc_Calibrate
      Adc_ConfigureThreshold
      Adc_Ctu2TriggerHandlerCtrlRegsEnableDisable
      Adc_DeInit
      Adc_DisableChannel
      Adc_DisableCtuControlMode
      Adc_DisableCTUTrigger
      Adc_DisableGroupNotification
      Adc_DisableHardwareTrigger
      Adc_EnableChannel
      Adc_EnableCtuControlMode
      Adc_EnableCTUTrigger
      Adc_EnableGroupNotification
      Adc_EnableHardwareTrigger
      Adc_GetCurrentPowerState
      Adc_GetGroupStatus
      Adc_GetInjectedConversionStatus
      Adc_GetStreamLastPointer
      Adc_GetTargetPowerState
      Adc_GetVersionInfo
      Adc_HwResultReadGroup
      Adc_Init
      Adc_Main_PowerTransitionManager
      Adc_PreparePowerState
      Adc_ReadGroup
      Adc_SelfTest
      Adc_SetChannel
      Adc_SetClockMode
      Adc_SetCtu2CmdListHandlerCtrlRegs
      Adc_SetCtu2TriggerCompareRegs
      Adc_SetCtu2TriggerHandlerCtrlRegs
      Adc_SetMode
      Adc_SetPowerState
      Adc_SetupResultBuffer
      Adc_StartGroupConversion
      Adc_StopGroupConversion
      Adc_ValidateCallAndGroup
      Adc_ValidateCallAndUnit
      Adc_ValidateGloballCall
      Adc_ValidatePtrInit
      Adc_Adc12bsarv2_EndGroupConvUnit0
      Adc_Adc12bsarv2_EndGroupConvUnit1
    bsw internal behavior InternalBehavior_0
      33 x exclusive area:
        ADC_EXCLUSIVE_AREA_{00..32}
      40 x bsw called entity:
        Adc_Calibrate: implemented-entry=Adc_Calibrate
        Adc_ConfigureThreshold: implemented-entry=Adc_ConfigureThreshold
        Adc_Ctu2TriggerHandlerCtrlRegsEnableDisable: implemented-entry=Adc_Ctu2TriggerHandlerCtrlRegsEnableDisable
        Adc_DeInit: implemented-entry=Adc_DeInit
        Adc_DisableChannel: implemented-entry=Adc_DisableChannel
        Adc_DisableCtuControlMode: implemented-entry=Adc_DisableCtuControlMode
        Adc_DisableCTUTrigger: implemented-entry=Adc_DisableCTUTrigger
        Adc_DisableGroupNotification: implemented-entry=Adc_DisableGroupNotification
        Adc_DisableHardwareTrigger: implemented-entry=Adc_DisableHardwareTrigger
        Adc_EnableChannel: implemented-entry=Adc_EnableChannel
        Adc_EnableCtuControlMode: implemented-entry=Adc_EnableCtuControlMode
        Adc_EnableCTUTrigger: implemented-entry=Adc_EnableCTUTrigger
        Adc_EnableGroupNotification: implemented-entry=Adc_EnableGroupNotification
        Adc_EnableHardwareTrigger: implemented-entry=Adc_EnableHardwareTrigger
        Adc_GetCurrentPowerState: implemented-entry=Adc_GetCurrentPowerState
        Adc_GetGroupStatus: implemented-entry=Adc_GetGroupStatus
        Adc_GetInjectedConversionStatus: implemented-entry=Adc_GetInjectedConversionStatus
        Adc_GetStreamLastPointer: implemented-entry=Adc_GetStreamLastPointer
        Adc_GetTargetPowerState: implemented-entry=Adc_GetTargetPowerState
        Adc_GetVersionInfo: implemented-entry=Adc_GetVersionInfo
        Adc_HwResultReadGroup: implemented-entry=Adc_HwResultReadGroup
        Adc_Init: can-enter-exclusive-area=[ADC_EXCLUSIVE_AREA_00, ADC_EXCLUSIVE_AREA_01, ADC_EXCLUSIVE_AREA_02, ADC_EXCLUSIVE_AREA_03, ADC_EXCLUSIVE_AREA_04, ADC_EXCLUSIVE_AREA_05, ADC_EXCLUSIVE_AREA_06, ADC_EXCLUSIVE_AREA_07, ADC_EXCLUSIVE_AREA_08, ADC_EXCLUSIVE_AREA_09, ADC_EXCLUSIVE_AREA_10, ADC_EXCLUSIVE_AREA_11, ADC_EXCLUSIVE_AREA_12, ADC_EXCLUSIVE_AREA_13, ADC_EXCLUSIVE_AREA_14, ADC_EXCLUSIVE_AREA_15, ADC_EXCLUSIVE_AREA_16, ADC_EXCLUSIVE_AREA_17, ADC_EXCLUSIVE_AREA_18, ADC_EXCLUSIVE_AREA_19, ADC_EXCLUSIVE_AREA_20, ADC_EXCLUSIVE_AREA_21, ADC_EXCLUSIVE_AREA_22, ADC_EXCLUSIVE_AREA_23, ADC_EXCLUSIVE_AREA_24, ADC_EXCLUSIVE_AREA_25, ADC_EXCLUSIVE_AREA_26, ADC_EXCLUSIVE_AREA_27, ADC_EXCLUSIVE_AREA_28, ADC_EXCLUSIVE_AREA_29, ADC_EXCLUSIVE_AREA_30, ADC_EXCLUSIVE_AREA_31, ADC_EXCLUSIVE_AREA_32], implemented-entry=Adc_Init
        Adc_Main_PowerTransitionManager: implemented-entry=Adc_Main_PowerTransitionManager
        Adc_PreparePowerState: implemented-entry=Adc_PreparePowerState
        Adc_ReadGroup: implemented-entry=Adc_ReadGroup
        Adc_SelfTest: implemented-entry=Adc_SelfTest
        Adc_SetChannel: implemented-entry=Adc_SetChannel
        Adc_SetClockMode: implemented-entry=Adc_SetClockMode
        Adc_SetCtu2CmdListHandlerCtrlRegs: implemented-entry=Adc_SetCtu2CmdListHandlerCtrlRegs
        Adc_SetCtu2TriggerCompareRegs: implemented-entry=Adc_SetCtu2TriggerCompareRegs
        Adc_SetCtu2TriggerHandlerCtrlRegs: implemented-entry=Adc_SetCtu2TriggerHandlerCtrlRegs
        Adc_SetMode: implemented-entry=Adc_SetMode
        Adc_SetPowerState: implemented-entry=Adc_SetPowerState
        Adc_SetupResultBuffer: implemented-entry=Adc_SetupResultBuffer
        Adc_StartGroupConversion: implemented-entry=Adc_StartGroupConversion
        Adc_StopGroupConversion: implemented-entry=Adc_StopGroupConversion
        Adc_ValidateCallAndGroup: implemented-entry=Adc_ValidateCallAndGroup
        Adc_ValidateCallAndUnit: implemented-entry=Adc_ValidateCallAndUnit
        Adc_ValidateGloballCall: implemented-entry=Adc_ValidateGloballCall
        Adc_ValidatePtrInit: implemented-entry=Adc_ValidatePtrInit
      bsw interrupt entity Adc_Adc12bsarv2_EndGroupConvUnit0: implemented-entry=Adc_Adc12bsarv2_EndGroupConvUnit0, interrupt-category=CAT-2, interrupt-source=Hardware
      bsw interrupt entity Adc_Adc12bsarv2_EndGroupConvUnit1: implemented-entry=Adc_Adc12bsarv2_EndGroupConvUnit1, interrupt-category=CAT-2, interrupt-source=Hardware
package /AUTOSAR_Adc/BswModuleEntrys
  bsw module entry Adc_Adc12bsarv2_EndGroupConvUnit0: service-id=0, is-reentrant=false, is-synchronous=true, call-type=INTERRUPT, execution-context=INTERRUPT-CAT-2, sw-service-impl-policy=STANDARD
  bsw module entry Adc_Adc12bsarv2_EndGroupConvUnit1: service-id=0, is-reentrant=false, is-synchronous=true, call-type=INTERRUPT, execution-context=INTERRUPT-CAT-2, sw-service-impl-policy=STANDARD
package /Adc_T40D2M10I2R0/Implementations
  bsw implementation BswImplementation_0: programming-language=C, sw-version=4.2.2, vendor-id=43, ar-release-version=4.2.2, behavior=InternalBehavior_0, vendor-specific-module-def=Adc
    code-descriptors:
      code Files
        artifact-descriptors:
          short-label=config::Adc.xdm, category=SWCFG
          short-label=doc::AUTOSAR_MCAL_ADC_IM.pdf, category=SWDOC
          short-label=doc::AUTOSAR_MCAL_ADC_UM.pdf, category=SWDOC
          short-label=include::Adc.h, category=SWHDR
          short-label=include::Adc_Adc12bsarv2.h, category=SWHDR
          short-label=include::Adc_Adc12bsarv2_CfgEx.h, category=SWHDR
          short-label=include::Adc_EnvCfg.h, category=SWHDR
          short-label=include::Adc_Ipw.h, category=SWHDR
          short-label=include::Adc_Pdb.h, category=SWHDR
          short-label=include::Adc_Reg_eSys_Adc12bsarv2.h, category=SWHDR
          short-label=include::Adc_Reg_eSys_Pdb.h, category=SWHDR
          short-label=include::Adc_Types.h, category=SWHDR
          short-label=src::Adc.c, category=SWSRC
          short-label=src::Adc_Adc12bsarv2.c, category=SWSRC
          short-label=src::Adc_Adc12bsarv2_Irq.c, category=SWSRC
          short-label=src::Adc_Ipw.c, category=SWSRC
          short-label=src::Adc_Pdb.c, category=SWSRC
          short-label=src::Adc_Pdb_Irq.c, category=SWSRC
    compiler IAR_Compiler: name=IAR Compiler, options=--cpu=Cortex-M4 --cpu=Cortex-M0+ --cpu_mode=thumb --endian=little -Ohz -c --no_clustering --no_mem_idioms --no_explicit_zero_opt --debug --diag_suppress=Pa050 -DAUTOSAR_OS_NOT_USED -DIAR --require_prototypes --no_wrap_diagnostics --no_system_include -e, vendor=IAR Systems, version=IAR: V8.11.2
    compiler GHS_Compiler:
      name=Green Hills
      options=-cpu=cortexm4 -cpu=cortexm0plus -ansi -Osize -dual_debug -G --no_exceptions -Wundef -Wimplicit-int -Wshadow -Wtrigraphs -Wall --prototype_errors --incorrect_pragma_warnings -noslashcomment -preprocess_assembly_files -nostartfile --short_enum -c --no_commons -keeptempfiles -list -DAUTOSAR_OS_NOT_USED -DDISABLE_MCAL_INTERMODULE_ASR_CHECK -DGHS
      vendor=Green Hills
      version=Green Hills Multi 7.1.4 / Compiler 2017.1.4
    generated-artifacts:
      4 x dependency on artifact, all with usages=COMPILE:
        Adc_PBcfg_c: artifact-descriptor={short-label=generate_PB::src::Adc_PBcfg.c, category=SWSRC}
        Adc_Cfg_h: artifact-descriptor={short-label=generate_PC::include::Adc_Cfg.h, category=SWHDR}
        Adc_CfgDefines_h: artifact-descriptor={short-label=generate_PC::include::Adc_CfgDefines.h, category=SWHDR}
        Adc_Cfg_c: artifact-descriptor={short-label=generate_PC::src::Adc_Cfg.c, category=SWSRC}
    linker IAR_Linker: name=IAR Compiler, options=--cpu=Cortex-M4 --cpu=Cortex-M0+ --map filename --no_library_search --entry _start --enable_stack_usage --skip_dynamic_initialization --no_wrap_diagnostics --config, vendor=IAR Systems, version=IAR: V8.11.2
    linker GHS_Linker: name=Green Hills, options=-Mn -delete -v -ignore_debug_references -map -keepmap -lstartup -lsys -larch -lansi -L(/lib/thumb2) -lutf8_s32, vendor=Green Hills, version=Green Hills Multi 7.1.4 / Compiler 2017.1.4
    resource consumption ResourceConsumption
      7 x memory section:
        ADC_CODE: alignment=UNSPECIFIED, sw-addrmethod=CODE, symbol=CODE
        ADC_CONFIG_DATA_UNSPECIFIED: alignment=UNSPECIFIED, sw-addrmethod=CONFIG_DATA, symbol=CONFIG_DATA_UNSPECIFIED
        ADC_CONST_32: alignment=32, sw-addrmethod=CONST, symbol=CONST_32
        ADC_CONST_UNSPECIFIED: alignment=UNSPECIFIED, sw-addrmethod=CONST, symbol=CONST_UNSPECIFIED
        ADC_VAR_INIT_UNSPECIFIED: alignment=UNSPECIFIED, sw-addrmethod=VAR_INIT, symbol=VAR_INIT_UNSPECIFIED
        ADC_VAR_NO_INIT_8: alignment=8, sw-addrmethod=VAR_NO_INIT, symbol=VAR_NO_INIT_8
        ADC_VAR_NO_INIT_UNSPECIFIED: alignment=UNSPECIFIED, sw-addrmethod=VAR_NO_INIT, symbol=VAR_NO_INIT_UNSPECIFIED
