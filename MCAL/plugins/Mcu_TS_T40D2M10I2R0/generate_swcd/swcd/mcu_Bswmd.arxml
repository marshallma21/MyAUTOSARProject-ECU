AUTOSAR XML (schema 4-0-3)
package /AUTOSAR_Mcu/BswModuleDescriptions
  bsw module description Mcu: module-id=101
    provided-entrys:
      Mcu_DisableCmu
      Mcu_DistributePllClock
      Mcu_EmiosConfigureGpren
      Mcu_GetMidrStructure
      Mcu_GetPeripheralState
      Mcu_GetPllStatus
      Mcu_GetPowerDomainState
      Mcu_GetPowerModeState
      Mcu_GetRamState
      Mcu_GetResetRawValue
      Mcu_GetResetReason
      Mcu_GetSystemState
      Mcu_GetVersionInfo
      Mcu_Init
      Mcu_InitClock
      Mcu_InitRamSection
      Mcu_PerformReset
      Mcu_SetMode
      Mcu_SRAMRetentionConfig
      Mcu_SscmGetMemConfig
      Mcu_SscmGetStatus
      Mcu_SscmGetUops
      Mcu_Cmu_ClockFailIsr
      Mcu_PMC_LowVoltage_ISR
      Mcu_PMC_SCG_CMU_Isr
      Mcu_PMC_TemperatureError_ISR
      Mcu_RCM_AlternateResetIsr
    bsw internal behavior InternalBehavior_0
      22 x bsw called entity:
        Mcu_DisableCmu: implemented-entry=Mcu_DisableCmu
        Mcu_DistributePllClock: implemented-entry=Mcu_DistributePllClock
        Mcu_EmiosConfigureGpren: implemented-entry=Mcu_EmiosConfigureGpren
        Mcu_GetMidrStructure: implemented-entry=Mcu_GetMidrStructure
        Mcu_GetPeripheralState: implemented-entry=Mcu_GetPeripheralState
        Mcu_GetPllStatus: implemented-entry=Mcu_GetPllStatus
        Mcu_GetPowerDomainState: implemented-entry=Mcu_GetPowerDomainState
        Mcu_GetPowerModeState: implemented-entry=Mcu_GetPowerModeState
        Mcu_GetRamState: implemented-entry=Mcu_GetRamState
        Mcu_GetResetRawValue: implemented-entry=Mcu_GetResetRawValue
        Mcu_GetResetReason: implemented-entry=Mcu_GetResetReason
        Mcu_GetSystemState: implemented-entry=Mcu_GetSystemState
        Mcu_GetVersionInfo: implemented-entry=Mcu_GetVersionInfo
        Mcu_Init: implemented-entry=Mcu_Init
        Mcu_InitClock: implemented-entry=Mcu_InitClock
        Mcu_InitRamSection: implemented-entry=Mcu_InitRamSection
        Mcu_PerformReset: implemented-entry=Mcu_PerformReset
        Mcu_SetMode: implemented-entry=Mcu_SetMode
        Mcu_SRAMRetentionConfig: implemented-entry=Mcu_SRAMRetentionConfig
        Mcu_SscmGetMemConfig: implemented-entry=Mcu_SscmGetMemConfig
        Mcu_SscmGetStatus: implemented-entry=Mcu_SscmGetStatus
        Mcu_SscmGetUops: implemented-entry=Mcu_SscmGetUops
      5 x bsw interrupt entity, all with interrupt-category=CAT-2, interrupt-source=Hardware:
        Mcu_Cmu_ClockFailIsr: implemented-entry=Mcu_Cmu_ClockFailIsr
        Mcu_PMC_LowVoltage_ISR: implemented-entry=Mcu_PMC_LowVoltage_ISR
        Mcu_PMC_SCG_CMU_Isr: implemented-entry=Mcu_PMC_SCG_CMU_Isr
        Mcu_PMC_TemperatureError_ISR: implemented-entry=Mcu_PMC_TemperatureError_ISR
        Mcu_RCM_AlternateResetIsr: implemented-entry=Mcu_RCM_AlternateResetIsr
package /AUTOSAR_Mcu/BswModuleEntrys
  5 x bsw module entry, all with service-id=0, is-reentrant=false, is-synchronous=true, call-type=INTERRUPT, execution-context=INTERRUPT-CAT-2, sw-service-impl-policy=STANDARD:
    Mcu_Cmu_ClockFailIsr
    Mcu_PMC_LowVoltage_ISR
    Mcu_PMC_SCG_CMU_Isr
    Mcu_PMC_TemperatureError_ISR
    Mcu_RCM_AlternateResetIsr
package /Mcu_T40D2M10I2R0/Implementations
  bsw implementation BswImplementation_0: programming-language=C, sw-version=4.2.2, vendor-id=43, ar-release-version=4.2.2, behavior=InternalBehavior_0, preconfigured-configuration=McuPreConfiguration, vendor-specific-module-def=Mcu
    code-descriptors:
      code Files
        artifact-descriptors:
          short-label=config::Mcu.xdm, category=SWCFG
          short-label=config_ext::McuPreConfiguration.xdm, category=SWCFG
          short-label=doc::AUTOSAR_MCAL_MCU_IM.pdf, category=SWDOC
          short-label=doc::AUTOSAR_MCAL_MCU_UM.pdf, category=SWDOC
          short-label=include::Mcu.h, category=SWHDR
          short-label=include::Mcu_CMU.h, category=SWHDR
          short-label=include::Mcu_CMU_IPVersion.h, category=SWHDR
          short-label=include::Mcu_CMU_Types.h, category=SWHDR
          short-label=include::Mcu_CortexM4.h, category=SWHDR
          short-label=include::Mcu_EnvCfg.h, category=SWHDR
          short-label=include::Mcu_IPW.h, category=SWHDR
          short-label=include::Mcu_IPW_Irq.h, category=SWHDR
          short-label=include::Mcu_IPW_Types.h, category=SWHDR
          short-label=include::Mcu_PCC.h, category=SWHDR
          short-label=include::Mcu_PCC_Types.h, category=SWHDR
          short-label=include::Mcu_PMC.h, category=SWHDR
          short-label=include::Mcu_PMC_IPVersion.h, category=SWHDR
          short-label=include::Mcu_PMC_Types.h, category=SWHDR
          short-label=include::Mcu_RCM.h, category=SWHDR
          short-label=include::Mcu_RCM_Types.h, category=SWHDR
          short-label=include::Mcu_SCG.h, category=SWHDR
          short-label=include::Mcu_SCG_Types.h, category=SWHDR
          short-label=include::Mcu_SIM.h, category=SWHDR
          short-label=include::Mcu_SIM_Types.h, category=SWHDR
          short-label=include::Mcu_SMC.h, category=SWHDR
          short-label=include::Mcu_SMC_Types.h, category=SWHDR
          short-label=include::Reg_eSys_CMU.h, category=SWHDR
          short-label=include::Reg_eSys_CortexM4.h, category=SWHDR
          short-label=include::Reg_eSys_PCC.h, category=SWHDR
          short-label=include::Reg_eSys_PMC.h, category=SWHDR
          short-label=include::Reg_eSys_RCM.h, category=SWHDR
          short-label=include::Reg_eSys_SCG.h, category=SWHDR
          short-label=include::Reg_eSys_SIM.h, category=SWHDR
          short-label=include::Reg_eSys_SMC.h, category=SWHDR
          short-label=src::Mcu.c, category=SWSRC
          short-label=src::Mcu_CMU.c, category=SWSRC
          short-label=src::Mcu_CMU_Irq.c, category=SWSRC
          short-label=src::Mcu_CortexM4.c, category=SWSRC
          short-label=src::Mcu_IPW.c, category=SWSRC
          short-label=src::Mcu_IPW_Irq.c, category=SWSRC
          short-label=src::Mcu_PCC.c, category=SWSRC
          short-label=src::Mcu_PMC.c, category=SWSRC
          short-label=src::Mcu_PMC_Irq.c, category=SWSRC
          short-label=src::Mcu_RCM.c, category=SWSRC
          short-label=src::Mcu_RCM_Irq.c, category=SWSRC
          short-label=src::Mcu_SCG.c, category=SWSRC
          short-label=src::Mcu_SIM.c, category=SWSRC
          short-label=src::Mcu_SMC.c, category=SWSRC
    compiler GHS_Compiler:
      name=Green Hills
      options=-cpu=cortexm4 -cpu=cortexm0plus -ansi -Osize -dual_debug -G --no_exceptions -Wundef -Wimplicit-int -Wshadow -Wtrigraphs -Wall --prototype_errors --incorrect_pragma_warnings -noslashcomment -preprocess_assembly_files -nostartfile --short_enum -c --no_commons -keeptempfiles -list -DAUTOSAR_OS_NOT_USED -DDISABLE_MCAL_INTERMODULE_ASR_CHECK -DGHS
      vendor=Green Hills
      version=Green Hills Multi 7.1.4 / Compiler 2017.1.4
    compiler IAR_Compiler: name=IAR Compiler, options=--cpu=Cortex-M4 --cpu=Cortex-M0+ --cpu_mode=thumb --endian=little -Ohz -c --no_clustering --no_mem_idioms --no_explicit_zero_opt --debug --diag_suppress=Pa050 -DAUTOSAR_OS_NOT_USED -DIAR --require_prototypes --no_wrap_diagnostics --no_system_include -e, vendor=IAR Systems, version=IAR: V8.11.2
    generated-artifacts:
      dependency on artifact Mcu_PBcfg_c: artifact-descriptor={short-label=generate_PB::src::Mcu_PBcfg.c, category=SWSRC}, usages=COMPILE
      dependency on artifact Mcu_Cfg_h: artifact-descriptor={short-label=generate_PC::include::Mcu_Cfg.h, category=SWHDR}, usages=COMPILE
      dependency on artifact Mcu_Cfg_c: artifact-descriptor={short-label=generate_PC::src::Mcu_Cfg.c, category=SWSRC}, usages=COMPILE
    linker GHS_Linker: name=Green Hills, options=-Mn -delete -v -ignore_debug_references -map -keepmap -lstartup -lsys -larch -lansi -L(/lib/thumb2) -lutf8_s32, vendor=Green Hills, version=Green Hills Multi 7.1.4 / Compiler 2017.1.4
    linker IAR_Linker: name=IAR Compiler, options=--cpu=Cortex-M4 --cpu=Cortex-M0+ --map filename --no_library_search --entry _start --enable_stack_usage --skip_dynamic_initialization --no_wrap_diagnostics --config, vendor=IAR Systems, version=IAR: V8.11.2
    resource consumption ResourceConsumption
      7 x memory section:
        MCU_CODE: alignment=UNSPECIFIED, sw-addrmethod=CODE, symbol=CODE
        MCU_CONFIG_DATA_UNSPECIFIED: alignment=UNSPECIFIED, sw-addrmethod=CONFIG_DATA, symbol=CONFIG_DATA_UNSPECIFIED
        MCU_CONST_32: alignment=32, sw-addrmethod=CONST, symbol=CONST_32
        MCU_CONST_UNSPECIFIED: alignment=UNSPECIFIED, sw-addrmethod=CONST, symbol=CONST_UNSPECIFIED
        MCU_VAR_INIT_32: alignment=32, sw-addrmethod=VAR_INIT, symbol=VAR_INIT_32
        MCU_VAR_INIT_UNSPECIFIED: alignment=UNSPECIFIED, sw-addrmethod=VAR_INIT, symbol=VAR_INIT_UNSPECIFIED
        MCU_VAR_NO_INIT_8: alignment=8, sw-addrmethod=VAR_NO_INIT, symbol=VAR_NO_INIT_8
