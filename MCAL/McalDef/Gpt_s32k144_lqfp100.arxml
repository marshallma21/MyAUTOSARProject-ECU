AUTOSAR XML (schema 4-3-0)
package /TS_T40D2M10I2R0
  ecuc definition collection Gpt_EcuParameterDefinition: module=Gpt
  module definition Gpt: post-build-variant-support=true, refined-module-def=Gpt, variants post-build/pre-compile  # Configuration of the Gpt (General Purpose Timer) module.
    container GptChannelConfigSet  # This container is the base of an Configuration Set which contains the configured GPT channels. This way, different configuration sets can be defined for post-build process.
      container GptChannelConfiguration [1..*]: multiplicity set at pre-compile  # This container contains the channel-wide configuration (parameters) of the GPT Driver
        integer GptChannelId: 0..4294967295, scope=ECU, set at post-build in variant post-build / pre-compile in variant pre-compile, symbolic-name-value=true, default-value=0  # Channel Id of the GPT channel. This value will be assigned to the symbolic name derived of the GptChannelConfiguration container short name.
        enumeration GptHwChannel: {LPIT_0_CH_0, LPIT_0_CH_1, LPIT_0_CH_2, LPIT_0_CH_3, FTM_0_CH_0, FTM_0_CH_1, FTM_0_CH_2, FTM_0_CH_3, FTM_0_CH_4, FTM_0_CH_5, FTM_0_CH_6, FTM_0_CH_7, FTM_1_CH_0, FTM_1_CH_1, FTM_1_CH_2, FTM_1_CH_3, FTM_1_CH_4, FTM_1_CH_5, FTM_1_CH_6, FTM_1_CH_7, FTM_2_CH_0, FTM_2_CH_1, FTM_2_CH_2, FTM_2_CH_3, FTM_2_CH_4, FTM_2_CH_5, FTM_2_CH_6, FTM_2_CH_7, FTM_3_CH_0, FTM_3_CH_1, FTM_3_CH_2, FTM_3_CH_3, FTM_3_CH_4, FTM_3_CH_5, FTM_3_CH_6, FTM_3_CH_7, LPTMR_0_CH_0, SRTC_0_CH_0}, origin=NXP, set at pre-compile in variant pre-compile / post-build in variant post-build, default-value=LPIT_0_CH_0  # Vendor specific: Selects the physical GPT Channel.
        enumeration GptChannelMode: {GPT_CH_MODE_CONTINUOUS, GPT_CH_MODE_ONESHOT}, scope=ECU, post-build-variant-value=true, set at post-build in variant post-build / pre-compile in variant pre-compile, default-value=GPT_CH_MODE_ONESHOT  # Specifies the behaviour of the timerchannel after the timeout has expired
        float GptChannelTickFrequency: 0.0..1.6E8, scope=ECU, post-build-variant-value=true, set at post-build in variant post-build / pre-compile in variant pre-compile, default-value=1.0  # EN: Specifies the tick frequency of the timer channel in Hz.
        integer GptFtmPrescaler [0..1]: 1..128, multiplicity set at pre-compile in variant pre-compile / post-build in variant post-build, origin=NXP, post-build-variant-value=true, set at pre-compile in variant pre-compile / post-build in variant post-build, default-value=1  # Vendor specific: The GPT module specific clock prescaler value. Selects one of 8 division factors for the clock source selected by GptChannelClkSrcRef. The new prescaler factor affects the clock source on the next system clock cycle after the new value is updated into the register bits. 1 - Value written in register: 0 2 - Value written in register: 1 4 - Value written in register: 2 8 - Value written in register: 3 16 - Value written in register: 4 32 - Value written in register: 5 64 - Value written in register: 6 128 - Value written in register: 7
        integer GptFtmPrescaler_Alternate [0..1]: 1..128, multiplicity set at pre-compile in variant pre-compile / post-build in variant post-build, origin=NXP, post-build-variant-value=true, set at pre-compile in variant pre-compile / post-build in variant post-build, default-value=1  # Vendor specific: The GPT module specific clock prescaler value. Selects one of 8 division factors for the clock source selected by GptChannelClkSrcRef. The new prescaler factor affects the clock source on the next system clock cycle after the new value is updated into the register bits. 1 - Value written in register: 0 2 - Value written in register: 1 4 - Value written in register: 2 8 - Value written in register: 3 16 - Value written in register: 4 32 - Value written in register: 5 64 - Value written in register: 6 128 - Value written in register: 7
        integer GptLptmrPrescaler [0..1]: 1..65536, multiplicity set at pre-compile in variant pre-compile / post-build in variant post-build, origin=NXP, post-build-variant-value=true, set at pre-compile in variant pre-compile / post-build in variant post-build, default-value=2  # Vendor specific: The GPT module specific clock prescaler value. Configures the Prescaler in Time Counter mode, from one of 16 divisions. 2 - Value written in register is 0 4 - Value written in register is 1 8 - Value written in register is 2 16 - Value written in register is 3 32 - Value written in register is 4 64 - Value written in register is 5 128 - Value written in register is 6 256 - Value written in register is 7 512 - Value written in register is 8 1024 - Value written in register is 9 2048 - Value written in register is 10 4096 - Value written in register is 11 8192 - Value written in register is 12 16384 - Value written in register is 13 32768 - Value written in register is 14 65536 - Value written in register is 15
        integer GptLptmrPrescaler_Alternate [0..1]: 1..65536, multiplicity set at pre-compile in variant pre-compile / post-build in variant post-build, origin=NXP, post-build-variant-value=true, set at pre-compile in variant pre-compile / post-build in variant post-build, default-value=2  # Vendor specific: The GPT module specific clock prescaler value. Configures the Prescaler in Time Counter mode, from one of 16 divisions. 2 - Value written in register is 0 4 - Value written in register is 1 8 - Value written in register is 2 16 - Value written in register is 3 32 - Value written in register is 4 64 - Value written in register is 5 128 - Value written in register is 6 256 - Value written in register is 7 512 - Value written in register is 8 1024 - Value written in register is 9 2048 - Value written in register is 10 4096 - Value written in register is 11 8192 - Value written in register is 12 16384 - Value written in register is 13 32768 - Value written in register is 14 65536 - Value written in register is 15
        enumeration GptFtmChannelClkSrc [0..1]: {SYSTEM_CLOCK, FIXED_FREQUENCY_CLOCK, EXTERNAL_CLOCK}, multiplicity set at pre-compile in variant pre-compile / post-build in variant post-build, origin=NXP, post-build-variant-value=true, set at pre-compile in variant pre-compile / post-build in variant post-build, default-value=SYSTEM_CLOCK  # Vendor specific: The GPT module specific clock input for the timer unit can statically be configured and allows to select different clock sources per module. Select the clock source for the FlexTimer module for this platform. SYSTEM_CLOCK FIXED_FREQUENCY_CLOCK EXTERNAL_CLOCK
        enumeration GptLptmrChannelClkSrc [0..1]: {SIRCDIV2_CLK, LPO1K_CLK, RTC_CLK, PCC_LPTMR0}, multiplicity set at pre-compile in variant pre-compile / post-build in variant post-build, origin=NXP, post-build-variant-value=true, set at pre-compile in variant pre-compile / post-build in variant post-build, default-value=SIRCDIV2_CLK  # Vendor specific: The GPT module specific clock input for the timer unit can statically be configured and allows to select different clock sources per module. Select the clock source for the Low Power Timer module for this platform. SIRCDIV2_CLK LPO1K_CLK RTC_CLK PCC_LPTMR0
        enumeration GptSRtcChannelClkSrc [0..1]: {EXTERNAL_CLOCK, LPO1K_CLK}, multiplicity set at pre-compile in variant pre-compile / post-build in variant post-build, origin=NXP, post-build-variant-value=true, set at pre-compile in variant pre-compile / post-build in variant post-build, default-value=EXTERNAL_CLOCK  # Vendor specific: The GPT module specific clock input for the timer unit can statically be configured and allows to select different clock sources per module. Select the clock source for the Real Time Clock module for this platform. EXTERNAL_CLOCK LPO1K_CLK
        boolean GptLPitIsExternalTrigger: origin=NXP, post-build-variant-value=true, set at pre-compile in variant pre-compile / post-build in variant post-build, default-value=false  # Select between external/internal trigger sources.
        boolean GptLPitEnReloadOnTrigger: origin=NXP, post-build-variant-value=true, set at pre-compile in variant pre-compile / post-build in variant post-build, default-value=false  # LPIT TImer channel will Reload Timer at each rising edge of trigger source.
        boolean GptLPitEnStopOnInterrupt: origin=NXP, post-build-variant-value=true, set at pre-compile in variant pre-compile / post-build in variant post-build, default-value=false  # LPIT Timer Channel will stop when its interrupt occurs.
        boolean GptLPitEnStartOnTrigger: origin=NXP, post-build-variant-value=true, set at pre-compile in variant pre-compile / post-build in variant post-build, default-value=false  # LPIT Timer Channel will Start at each rising edge of Trigger Signal.
        enumeration GptLPitTriggerChannels [0..1]: {Channel_0_Trigger_Source, Channel_1_Trigger_Source, Channel_2_Trigger_Source, Channel_3_Trigger_Source, Channel_4_Trigger_Source, Channel_5_Trigger_Source, Channel_6_Trigger_Source, Channel_7_Trigger_Source, Channel_8_Trigger_Source, Channel_9_Trigger_Source, Channel_10_Trigger_Source, Channel_11_Trigger_Source, Channel_12_Trigger_Source, Channel_13_Trigger_Source, Channel_14_Trigger_Source, Channel_15_Trigger_Source}, multiplicity set at pre-compile in variant pre-compile / post-build in variant post-build, origin=NXP, post-build-variant-value=true, set at pre-compile in variant pre-compile / post-build in variant post-build, default-value=Channel_0_Trigger_Source  # Vendor specific: LPIT External Trigger Channels Select. Trigger Channels can be selected from 16 external sources. 0 Timer channel 0 trigger source is selectd. 1 Timer channel 1 trigger source is selectd. .. ........ 14 Timer channel 14 trigger source is selectd. 15 Timer channel 15 trigger source is selectd.
        integer GptChannelTickValueMax: 65535..4294967295, post-build-variant-value=true, set at pre-compile in variant pre-compile / post-build in variant post-build, default-value=4294967295  # Maximum value in ticks, the timer channel is able to count. With the next tick, the timer rolls over to zero. There is mandatory to set 4294967295 for the LPIT and SRTC channels (coresponding to the 32 bits counter resolution) and 65535 for the FTM and LPTMR channels (corresponding to the 16 bits counter resolution)!
        boolean GptFreezeEnable: origin=NXP, set at pre-compile in variant pre-compile / post-build in variant post-build, default-value=true  # Vendor specific: Select to set Freeze enable for the hw resources. For FlexTimer channels the freeze option must be the same for all channels belonging to the same module.
        boolean GptEnableWakeup: post-build-variant-value=true, set at post-build in variant post-build / pre-compile in variant pre-compile, default-value=false  # Enables wakeup capability of CPU for a channel.
        function name GptNotification [0..1]: multiplicity set at pre-compile in variant pre-compile / post-build in variant post-build, post-build-variant-multiplicity=true, post-build-variant-value=true, set at pre-compile in variant pre-compile / post-build in variant post-build, default-value=NULL_PTR  # Function pointer to callback function(for non-wakeup notification). The field is editable only if the switch GptEnableDisableNotificationApi is true.
        reference GptChannelClkSrcRef: post-build-variant-value=true, set at post-build in variant post-build / pre-compile in variant pre-compile, destination=GptClockReferencePoint  # Reference to the GptClockReferencePoint from which the channel clock is derived.
        container GptWakeupConfiguration [0..1]: multiplicity set at pre-compile  # This container defines the wakeup source codes reported to Ecu State Manager.
          symbolic name reference GptWakeupSourceRef: post-build-variant-value=true, set at post-build in variant post-build / pre-compile in variant pre-compile, destination=EcuMWakeupSource  # In case the wakeup-capability is true this value is transmitted to the Ecu State Manager. Implementation Type: reference to EcuM_WakeupSourceType
    container GptHwConfiguration [22..22]  # List of all HW channel resources for GPT module.
      enumeration GptIsrHwId: {LPIT_0_CH_0, LPIT_0_CH_1, LPIT_0_CH_2, LPIT_0_CH_3, FTM_0_CH_0_CH_1, FTM_0_CH_2_CH_3, FTM_0_CH_4_CH_5, FTM_0_CH_6_CH_7, FTM_1_CH_0_CH_1, FTM_1_CH_2_CH_3, FTM_1_CH_4_CH_5, FTM_1_CH_6_CH_7, FTM_2_CH_0_CH_1, FTM_2_CH_2_CH_3, FTM_2_CH_4_CH_5, FTM_2_CH_6_CH_7, FTM_3_CH_0_CH_1, FTM_3_CH_2_CH_3, FTM_3_CH_4_CH_5, FTM_3_CH_6_CH_7, LPTMR_0_CH_0, SRTC_0_CH_0}, origin=NXP, set at pre-compile, symbolic-name-value=true, default-value=LPIT_0_CH_1  # ID of HW interrupt resources.
      boolean GptIsrEnable: origin=NXP, set at pre-compile, default-value=false  # Enable/Disable HW channels' Interrupt Sources.
      boolean GptModuleIsUsed: origin=NXP, set at pre-compile, default-value=false  # This column configures HW channels which are going to be used.
    container GptConfigurationOfOptApiServices  # This container contains all configuration switches for configuring optional API services of the GPT driver.
      boolean GptDeinitApi: set at pre-compile, default-value=true  # Adds / removes the service Gpt_DeInit() from the code.
      boolean GptEnableDisableNotificationApi: set at pre-compile, default-value=true  # Adds / removes the services Gpt_EnableNotification() and Gpt_DisableNotification from the code.
      boolean GptTimeElapsedApi: set at pre-compile, default-value=true  # Adds / removes the service Gpt_GetTimeElapsed() from the code.
      boolean GptTimeRemainingApi: set at pre-compile, default-value=true  # Adds / removes the service Gpt_GetTimeRemaining() from the code.
      boolean GptVersionInfoApi: set at pre-compile, default-value=true  # Adds / removes the service Gpt_GetVersionInfo() from the code.
      boolean GptWakeupFunctionalityApi: set at pre-compile, default-value=true  # Adds / removes the services Gpt_SetMode(), Gpt_EnableWakeup() Gpt_DisableWakeup() and Gpt_Cbk_CheckWakeup() from the code.
      boolean GptPredefTimerFunctionalityApi: origin=NXP, set at pre-compile, default-value=true  # Adds / removes the services Gpt_SetMode(), Gpt_EnableWakeup() Gpt_DisableWakeup() and Gpt_Cbk_CheckWakeup() from the code.
    container GptNonAUTOSAR  # Enabling the settings of this section will configure the driver in a mode not compliant with AUTOSAR requirements.
      boolean GptEnableUserModeSupport: origin=NXP, set at pre-compile, default-value=false  # When this parameter is enabled, the MDL module will adapt to run from User Mode, with the following measures: (if applicable) a) configuring REG_PROT for ABC1, ABC2 IPs so that the registers under protection can be accessed from user mode by setting UAA bit in REG_PROT_GCR to 1 (if applicable) b) using 'call trusted function' stubs for all internal function calls that access registers requiring supervisor mode. (if applicable) c) other module specific measures for more information, please see chapter 5.7 User Mode Support in IM
      boolean GptStandbyWakeupSupport: origin=NXP, set at pre-compile, default-value=false  # The driver shall NOT CLEAR the interrupt flag, the interrupt enable bit and also should not disable the counter, during init (Gpt_SRtc_Init()) the flag is already set.
      boolean GptEnableDualClockMode: origin=NXP, set at pre-compile, default-value=false  # Enables prescaler settings at mode transition.true: Enabled.false: Disabled. Note This feature is not required by Autosar.
      boolean GptChangeNextTimeoutValueApi: origin=NXP, set at pre-compile, default-value=false  # Vendor specific: Enables settings for changing the channel counter compare value of a running counter. Note This API can be used FTM channels.
      boolean GptEnableTriggers: origin=NXP, set at pre-compile, default-value=false  # Enable Trigger Mode.true: Enabled.false: Disabled. Note This feature is not required by Autosar.
    container GptDriverConfiguration  # This container contains the module-wide configuration (parameters) of the GPT Driver.
      boolean GptDevErrorDetect: set at pre-compile, default-value=true  # Enables/Disables development error detection.
      boolean GptPredefTimer100us32bitEnable: scope=ECU, set at pre-compile, default-value=false  # Enables/Disables the feature 100us/ tick
      enumeration GptPredefTimer1usEnablingGrade: {GPT_PREDEF_TIMER_1US_16BIT_ENABLED, GPT_PREDEF_TIMER_1US_16_24BIT_ENABLED, GPT_PREDEF_TIMER_1US_16_24_32BIT_ENABLED, GPT_PREDEF_TIMER_1US_DISABLED}, scope=ECU, set at pre-compile, default-value=GPT_PREDEF_TIMER_1US_16BIT_ENABLED  # Specifies the grade of enabling the GPT Predef Timers with 1us tick duration.
      boolean GptReportWakeupSource: set at pre-compile, default-value=true  # Enables/Disables wakeup source reporting.
      enumeration GptRegisterLockingMode: {NO_REGISTER_LOCKING}, origin=NXP, set at pre-compile, default-value=NO_REGISTER_LOCKING  # GptRegisterLockingMode can take following values: UserModeSoftLocking: each function writing to hardware registers is responsible for maintaining the register soft locking mechanism; no additional actions needed in the configuration locking mechanism; the register locking management is available in user mode. SupervisorModeSoftLocking: the functions writing the hardware registers use register writes without locking; the configuration locking/unlocking functions are responsible for applying/releasing the register soft locking in supervisor mode only.
      container GptClockReferencePoint [1..*]: multiplicity set at pre-compile  # This container contains a parameter, which represents a reference to a container of the type McuClockReferencePoint (defined in module MCU).
        reference GptClockReference: set at pre-compile, destination=McuClockReferencePoint  # Reference to a container of the type McuClockReferencePoint, to select an input clock.
    container GptPredefTimerConfiguration  # Container for configuring the Predefined Timer functionality.
      container GptPredefTimer_1us_16Bit [0..1]: multiplicity set at pre-compile  # This container contains the 1U_16BIT predef timer configuration (parameters) of the GPT Driver
        enumeration GptHwChannel: {FTM_0_CH_0, FTM_0_CH_1, FTM_0_CH_2, FTM_0_CH_3, FTM_0_CH_4, FTM_0_CH_5, FTM_0_CH_6, FTM_0_CH_7, FTM_1_CH_0, FTM_1_CH_1, FTM_1_CH_2, FTM_1_CH_3, FTM_1_CH_4, FTM_1_CH_5, FTM_1_CH_6, FTM_1_CH_7, FTM_2_CH_0, FTM_2_CH_1, FTM_2_CH_2, FTM_2_CH_3, FTM_2_CH_4, FTM_2_CH_5, FTM_2_CH_6, FTM_2_CH_7, FTM_3_CH_0, FTM_3_CH_1, FTM_3_CH_2, FTM_3_CH_3, FTM_3_CH_4, FTM_3_CH_5, FTM_3_CH_6, FTM_3_CH_7, LPTMR_0_CH_0}, origin=NXP, set at pre-compile in variant pre-compile / post-build in variant post-build, default-value=FTM_0_CH_0  # Vendor specific: Selects the physical GPT Channel. LPIT and SRTC are not use for this feature
        integer GptChannelPrescaler: 0..65536, origin=NXP, post-build-variant-value=true, set at pre-compile in variant pre-compile / post-build in variant post-build, default-value=0  # Vendor specific: The GPT module specific clock prescaler value. For the FTM module. Selects one of 8 division factors for the clock source selected by GptChannelClkSrcRef. 1 - Value written in register: 0 2 - Value written in register: 1 4 - Value written in register: 2 8 - Value written in register: 3 16 - Value written in register: 4 32 - Value written in register: 5 64 - Value written in register: 6 128 - Value written in register: 7 For the LPTMR module. Configures the size of the Prescaler in Time Counter mode, from one of 16 divisions. 2 - Value written in register is 0 4 - Value written in register is 1 8 - Value written in register is 2 16 - Value written in register is 3 32 - Value written in register is 4 64 - Value written in register is 5 128 - Value written in register is 6 256 - Value written in register is 7 512 - Value written in register is 8 1024 - Value written in register is 9 2048 - Value written in register is 10 4096 - Value written in register is 11 8192 - Value written in register is 12 16384 - Value written in register is 13 32768 - Value written in register is 14 65536 - Value written in register is 15
        enumeration GptFtmChannelClkSrc: {SYSTEM_CLOCK, FIXED_FREQUENCY_CLOCK, EXTERNAL_CLOCK}, origin=NXP, set at pre-compile, default-value=SYSTEM_CLOCK  # Vendor specific: The GPT module specific clock input for the timer unit can statically be configured and allows to select different clock sources per module. Select the clock source for the FlexTimer module for this platform. SYSTEM_CLOCK FIXED_FREQUENCY_CLOCK EXTERNAL_CLOCK
        enumeration GptLptmrChannelClkSrc: {SIRCDIV2_CLK, LPO1K_CLK, RTC_CLK, PCC_LPTMR0}, origin=NXP, set at pre-compile, default-value=SIRCDIV2_CLK  # Vendor specific: The GPT module specific clock input for the timer unit can statically be configured and allows to select different clock sources per module. Select the clock source for the Low Power Timer module for this platform. SIRCDIV2_CLK LPO1K_CLK RTC_CLK PCC_LPTMR0
        boolean GptFreezeEnable: origin=NXP, set at pre-compile, default-value=true  # Vendor specific: Select to set Freeze enable for the hw resources.
        reference GptChannelClkSrcRef: origin=NXP, post-build-variant-value=true, set at pre-compile in variant pre-compile / post-build in variant post-build, destination=GptClockReferencePoint  # Reference to the GptClockReferencePoint from which the channel clock is derived.
      container GptPredefTimer_1us_24Bit [0..0]  # This container contains the channel-wide configuration (parameters) of the GPT Driver
        enumeration GptHwChannel: {NOT_APPLICABLE}, origin=NXP, set at pre-compile, default-value=NOT_APPLICABLE  # Vendor specific: Selects the physical GPT Channel. LPIT and SRTC not use for this feature
        integer GptChannelPrescaler: 0..15, origin=NXP, set at pre-compile, default-value=0  # Vendor specific: The GPT module specific clock prescaler value. For the FTM module. Selects one of 8 division factors for the clock source selected by GptChannelClkSrcRef. 0 - Clock divided by 1 1 - Clock divided by 2 2 - Clock divided by 4 3 - Clock divided by 8 4 - Clock divided by 16 5 - Clock divided by 32 6 - Clock divided by 64 7 - Clock divided by 128 For the LPTMR module. Configures the size of the Prescaler in Time Counter mode, from one of 16 divisions. 0 - Clock divided by 2 1 - Clock divided by 4 2 - Clock divided by 8 3 - Clock divided by 16 4 - Clock divided by 32 5 - Clock divided by 64 6 - Clock divided by 128 7 - Clock divided by 256 8 - Clock divided by 512 9 - Clock divided by 1024 10 - Clock divided by 2048 11 - Clock divided by 4096 12 - Clock divided by 8192 13 - Clock divided by 16384 14 - Clock divided by 32768 15 - Clock divided by 65536
        boolean GptFreezeEnable: origin=NXP, set at pre-compile, default-value=true  # Vendor specific: Select to set Freeze enable for the hw resources.
        reference GptChannelClkSrcRef: origin=NXP, set at pre-compile, destination=GptClockReferencePoint  # Reference to the GptClockReferencePoint from which the channel clock is derived.
      container GptPredefTimer_1us_32Bit [0..0]  # This container contains the predef timer configuration (parameters) of the GPT Driver
        enumeration GptHwChannel: {NOT_APPLICABLE}, origin=NXP, set at pre-compile, default-value=NOT_APPLICABLE  # Vendor specific: Selects the physical GPT Channel. LPIT and SRTC not use for this feature
        integer GptChannelPrescaler: 0..15, origin=NXP, set at pre-compile, default-value=0  # Vendor specific: The GPT module specific clock prescaler value. For the FTM module. Selects one of 8 division factors for the clock source selected by GptChannelClkSrcRef. 0 - Clock divided by 1 1 - Clock divided by 2 2 - Clock divided by 4 3 - Clock divided by 8 4 - Clock divided by 16 5 - Clock divided by 32 6 - Clock divided by 64 7 - Clock divided by 128 For the LPTMR module. Configures the size of the Prescaler in Time Counter mode, from one of 16 divisions. 0 - Clock divided by 2 1 - Clock divided by 4 2 - Clock divided by 8 3 - Clock divided by 16 4 - Clock divided by 32 5 - Clock divided by 64 6 - Clock divided by 128 7 - Clock divided by 256 8 - Clock divided by 512 9 - Clock divided by 1024 10 - Clock divided by 2048 11 - Clock divided by 4096 12 - Clock divided by 8192 13 - Clock divided by 16384 14 - Clock divided by 32768 15 - Clock divided by 65536
        boolean GptFreezeEnable: origin=NXP, set at pre-compile, default-value=true  # Vendor specific: Select to set Freeze enable for the hw resources.
        reference GptChannelClkSrcRef: origin=NXP, set at pre-compile, destination=GptClockReferencePoint  # Reference to the GptClockReferencePoint from which the channel clock is derived.
      container GptPredefTimer_100us_32Bit [0..0]  # This container contains the channel-wide configuration (parameters) of the GPT Driver
        enumeration GptHwChannel: {NOT_APPLICABLE}, origin=NXP, set at pre-compile, default-value=NOT_APPLICABLE  # Vendor specific: Selects the physical GPT Channel. LPIT and SRTC not use for this feature
        integer GptChannelPrescaler: 0..15, origin=NXP, set at pre-compile, default-value=0  # Vendor specific: The GPT module specific clock prescaler value. For the FTM module. Selects one of 8 division factors for the clock source selected by GptChannelClkSrcRef. 0 - Clock divided by 1 1 - Clock divided by 2 2 - Clock divided by 4 3 - Clock divided by 8 4 - Clock divided by 16 5 - Clock divided by 32 6 - Clock divided by 64 7 - Clock divided by 128 For the LPTMR module. Configures the size of the Prescaler in Time Counter mode, from one of 16 divisions. 0 - Clock divided by 2 1 - Clock divided by 4 2 - Clock divided by 8 3 - Clock divided by 16 4 - Clock divided by 32 5 - Clock divided by 64 6 - Clock divided by 128 7 - Clock divided by 256 8 - Clock divided by 512 9 - Clock divided by 1024 10 - Clock divided by 2048 11 - Clock divided by 4096 12 - Clock divided by 8192 13 - Clock divided by 16384 14 - Clock divided by 32768 15 - Clock divided by 65536
        boolean GptFreezeEnable: origin=NXP, set at pre-compile, default-value=true  # Vendor specific: Select to set Freeze enable for the hw resources.
        reference GptChannelClkSrcRef: origin=NXP, set at pre-compile, destination=GptClockReferencePoint  # Reference to the GptClockReferencePoint from which the channel clock is derived.
    container CommonPublishedInformation  # Common container, aggregated by all modules. It contains published information about vendor and versions.
      integer ArReleaseMajorVersion: 4..4, origin=NXP, set at pre-compile, default-value=4  # Major version number of AUTOSAR specification on which the appropriate implementation is based on.
      integer ArReleaseMinorVersion: 2..2, origin=NXP, set at pre-compile, default-value=2  # Minor version number of AUTOSAR specification on which the appropriate implementation is based on.
      integer ArReleaseRevisionVersion: 2..2, origin=NXP, set at pre-compile, default-value=2  # Revision version number of AUTOSAR specification on which the appropriate implementation is based on.
      integer ModuleId: 100..100, origin=NXP, set at pre-compile, default-value=100  # Module ID of this module from Module List.
      integer SwMajorVersion: 1..1, origin=NXP, set at pre-compile, default-value=1  # Major version number of the vendor specific implementation of the module. The numbering is vendor specific.
      integer SwMinorVersion: 0..0, origin=NXP, set at pre-compile, default-value=0  # Minor version number of the vendor specific implementation of the module. The numbering is vendor specific.
      integer SwPatchVersion: 2..2, origin=NXP, set at pre-compile, default-value=2  # Patch level version number of the vendor specific implementation of the module. The numbering is vendor specific.
      string VendorApiInfix [0..1]: multiplicity set at pre-compile, origin=NXP, set at pre-compile  # In driver modules which can be instantiated several times on a single ECU, BSW00347 requires that the name of APIs is extended by the VendorId and a vendor specific name. This parameter is used to specify the vendor specific name. In total, the implementation specific name is generated as follows: <ModuleName><VendorId><VendorApiInfix>. E.g. assuming that the VendorId of the implementor is 123 and the implementer chose a VendorApiInfix of "v11r456" a api name Can_Write defined in the SWS will translate to Can_123_v11r456Write. This parameter is mandatory for all modules with upper multiplicity > 1. It shall not be used for modules with upper multiplicity =1.
      integer VendorId: 43..43, origin=NXP, set at pre-compile, default-value=43  # Vendor ID of the dedicated implementation of this module according to the AUTOSAR vendor list.
