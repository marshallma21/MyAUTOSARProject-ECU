AUTOSAR XML (schema 4-3-0)
package /TS_T40D2M10I2R0
  ecuc definition collection Eth_EcuParameterDefinition: module=Eth
  module definition Eth [1..*]: post-build-variant-support=true, refined-module-def=Eth, variants link-time/post-build/pre-compile  # Configuration of the Eth (Ethernet Driver) module.
    container EthConfigSet  # This container contains the configuration parameters and sub containers of the AUTOSAR Eth module.
      container EthCtrlConfig [1..*]: multiplicity set at pre-compile  # Configuration of the individual controller
        boolean EthCtrlEnableMii: set at pre-compile, default-value=true  # Enables / Disables Media Independent Interface (MII) for transceiver access
        boolean EthCtrlEnableRxInterrupt: set at pre-compile, default-value=true  # Enables / Disables receive interrupt
        boolean EthCtrlEnableTxInterrupt: set at pre-compile, default-value=true  # Enables / Disables transmit interrupt
        integer EthCtrlIdx: 0..255, scope=ECU, set at pre-compile, symbolic-name-value=true, default-value=0  # Specifies the instance ID of the configured controller.
        string EthCtrlPhyAddress [0..1]: multiplicity set at link in variant link-time / post-build in variant post-build / pre-compile in variant pre-compile, post-build-variant-multiplicity=true, post-build-variant-value=true, set at link in variant link-time / post-build in variant post-build / pre-compile in variant pre-compile, default-value=66:55:44:33:22:11  # Specifies the unique 48-bit physical address (MAC address) of the controller in network byte order.
        integer EthCtrlRxBufLenByte: 0..1522, post-build-variant-value=true, set at link in variant link-time / post-build in variant post-build / pre-compile in variant pre-compile, default-value=64  # Limits the maximum receive buffer length (frame length) in bytes. To compute the value: the frame payload length shall be extended by 14 bytes for frame header and 4 bytes for the frame CRC, then it shall be increased to a multiple of 16 bytes.
        integer EthCtrlTxBufLenByte: 0..1522, post-build-variant-value=true, set at link in variant link-time / post-build in variant post-build / pre-compile in variant pre-compile, default-value=64  # Limits the maximum transmit buffer length (frame length) in bytes. Maximal frame payload is equal to the configured value decreased by 14 bytes that are used for the frame header.
        integer EthRxBufTotal: 0..255, post-build-variant-value=true, set at link in variant link-time / post-build in variant post-build / pre-compile in variant pre-compile, default-value=16  # Configures the number of receive buffers.
        integer EthTxBufTotal: 0..255, post-build-variant-value=true, set at link in variant link-time / post-build in variant post-build / pre-compile in variant pre-compile, default-value=16  # Configures the number of transmit buffers.
        container EthDemEventParameterRefs [0..1]: multiplicity set at link in variant link-time / post-build in variant post-build / pre-compile in variant pre-compile  # Container for the references to DemEventParameter elements which shall be invoked using the API Dem_ReportErrorStatus in case the corresponding error occurs. The EventId is taken from the referenced DemEventParameter's DemEventId value. The standardized errors are provided in the container and can be extended by vendor specific error references.
          symbolic name reference ETH_E_ACCESS [0..1]: multiplicity set at link in variant link-time / post-build in variant post-build / pre-compile in variant pre-compile, set at link in variant link-time / post-build in variant post-build / pre-compile in variant pre-compile, destination=DemEventParameter  # Reference to the DemEventParameter which shall be issued when the error "Controller access failed" has occured.
          symbolic name reference ETH_E_ALIGNMENT [0..1]: multiplicity set at link in variant link-time / post-build in variant post-build / pre-compile in variant pre-compile, set at link in variant link-time / post-build in variant post-build / pre-compile in variant pre-compile, destination=DemEventParameter  # Reference to the DemEventParameter which shall be issued when the error "Alignment Error" has occured.
          symbolic name reference ETH_E_CRC [0..1]: multiplicity set at link in variant link-time / post-build in variant post-build / pre-compile in variant pre-compile, set at link in variant link-time / post-build in variant post-build / pre-compile in variant pre-compile, destination=DemEventParameter  # Reference to the DemEventParameter which shall be issued when the error "CRC Failure" has occured.
          symbolic name reference ETH_E_LATECOLLISION [0..1]: multiplicity set at link in variant link-time / post-build in variant post-build / pre-compile in variant pre-compile, set at link in variant link-time / post-build in variant post-build / pre-compile in variant pre-compile, destination=DemEventParameter  # Reference to the DemEventParameter which shall be issued when the error "Late Collisions" has occured.
          symbolic name reference ETH_E_MULTIPLECOLLISION [0..1]: multiplicity set at link in variant link-time / post-build in variant post-build / pre-compile in variant pre-compile, set at link in variant link-time / post-build in variant post-build / pre-compile in variant pre-compile, destination=DemEventParameter  # Reference to the DemEventParameter which shall be issued when the error "Multiple Collisions" has occured.
          symbolic name reference ETH_E_OVERSIZEFRAME [0..1]: multiplicity set at link in variant link-time / post-build in variant post-build / pre-compile in variant pre-compile, set at link in variant link-time / post-build in variant post-build / pre-compile in variant pre-compile, destination=DemEventParameter  # Reference to the DemEventParameter which shall be issued when the error "Oversized Frame" has occured.
          symbolic name reference ETH_E_RX_FRAMES_LOST [0..1]: multiplicity set at link in variant link-time / post-build in variant post-build / pre-compile in variant pre-compile, set at link in variant link-time / post-build in variant post-build / pre-compile in variant pre-compile, destination=DemEventParameter  # Reference to the DemEventParameter which shall be issued when the error "receive frames lost" has occured.
          symbolic name reference ETH_E_SINGLECOLLISION [0..1]: multiplicity set at link in variant link-time / post-build in variant post-build / pre-compile in variant pre-compile, set at link in variant link-time / post-build in variant post-build / pre-compile in variant pre-compile, destination=DemEventParameter  # Reference to the DemEventParameter which shall be issued when the error "Single Collisions" has occured.
          symbolic name reference ETH_E_UNDERSIZEFRAME [0..1]: multiplicity set at link in variant link-time / post-build in variant post-build / pre-compile in variant pre-compile, set at link in variant link-time / post-build in variant post-build / pre-compile in variant pre-compile, destination=DemEventParameter  # Reference to the DemEventParameter which shall be issued when the error "Undersized Frame" has occured.
        container EthVendorSpecific  # Vendor specific: Vendor specific configuration of the individual controller
          enumeration EthPhyInterface: {MII_100Mbs, RMII_100Mbs, RGMII_100Mbs, RGMII_1000Mbs}, origin=NXP, set at pre-compile, default-value=MII_100Mbs  # Defines interface for communication with Ethernet PHY.
          boolean EthCtrlSupportMDIO: origin=NXP, set at pre-compile, default-value=true  # Enables / Disables MDIO transmit and receive for transceiver access
          integer EthInterPacketGap: 8..26, origin=NXP, post-build-variant-value=true, set at link in variant link-time / post-build in variant post-build / pre-compile in variant pre-compile, default-value=12  # Vendor specific: Size of gap in bytes beetween transmitted frames. Valid values are between 8 and 26 byte-times (64 and 516 bit-times). In full-duplex mode is IPG measured after last packet transmittion. In half-duplex mode begins to measure the IPG from CRS de-assertion. Note that only values greater than or equal 12 byte-times (96 bit times) are allowed by IEEE 802.3 specification.
          integer EthMIISpeedControl: 0..63, origin=NXP, post-build-variant-value=true, set at link in variant link-time / post-build in variant post-build / pre-compile in variant pre-compile, default-value=32  # Vendor specific: Defines MII management data clock speed according to a formula F_MDC = F_sys /(4 * EthMIISpeedControl). According to the 802.3 the F_MDC must be less than or equal to 2,5 MHz so minimal value of EthMIISpeedControl is Fsys / 10 MHz, where Fsys is the system clock frequency.
          integer EthMDIOHoldTime: 0..7, origin=NXP, post-build-variant-value=true, set at link in variant link-time / post-build in variant post-build / pre-compile in variant pre-compile, default-value=0  # Vendor specific: Holdtime on MDIO output. IEEE802.3 clause 22 defines minimum of 10ns for the holdtime on the MDIO output. Depending on the host bus freqency, the settings may need to be increased. Value means count of internal clock cycles plus one (i.e. 0x7 is eight internal module clock cycles)
          boolean EthFullDuplexEnable: origin=NXP, set at link in variant link-time / post-build in variant post-build / pre-compile in variant pre-compile, default-value=true  # Vendor specific: Enables / disables full duplex mode.
          boolean EthDropInvalidMAC: origin=NXP, post-build-variant-value=true, set at link in variant link-time / post-build in variant post-build / pre-compile in variant pre-compile, default-value=true  # Vendor specific: Enables / disables discardion of frames with MAC layer errors. If enabled, then any received frame with CRC, length or PHY error is automatically discarded in cotroller. Frame payload length is automatically checked with Frametype field to discard frame in case of inconsitency.
          boolean EthReceiveBroadcast: origin=NXP, post-build-variant-value=true, set at link in variant link-time / post-build in variant post-build / pre-compile in variant pre-compile, default-value=true  # Vendor specific: Enables / disables reception of broadcast frames.
          boolean EthEnablePromiscuousMode: origin=NXP, post-build-variant-value=true, set at link in variant link-time / post-build in variant post-build / pre-compile in variant pre-compile, default-value=false  # Vendor specific: Enables / disables promiscuous mode - all frames are received regardless the destination address.
          reference EthTimeStampReferenceClock [0..1]: multiplicity set at pre-compile, origin=NXP, post-build-variant-value=true, set at link in variant link-time / post-build in variant post-build / pre-compile in variant pre-compile, destination=McuClockReferencePoint  # This is for getting clock source which is used by ENET timer. This is required for support timestamps.
          container EthEnableLoopbackMode [0..1]: multiplicity set at link in variant link-time / post-build in variant post-build / pre-compile in variant pre-compile  # Vendor specific: Enables loopback mode (for testing purposes).
            boolean EthInternalLoopbackMode: origin=NXP, post-build-variant-value=true, set at link in variant link-time / post-build in variant post-build / pre-compile in variant pre-compile, default-value=false  # Vendor specific: Enables internal loopback mode - Receiver is internally connected with the transceiver. No external signals are used.
    container EthGeneral  # General configuration of Ethernet Driver module
      boolean EthDevErrorDetect: set at pre-compile, default-value=true  # Enables / Disables development error detection.
      boolean EthGetDropCountApi: set at pre-compile, default-value=false  # Enables / Disables Eth_GetDropCount API.
      boolean EthGetEtherStatsApi: set at pre-compile, default-value=false  # Enables / Disables Eth_GetEtherStats API.
      boolean EthGlobalTimeSupport: set at pre-compile, default-value=false  # Enables/Disables the GlobalTime APIs used amongst others by Global Time Synchronization over Ethernet.
      integer EthIndex: 0..255, set at pre-compile, default-value=0  # Specifies the InstanceId of this module instance. If only one instance is present it shall have the Id 0.
      float EthMainFunctionPeriod: 0.0..65.535, set at pre-compile, default-value=0  # Specifies the period of main function Eth_MainFunction in seconds. Ethernet driver does not require this information but the BSW scheduler. ASR define Infinity as limitation, but it is abnormal if the period is longer than 65.535 second
      integer EthMaxCtrlsSupported: set at pre-compile, default-value=1  # Limits the total number of supported controllers.
      boolean EthUpdatePhysAddrFilter: set at pre-compile, default-value=false  # Enables/Disables optional API Eth_UpdatePhysAddrFilter.
      boolean EthVersionInfoApi: set at pre-compile, default-value=true  # Enables / Disables version info API
      boolean EthEnableUserModeSupport: origin=NXP, set at pre-compile, default-value=false  # When this parameter is enabled, the Eth module will adapt to run from User Mode, with the following measures: (if applicable) a) configuring REG_PROT for the Eth Controllers so that the registers under protection eth be accessed from user mode by setting UAA bit in REG_PROT_GCR to 1 (if applicable) b) using 'call trusted function' stubs for all internal function calls that access registers requiring supervisor mode. (if applicable) c) other module specific measures for more information, please see chapter 5.7 User Mode Support in IM
      container EthCtrlOffloading  # Configuration of hardware offloading features.
        boolean EthCtrlEnableOffloadChecksumICMP: set at pre-compile, default-value=false  # Enables / Disables hardware offloading for ICMP checksums.
        boolean EthCtrlEnableOffloadChecksumIPv4: set at pre-compile, default-value=false  # Enables / Disables hardware offloading for IPv4 checksums.
        boolean EthCtrlEnableOffloadChecksumTCP: set at pre-compile, default-value=false  # Enables / Disables hardware offloading for TCP checksums.
        boolean EthCtrlEnableOffloadChecksumUDP: set at pre-compile, default-value=false  # Enables / Disables hardware offloading for UDP checksums.
      container EthVendorSpecific  # Vendor specific: General vendor specific configuration of Ethernet Driver module
        boolean EthBridgeSupport: origin=NXP, set at pre-compile, default-value=false  # Vendor specific: When this option is ON, the Ethernet Bridge feature allows difference source address.
        boolean EthDisableDemEventDetect: origin=NXP, set at pre-compile, default-value=false  # Vendor specific: When this option is ON the Diagnostic Event Manager is disabled, no diagnostic error events are reported.
        integer EthMaxTXBuffersSupported: 1..255, origin=NXP, set at pre-compile, default-value=255  # Vendor specific: Limits the total number of supported transmit buffers. Each supported transmit buffer needs one byte in Eth driver internal memory even if it is not used. Memory consumption can be lowered by decreasing this number.
        integer EthMaxTXBuffersSize: 1..399840, origin=NXP, set at pre-compile, default-value=24512  # Vendor specific: Limits the size of transmit buffers (include buffer data and buffer descriptor) in bytes. This value should be calculated carefully to optimzie the memory used Eth driver. Otherwise, there will be wasted memory.
        integer EthMaxRXBuffersSize: 1..399840, origin=NXP, set at pre-compile, default-value=24512  # Vendor specific: Limits the size of Receive buffers (include buffer data and buffer descriptor) in bytes. This value should be calculated carefully to optimzie the memory used Eth driver. Otherwise, there will be wasted memory.
        integer EthMulticastPoolSize: 1..512, origin=NXP, set at pre-compile, default-value=15  # Vendor specific: Defines maximal count of addresses in multicast pool.
        boolean EthUseMultiBufferRxFrames: origin=Freescale, set at pre-compile, default-value=false  # Vendor specific: Enables / disables support of spreading Eth frames over multiple RX buffers.
        boolean EthEnableRxFrameWrap: origin=Freescale, set at pre-compile, default-value=false  # Vendor specific: Enables / disables support of multi-buffers frames wrapped over the receive buffer ring. Parameter is only accessible and considered during generation when value of EthUseMultiBufferRxFrames is set to 'true'.
        boolean EthUseMultiBufferTxFrames: origin=NXP, set at pre-compile, default-value=false  # Vendor specific: Enables / disables support of spreading Eth frames over multiple TX buffers.
    container CommonPublishedInformation  # Common container, aggregated by all modules. It contains published information about vendor and versions.
      integer ArReleaseMajorVersion: 4..4, origin=NXP, set at published-information, default-value=4  # Major version number of AUTOSAR specification on which the appropriate implementation is based on.
      integer ArReleaseMinorVersion: 2..2, origin=NXP, set at published-information, default-value=2  # Minor version number of AUTOSAR specification on which the appropriate implementation is based on.
      integer ArReleaseRevisionVersion: 2..2, origin=NXP, set at published-information, default-value=2  # Revision version number of AUTOSAR specification on which the appropriate implementation is based on.
      integer ModuleId: 88..88, origin=NXP, set at published-information, default-value=88  # Module ID of this module from Module List.
      integer SwMajorVersion: 1..1, origin=NXP, set at published-information, default-value=1  # Major version number of the vendor specific implementation of the module. The numbering is vendor specific.
      integer SwMinorVersion: 0..0, origin=NXP, set at published-information, default-value=0  # Minor version number of the vendor specific implementation of the module. The numbering is vendor specific.
      integer SwPatchVersion: 2..2, origin=NXP, set at published-information, default-value=2  # Patch level version number of the vendor specific implementation of the module. The numbering is vendor specific.
      string VendorApiInfix [0..1]: multiplicity set at published-information, origin=NXP, set at published-information  # In driver modules which can be instantiated several times on a single ECU, BSW00347 requires that the name of APIs is extended by the VendorId and a vendor specific name. This parameter is used to specify the vendor specific name. In total, the implementation specific name is generated as follows: [ModuleName]_[VendorId]_[VendorApiInfix][Api name from SWS]. E.g. assuming that the VendorId of the implementor is 123 and the implementer chose a VendorApiInfix of "v11r456" a api name Can_Write defined in the SWS will translate to Can_123_v11r456Write. This parameter is mandatory for all modules with upper multiplicity > 1. It shall not be used for modules with upper multiplicity =1.
      integer VendorId: 43..43, origin=NXP, set at published-information, default-value=43  # Vendor ID of the dedicated implementation of this module according to the AUTOSAR vendor list.
