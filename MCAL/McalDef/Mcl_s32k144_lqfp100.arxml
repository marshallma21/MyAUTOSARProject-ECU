AUTOSAR XML (schema 4-3-0)
package /TS_T40D2M10I2R0
  ecuc definition collection Mcl_EcuParameterDefinition: module=Mcl
  module definition Mcl: post-build-variant-support=true, variants post-build/pre-compile  # Vendor specific: Configuration of the Mcl (MicroController Library ) module.
    container MclGeneral  # Vendor specific: Configuration of general Mcl parameters.
      boolean MclDisableDemReportErrorStatus: origin=NXP, set at pre-compile, default-value=false  # Enable/Disable Dem error reporting.
      boolean MclDevErrorDetect: origin=NXP, set at pre-compile, default-value=true  # Vendor specific: Switches the Development Error Detection and Notification on or off. true: Enabled. false: Disabled.
      boolean MclDmaNotificationSupported: origin=Freescale, set at pre-compile, default-value=true  # This parameter is obsolete. The newly added MclIsrAvailable configures the interrupts available.
      boolean MclErrorChecking: origin=Freescale, set at pre-compile, default-value=true  # Vendor specific: Vendor specific: Switch to indicate if the error user notification is supported.
      boolean Mcl_VersionInfoApi: origin=NXP, set at pre-compile, default-value=true  # Vendor specific: Enables/Disables the get version info API function
      boolean Mcl_DmaGetChannelErrorStatusApi: origin=NXP, set at pre-compile, default-value=false  # Vendor specific: Enables/Disables the get channel error status API Mcl_DmaGetChannelErrorStatus
      boolean Mcl_DmaGetGlobalErrorStatusApi: origin=NXP, set at pre-compile, default-value=false  # Vendor specific: Enables/Disables the get global error status API Mcl_DmaGetGlobalErrorStatus
      boolean Mcl_DeInitApi: origin=NXP, set at pre-compile, default-value=false  # Vendor specific: Enables/Disables the Mcl_DeInit API
      boolean Mcl_CommonTimebaseSupported: origin=NXP, set at pre-compile, default-value=false  # Enables/Disables the option to set the a common timebase for multiple FTM modules. Note: NoteThis is an Implementation Specific Parameter. Enabling this feature will allow the use of the Mcl_SelectCommonTimebase API
      boolean EnableDMA: origin=NXP, set at pre-compile, default-value=true  # Vendor specific: Activates/Deactivates DMA configuration. DMA configuration must be enabled here.
      boolean MclEnableTrgMux: origin=NXP, set at pre-compile, default-value=false  # Vendor specific: Activates/Deactivates TrigMux configuration.
      boolean MclEnableUserModeSupport: origin=Freescale, set at pre-compile, default-value=false  # When this parameter is enabled, the MCL module will adapt to run from User Mode, with the following measures: b) using 'call trusted function' stubs for all internal function calls that access registers requiring supervisor mode. for more information, please see chapter 5.7 User Mode Support in IM Note: Implementation Specific Parameter.
      boolean EnableFlexioSupport: origin=NXP, set at pre-compile, default-value=false  # When this parameter is enabled, the FLEXIO APIs and FLEXIO configuration are enabled to the user.
      function name MclErrorNotificationDma0: origin=NXP, post-build-variant-value=true, set at pre-compile in variant pre-compile / post-build in variant post-build, default-value=NULL_PTR  # Vendor specific: User callback function NOTE: please use NULL or NULL_PTR w/o any quotes. If the used string is different from NULL or NULL_PTR it will be used as the configured function name.
      container MclIsrAvailable [16..16]  # Vendor specific: Mcl ISRs Available.Please check the ISRs which are needed for the application. Warning: This is a precompile configuration.If you uncheck a ISR, you will not be able to enable the respective channel or error functionality at post build time.
        enumeration MclIsrName: {eDMA_0, eDMA_1, eDMA_2, eDMA_3, eDMA_4, eDMA_5, eDMA_6, eDMA_7, eDMA_8, eDMA_9, eDMA_10, eDMA_11, eDMA_12, eDMA_13, eDMA_14, eDMA_15}, origin=NXP, set at pre-compile, default-value=eDMA_0  # Vendor specific: Mcl Interrupt Name.
        boolean MclIsrEnabled: origin=NXP, set at pre-compile, default-value=true  # Vendor specific: Switch to indicate if the interrupt is enabled
      container MclLmem  # Vendor specific: Container for the LMEM related configuration parameters.
        boolean MclLmemEnableCacheApi: origin=NXP, set at pre-compile, default-value=false  # Vendor specific: Enable all Lmem cache APIs (Enable, Disable, Flush, Invalidate, Clear)
        boolean MclSynchronizeCache: origin=NXP, set at pre-compile, default-value=false  # Vendor specific: Synchronize the memory by invalidating the cache before and after each DMA hardware operation. The MCL driver needs to maintain the memory coherency by means of three methods: 1. Disable data cache, or 2. Place the data buffers in non-cacheable memory sections, or 3. Enable the MclSynchronizeCache feature, or 4. Use the cache line APIs individually. Depending on the application configuration, one option may be more beneficial than others. If the respective cache is disabled or the buffers are placed in non-cacheable memories, this parameter should be disabled. Enabled: The MCL driver will call Mcl cache API functions in order to sync the cache and memory before and after each DMA transfer, in order to ensure that the cache and the modified memory are in sync. If enabled, the driver will attempt to invalidate the entire cache. If, for perfomance reasons, this invalidation is not desired, then the upper software layers should disable this parameter and invalidate/flush the DMA buffers accordingly, using the provide cache line APIs. If enabled, the affected drivers will be able to run with the buffers cached. Disabled: MCL driver will not call any cache function during a DMA operation. If disabled, the MCL driver needs to have its buffers placed in non-cacheable memories, the cache has to be disabled or the data buffers have to be flushed before a DMA transaction and invalidated/cleared after it finishes.
        boolean MclLmemEnableWriteBuffer: origin=NXP, set at pre-compile, default-value=false  # Vendor specific: Enable also Write Buffer alongside with Cache enable. If the memory is not cacheable or if the cacheable memory is read-only(for ex. if only flash is cacheable), this feature is not usable.
        integer MclLmemCacheTimeout: 1..2147483647, origin=NXP, set at pre-compile, default-value=2147483647  # Vendor specific: Lmem Cache Timeout is the timeout value for LMEM Cache invalidate and flush operations.
    container MclDemEventParameterRefs [0..1]: multiplicity set at pre-compile  # Vendor specific: Container for the references to DemEventParameter elements which shall be invoked using the API Dem_reportErrorStatus in case the corresponding error occurs. The EventId is taken from the referenced DemEventParameter/DemEventId value.
      symbolic name reference MCL_E_DMA_DESCRIPTOR [0..1]: multiplicity set at pre-compile, origin=NXP, set at pre-compile, destination=DemEventParameter  # Vendor specific: Reference to the DemEventParameter which shall be issued when a descriptor error occurs
      symbolic name reference MCL_E_DMA_BUS [0..1]: multiplicity set at pre-compile, origin=NXP, set at pre-compile, destination=DemEventParameter  # Vendor specific: Reference to the DemEventParameter which shall be issued when a bus error occured.
      symbolic name reference MCL_E_DMA_PRIORITY [0..1]: multiplicity set at pre-compile, origin=NXP, set at pre-compile, destination=DemEventParameter  # Vendor specific: Reference to the DemEventParameter which shall be issued when a descriptor error occurs
      symbolic name reference MCL_E_DMA_INCONSISTENCY [0..1]: multiplicity set at pre-compile, origin=NXP, set at pre-compile, destination=DemEventParameter  # Vendor specific: Reference to the DemEventParameter which shall be issued when a descriptor error occurs
      symbolic name reference MCL_E_DMA_UNRECOGNIZED [0..1]: multiplicity set at pre-compile, origin=NXP, set at pre-compile, destination=DemEventParameter  # Vendor specific: Reference to the DemEventParameter which shall be issued when a descriptor error occurs
    container MclConfigSet [1..*]: multiplicity set at post-build in variant post-build / pre-compile in variant pre-compile  # Vendor specific: This container is the base for a multiple configuration set
      container DmaInstance [1..2]: multiplicity set at post-build in variant post-build / pre-compile in variant pre-compile  # Vendor specific: Configuration of a DMA Instance.
        enumeration DmaHwInstance: {eDMA_Instance0}, origin=NXP, set at pre-compile in variant pre-compile / post-build in variant post-build, default-value=eDMA_Instance0  # Vendor specific: Select the physical eDMA Instance. NOTE: This is an Implementation Specific Parameter.
        boolean MclEDMA_CX: origin=NXP, post-build-variant-value=true, set at post-build in variant post-build / pre-compile in variant pre-compile, default-value=false  # Vendor specific: DMA_CR[CX]. Cancel Transfer. 0 - Normal operation. 1 - Cancel the remaining data transfer. Stop the executing channel and force the minor loop to be finished. The cancel takes effect after the last write of the current read/write sequence. The CXFR bit clears itself after the cancel has been honored. This cancel retires the channel normally as if the minor loop was completed. Note: Implementation Specific Parameter.
        boolean MclEDMA_ECX: origin=NXP, post-build-variant-value=true, set at post-build in variant post-build / pre-compile in variant pre-compile, default-value=false  # Vendor specific: DMA_CR[ECX]. Error Cancel Transfer. 0 - Normal operation. 1 - Cancel the remaining data transfer in the same fashion as the CX cancel transfer. Stop the executing channel and force the minor loop to be finished. The cancel takes effect after the last write of the current read/write sequence. The ECX bit clears itself after the cancel cancel has been honored. In addition to cancelling the transfer, the ECX treats the cancel as an error condition; thus updating the DMAES register and generating an optional error interrupt. Note: Implementation Specific Parameter.
        boolean MclEDMA_CLM: origin=NXP, post-build-variant-value=true, set at post-build in variant post-build / pre-compile in variant pre-compile, default-value=false  # Vendor specific: DMA_CR[CLM]. Continuous Link Mode. 0 - A minor loop channel link made to itself will go through channel arbitration before being activated again. 1 - A minor loop channel link made to itself will not go through channel arbitration before being activated again. Upon minor loop completion the channel will active again if that channel has has a minor loop channel link enabled and the link channel is itself. This effectively applies the minor loop offsets and restarts the next minor loop. Note: Implementation Specific Parameter.
        boolean MclEDMA_HALT: origin=NXP, post-build-variant-value=true, set at post-build in variant post-build / pre-compile in variant pre-compile, default-value=false  # Vendor specific: DMA_CR[HALT]. Halt eDMA Operations. 0 - Normal operation. 1 - Stall the start of any new channels. Executing channels are allowed to complete. Channel execution will resume when the HALT bit is cleared. Note: Implementation Specific Parameter.
        boolean MclEDMA_HOE: origin=NXP, post-build-variant-value=true, set at post-build in variant post-build / pre-compile in variant pre-compile, default-value=false  # Vendor specific: DMA_CR[HOE]. Halt On Error. 0 - Normal operation. 1 - Any error will cause the HALT bit to be set. Subsequently, all service requests will be ignored until the HALT bit is cleared. Note: Implementation Specific Parameter.
        boolean MclEDMA_ERCA: origin=NXP, post-build-variant-value=true, set at post-build in variant post-build / pre-compile in variant pre-compile, default-value=false  # Vendor specific: DMA_CR[ERCA]. Enable Round Robin Channel Arbitration. 0 - Fixed-priority arbitration is used for channel selection within each group. 1 - Round-Robin arbitration is used for channel selection within each group. Note: Implementation Specific Parameter.
        boolean MclEDMA_EDBG: origin=NXP, post-build-variant-value=true, set at post-build in variant post-build / pre-compile in variant pre-compile, default-value=false  # Vendor specific: DMA_CR[EDBG]. Enable Debug. 0 - The assertion of the system debug control input is ignored. 1 - The assertion of the system debug control input causes the eDMA to stall the start of a new channel. Executing channels are allowed to complete. Channel execution will resume when either the system debug control input is negated or the EDBG bit is cleared. Note: Implementation Specific Parameter.
      container DMAChannel [0..16]: multiplicity set at pre-compile  # Vendor specific: All data needed to configure one DMA channel.
        integer MclDMAChannelId: 0..15, origin=NXP, set at pre-compile, default-value=0  # Vendor specific: Id for the current DMA logical Channel. Note: Implementation Specific Parameter.
        enumeration DmaHwChannel: {eDMA_0, eDMA_1, eDMA_2, eDMA_3, eDMA_4, eDMA_5, eDMA_6, eDMA_7, eDMA_8, eDMA_9, eDMA_10, eDMA_11, eDMA_12, eDMA_13, eDMA_14, eDMA_15}, origin=NXP, post-build-variant-value=true, set at pre-compile in variant pre-compile / post-build in variant post-build, default-value=eDMA_0  # Vendor specific: Select the physical eDMA Channel. NOTE: This is an Implementation Specific Parameter.
        integer DMAChannelPriority: 0..15, origin=NXP, post-build-variant-value=true, set at pre-compile in variant pre-compile / post-build in variant post-build, default-value=0  # Vendor specific: Priority level for DMA channel. Priorities assigned to channels from the same Group must be unique. Please read section Enhanced Direct Memory Access (eDMA) from the manual for more information
        boolean ECP: origin=NXP, post-build-variant-value=true, set at pre-compile in variant pre-compile / post-build in variant post-build, default-value=false  # Vendor specific: Enable channel preemption. 0 (unchecked) - Channel n cannot be suspended by a higher priority channel's service request 1 (checked) - Channel n can be temporarily suspended by a higher priority channel's service request
        boolean DPA: origin=NXP, post-build-variant-value=true, set at pre-compile in variant pre-compile / post-build in variant post-build, default-value=false  # Vendor specific: Disable preemptive ability. 0 (unchecked) - Channel n can suspen a lower priority channel 1 (checked) - Channel n cannot suspend any channel, regardless of the channel's priority.
        boolean EMI: origin=NXP, post-build-variant-value=true, set at pre-compile in variant pre-compile / post-build in variant post-build, default-value=false  # Vendor specific: Enable Master ID replication. 0 (unchecked) - Master ID replication is disabled 1 (checked) - Master ID replication is enabled
        function name MclDmaTransferCompletionNotif: origin=NXP, post-build-variant-value=true, set at pre-compile in variant pre-compile / post-build in variant post-build, default-value=NULL_PTR  # Vendor specific: User callback function to report that the trasnfer is half or complete depending on configuration. NOTE: please use NULL or NULL_PTR w/o any quotes. If the used string is different from NULL or NULL_PTR it will be used as the configured function name.
        boolean MclDMAChannelEnable: origin=NXP, post-build-variant-value=true, set at pre-compile in variant pre-compile / post-build in variant post-build, default-value=false  # Vendor specific: DMA Channel Enable Enables the DMA channel. false - DMA channel is disabled. This mode is primarily used during configuration of the DMA Mux. The DMA has separate channel enables/disables, which should be used to disable or re-configure a DMA channel. true - DMA channel is enabled Note: Implementation Specific Parameter.
        boolean MclDMAChannelTriggerEnable: origin=NXP, post-build-variant-value=true, set at pre-compile in variant pre-compile / post-build in variant post-build, default-value=false  # Vendor specific: DMA Channel Trigger Enable Enables the periodic trigger capability for the triggered DMA channel. false - Triggering is disabled. If triggering is disabled, and the ENBL bit is set, the DMA Channel will simply route the specified source to the DMA channel. (Normal mode) true - Triggering is enabled. If triggering is enabled, and the ENBL bit is set, the DMAMUX is in Periodic Trigger mode. Note: Implementation Specific Parameter.
        enumeration DmaSource0: {LPUART0_RX, LPUART0_TX, LPUART1_RX, LPUART1_TX, LPUART2_RX, LPUART2_TX, FLEXIO_SHIFTER0, FLEXIO_SHIFTER1, FLEXIO_SHIFTER2, FLEXIO_SHIFTER3, LPSPI0_RX, LPSPI0_TX, LPSPI1_RX, LPSPI1_TX, LPSPI2_RX, LPSPI2_TX, FTM1_CH_0, FTM1_CH_1, FTM1_CH_2, FTM1_CH_3, FTM1_CH_4, FTM1_CH_5, FTM1_CH_6, FTM1_CH_7, FTM2_CH_0, FTM2_CH_1, FTM2_CH_2, FTM2_CH_3, FTM2_CH_4, FTM2_CH_5, FTM2_CH_6, FTM2_CH_7, FTM0_CH_0_7, FTM3_CH_0_7, ADC0_COCO, ADC1_COCO, LPI2C0_RX, LPI2C0_TX, PDB0, PDB1, CMP0, PCM_PORT_A, PCM_PORT_B, PCM_PORT_C, PCM_PORT_D, PCM_PORT_E, FLEXCAN0, FLEXCAN1, FLEXCAN2, LPTMR0, ALWAYS_ENABLED_0, ALWAYS_ENABLED_1, NOT_USED}, origin=NXP, post-build-variant-value=true, set at pre-compile in variant pre-compile / post-build in variant post-build, default-value=NOT_USED  # Vendor specific: Configuration of DmaMux0 input source (Physical DMA channels from 0 to 15) NOTE: This is an Implementation Specific Parameter.
        enumeration DmaSource{1..6}: {NOT_USED}, origin=NXP, post-build-variant-value=true, set at pre-compile in variant pre-compile / post-build in variant post-build, default-value=NOT_USED  # Vendor specific: Configuration of DmaMux{1..6} input source (Physical DMA channels from 0 to 0) NOTE: This is an Implementation Specific Parameter.
        enumeration DmaSource7: {NOT_USED}, origin=NXP, post-build-variant-value=true, set at pre-compile in variant pre-compile / post-build in variant post-build, default-value=NOT_USED  # Vendor specific: Configuration of DmaMux7 input source(Physical DMA channels from 0 to 0) NOTE: This is an Implementation Specific Parameter.
        enumeration DmaSource8: {NOT_USED}, origin=NXP, post-build-variant-value=true, set at pre-compile in variant pre-compile / post-build in variant post-build, default-value=NOT_USED  # Vendor specific: Configuration of DmaMux8 input source(Physical DMA channels from 0 to 0) NOTE: This is an Implementation Specific Parameter.
        enumeration DmaSource9: {NOT_USED}, origin=NXP, post-build-variant-value=true, set at pre-compile in variant pre-compile / post-build in variant post-build, default-value=NOT_USED  # Vendor specific: Configuration of DmaMux9 input source (Physical DMA channels from 0 to 0) NOTE: This is an Implementation Specific Parameter.
      container TriggerMux  # Vendor specific: Configuration of TRIGGER MUX.
        enumeration TrgMuxDmaMux0Input0: {INPUT_DISABLED, VDD, INPUT_0, INPUT_1, INPUT_2, INPUT_3, INPUT_4, INPUT_5, INPUT_6, INPUT_7, INPUT_8, INPUT_9, INPUT_10, INPUT_11, CMP0, LPIT_CH0, LPIT_CH1, LPIT_CH2, LPIT_CH3, LPTMR0_TRIGGER, FTM0_INT, FTM0_EXT, FTM1_INT, FTM1_EXT, FTM2_INT, FTM2_EXT, FTM3_INT, FTM3_EXT, ADC0_COCOA, ADC0_COCOB, ADC1_COCOA, ADC1_COCOB, PDB0_CH0, PDB0_PULSE_OUT, PDB1_CH0, PDB1_PULSE_OUT, RTC_ALARM, RTC_SEC_COUNTER, FLEXIO_TRIG0, FLEXIO_TRIG1, FLEXIO_TRIG2, FLEXIO_TRIG3, LPUART0_RX_DATA, LPUART0_TX_DATA, LPUART0_RX_IDLE, LPUART1_RX_DATA, LPUART1_TX_DATA, LPUART1_RX_IDLE, LPI2C0_MASTER_TRIGGER, LPI2C0_SLAVE_TRIGGER, LPSPI0_FRAME, LPSPI0_RX_DATA, LPSPI1_FRAME, LPSPI1_RX_DATA, SIM_SW_TRIGGER, LPI2C1_MASTER_TRIGGER, LPI2C1_SLAVE_TRIGGER, FTM4_INT, FTM4_EXT, FTM5_INT, FTM5_EXT, FTM6_INT, FTM6_EXT, FTM7_INT, FTM7_EXT}, origin=NXP, post-build-variant-value=true, set at pre-compile, default-value=INPUT_DISABLED  # Vendor specific: Used to configure the MUX select for peripheral trigger input 0.
        enumeration TrgMuxDmaMux0Input1: {INPUT_DISABLED, VDD, INPUT_0, INPUT_1, INPUT_2, INPUT_3, INPUT_4, INPUT_5, INPUT_6, INPUT_7, INPUT_8, INPUT_9, INPUT_10, INPUT_11, CMP0, LPIT_CH0, LPIT_CH1, LPIT_CH2, LPIT_CH3, LPTMR0_TRIGGER, FTM0_INT, FTM0_EXT, FTM1_INT, FTM1_EXT, FTM2_INT, FTM2_EXT, FTM3_INT, FTM3_EXT, ADC0_COCOA, ADC0_COCOB, ADC1_COCOA, ADC1_COCOB, PDB0_CH0, PDB0_PULSE_OUT, PDB1_CH0, PDB1_PULSE_OUT, RTC_ALARM, RTC_SEC_COUNTER, FLEXIO_TRIG0, FLEXIO_TRIG1, FLEXIO_TRIG2, FLEXIO_TRIG3, LPUART0_RX_DATA, LPUART0_TX_DATA, LPUART0_RX_IDLE, LPUART1_RX_DATA, LPUART1_TX_DATA, LPUART1_RX_IDLE, LPI2C0_MASTER_TRIGGER, LPI2C0_SLAVE_TRIGGER, LPSPI0_FRAME, LPSPI0_RX_DATA, LPSPI1_FRAME, LPSPI1_RX_DATA, SIM_SW_TRIGGER, LPI2C1_MASTER_TRIGGER, LPI2C1_SLAVE_TRIGGER, FTM4_INT, FTM4_EXT, FTM5_INT, FTM5_EXT, FTM6_INT, FTM6_EXT, FTM7_INT, FTM7_EXT}, origin=NXP, post-build-variant-value=true, set at pre-compile, default-value=INPUT_DISABLED  # Vendor specific: Used to configure the MUX select for peripheral trigger input 1.
        enumeration TrgMuxDmaMux0Input2: {INPUT_DISABLED, VDD, INPUT_0, INPUT_1, INPUT_2, INPUT_3, INPUT_4, INPUT_5, INPUT_6, INPUT_7, INPUT_8, INPUT_9, INPUT_10, INPUT_11, CMP0, LPIT_CH0, LPIT_CH1, LPIT_CH2, LPIT_CH3, LPTMR0_TRIGGER, FTM0_INT, FTM0_EXT, FTM1_INT, FTM1_EXT, FTM2_INT, FTM2_EXT, FTM3_INT, FTM3_EXT, ADC0_COCOA, ADC0_COCOB, ADC1_COCOA, ADC1_COCOB, PDB0_CH0, PDB0_PULSE_OUT, PDB1_CH0, PDB1_PULSE_OUT, RTC_ALARM, RTC_SEC_COUNTER, FLEXIO_TRIG0, FLEXIO_TRIG1, FLEXIO_TRIG2, FLEXIO_TRIG3, LPUART0_RX_DATA, LPUART0_TX_DATA, LPUART0_RX_IDLE, LPUART1_RX_DATA, LPUART1_TX_DATA, LPUART1_RX_IDLE, LPI2C0_MASTER_TRIGGER, LPI2C0_SLAVE_TRIGGER, LPSPI0_FRAME, LPSPI0_RX_DATA, LPSPI1_FRAME, LPSPI1_RX_DATA, SIM_SW_TRIGGER, LPI2C1_MASTER_TRIGGER, LPI2C1_SLAVE_TRIGGER, FTM4_INT, FTM4_EXT, FTM5_INT, FTM5_EXT, FTM6_INT, FTM6_EXT, FTM7_INT, FTM7_EXT}, origin=NXP, post-build-variant-value=true, set at pre-compile, default-value=INPUT_DISABLED  # Vendor specific: Used to configure the MUX select for peripheral trigger input 2.
        enumeration TrgMuxDmaMux0Input3: {INPUT_DISABLED, VDD, INPUT_0, INPUT_1, INPUT_2, INPUT_3, INPUT_4, INPUT_5, INPUT_6, INPUT_7, INPUT_8, INPUT_9, INPUT_10, INPUT_11, CMP0, LPIT_CH0, LPIT_CH1, LPIT_CH2, LPIT_CH3, LPTMR0_TRIGGER, FTM0_INT, FTM0_EXT, FTM1_INT, FTM1_EXT, FTM2_INT, FTM2_EXT, FTM3_INT, FTM3_EXT, ADC0_COCOA, ADC0_COCOB, ADC1_COCOA, ADC1_COCOB, PDB0_CH0, PDB0_PULSE_OUT, PDB1_CH0, PDB1_PULSE_OUT, RTC_ALARM, RTC_SEC_COUNTER, FLEXIO_TRIG0, FLEXIO_TRIG1, FLEXIO_TRIG2, FLEXIO_TRIG3, LPUART0_RX_DATA, LPUART0_TX_DATA, LPUART0_RX_IDLE, LPUART1_RX_DATA, LPUART1_TX_DATA, LPUART1_RX_IDLE, LPI2C0_MASTER_TRIGGER, LPI2C0_SLAVE_TRIGGER, LPSPI0_FRAME, LPSPI0_RX_DATA, LPSPI1_FRAME, LPSPI1_RX_DATA, SIM_SW_TRIGGER, LPI2C1_MASTER_TRIGGER, LPI2C1_SLAVE_TRIGGER, FTM4_INT, FTM4_EXT, FTM5_INT, FTM5_EXT, FTM6_INT, FTM6_EXT, FTM7_INT, FTM7_EXT}, origin=NXP, post-build-variant-value=true, set at pre-compile, default-value=INPUT_DISABLED  # Vendor specific: Used to configure the MUX select for peripheral trigger input 3.
        boolean TrgMuxDmaMux0LockEn: origin=NXP, post-build-variant-value=true, set at pre-compile, default-value=false  # Vendor specific: Configures if register TrgMuxDmaMux0 must be locked(read-only).
        enumeration TrgMuxXOut0Input0: {INPUT_DISABLED, VDD, INPUT_0, INPUT_1, INPUT_2, INPUT_3, INPUT_4, INPUT_5, INPUT_6, INPUT_7, INPUT_8, INPUT_9, INPUT_10, INPUT_11, CMP0, LPIT_CH0, LPIT_CH1, LPIT_CH2, LPIT_CH3, LPTMR0_TRIGGER, FTM0_INT, FTM0_EXT, FTM1_INT, FTM1_EXT, FTM2_INT, FTM2_EXT, FTM3_INT, FTM3_EXT, ADC0_COCOA, ADC0_COCOB, ADC1_COCOA, ADC1_COCOB, PDB0_CH0, PDB0_PULSE_OUT, PDB1_CH0, PDB1_PULSE_OUT, RTC_ALARM, RTC_SEC_COUNTER, FLEXIO_TRIG0, FLEXIO_TRIG1, FLEXIO_TRIG2, FLEXIO_TRIG3, LPUART0_RX_DATA, LPUART0_TX_DATA, LPUART0_RX_IDLE, LPUART1_RX_DATA, LPUART1_TX_DATA, LPUART1_RX_IDLE, LPI2C0_MASTER_TRIGGER, LPI2C0_SLAVE_TRIGGER, LPSPI0_FRAME, LPSPI0_RX_DATA, LPSPI1_FRAME, LPSPI1_RX_DATA, SIM_SW_TRIGGER, LPI2C1_MASTER_TRIGGER, LPI2C1_SLAVE_TRIGGER, FTM4_INT, FTM4_EXT, FTM5_INT, FTM5_EXT, FTM6_INT, FTM6_EXT, FTM7_INT, FTM7_EXT}, origin=NXP, post-build-variant-value=true, set at pre-compile, default-value=INPUT_DISABLED  # Vendor specific: Used to configure the XbOut03 input 0.
        enumeration TrgMuxXOut0Input1: {INPUT_DISABLED, VDD, INPUT_0, INPUT_1, INPUT_2, INPUT_3, INPUT_4, INPUT_5, INPUT_6, INPUT_7, INPUT_8, INPUT_9, INPUT_10, INPUT_11, CMP0, LPIT_CH0, LPIT_CH1, LPIT_CH2, LPIT_CH3, LPTMR0_TRIGGER, FTM0_INT, FTM0_EXT, FTM1_INT, FTM1_EXT, FTM2_INT, FTM2_EXT, FTM3_INT, FTM3_EXT, ADC0_COCOA, ADC0_COCOB, ADC1_COCOA, ADC1_COCOB, PDB0_CH0, PDB0_PULSE_OUT, PDB1_CH0, PDB1_PULSE_OUT, RTC_ALARM, RTC_SEC_COUNTER, FLEXIO_TRIG0, FLEXIO_TRIG1, FLEXIO_TRIG2, FLEXIO_TRIG3, LPUART0_RX_DATA, LPUART0_TX_DATA, LPUART0_RX_IDLE, LPUART1_RX_DATA, LPUART1_TX_DATA, LPUART1_RX_IDLE, LPI2C0_MASTER_TRIGGER, LPI2C0_SLAVE_TRIGGER, LPSPI0_FRAME, LPSPI0_RX_DATA, LPSPI1_FRAME, LPSPI1_RX_DATA, SIM_SW_TRIGGER, LPI2C1_MASTER_TRIGGER, LPI2C1_SLAVE_TRIGGER, FTM4_INT, FTM4_EXT, FTM5_INT, FTM5_EXT, FTM6_INT, FTM6_EXT, FTM7_INT, FTM7_EXT}, origin=NXP, post-build-variant-value=true, set at pre-compile, default-value=INPUT_DISABLED  # Vendor specific: Used to configure the XbOut03 input 1.
        enumeration TrgMuxXOut0Input2: {INPUT_DISABLED, VDD, INPUT_0, INPUT_1, INPUT_2, INPUT_3, INPUT_4, INPUT_5, INPUT_6, INPUT_7, INPUT_8, INPUT_9, INPUT_10, INPUT_11, CMP0, LPIT_CH0, LPIT_CH1, LPIT_CH2, LPIT_CH3, LPTMR0_TRIGGER, FTM0_INT, FTM0_EXT, FTM1_INT, FTM1_EXT, FTM2_INT, FTM2_EXT, FTM3_INT, FTM3_EXT, ADC0_COCOA, ADC0_COCOB, ADC1_COCOA, ADC1_COCOB, PDB0_CH0, PDB0_PULSE_OUT, PDB1_CH0, PDB1_PULSE_OUT, RTC_ALARM, RTC_SEC_COUNTER, FLEXIO_TRIG0, FLEXIO_TRIG1, FLEXIO_TRIG2, FLEXIO_TRIG3, LPUART0_RX_DATA, LPUART0_TX_DATA, LPUART0_RX_IDLE, LPUART1_RX_DATA, LPUART1_TX_DATA, LPUART1_RX_IDLE, LPI2C0_MASTER_TRIGGER, LPI2C0_SLAVE_TRIGGER, LPSPI0_FRAME, LPSPI0_RX_DATA, LPSPI1_FRAME, LPSPI1_RX_DATA, SIM_SW_TRIGGER, LPI2C1_MASTER_TRIGGER, LPI2C1_SLAVE_TRIGGER, FTM4_INT, FTM4_EXT, FTM5_INT, FTM5_EXT, FTM6_INT, FTM6_EXT, FTM7_INT, FTM7_EXT}, origin=NXP, post-build-variant-value=true, set at pre-compile, default-value=INPUT_DISABLED  # Vendor specific: Used to configure the XbOut03 input 2.
        enumeration TrgMuxXOut0Input3: {INPUT_DISABLED, VDD, INPUT_0, INPUT_1, INPUT_2, INPUT_3, INPUT_4, INPUT_5, INPUT_6, INPUT_7, INPUT_8, INPUT_9, INPUT_10, INPUT_11, CMP0, LPIT_CH0, LPIT_CH1, LPIT_CH2, LPIT_CH3, LPTMR0_TRIGGER, FTM0_INT, FTM0_EXT, FTM1_INT, FTM1_EXT, FTM2_INT, FTM2_EXT, FTM3_INT, FTM3_EXT, ADC0_COCOA, ADC0_COCOB, ADC1_COCOA, ADC1_COCOB, PDB0_CH0, PDB0_PULSE_OUT, PDB1_CH0, PDB1_PULSE_OUT, RTC_ALARM, RTC_SEC_COUNTER, FLEXIO_TRIG0, FLEXIO_TRIG1, FLEXIO_TRIG2, FLEXIO_TRIG3, LPUART0_RX_DATA, LPUART0_TX_DATA, LPUART0_RX_IDLE, LPUART1_RX_DATA, LPUART1_TX_DATA, LPUART1_RX_IDLE, LPI2C0_MASTER_TRIGGER, LPI2C0_SLAVE_TRIGGER, LPSPI0_FRAME, LPSPI0_RX_DATA, LPSPI1_FRAME, LPSPI1_RX_DATA, SIM_SW_TRIGGER, LPI2C1_MASTER_TRIGGER, LPI2C1_SLAVE_TRIGGER, FTM4_INT, FTM4_EXT, FTM5_INT, FTM5_EXT, FTM6_INT, FTM6_EXT, FTM7_INT, FTM7_EXT}, origin=NXP, post-build-variant-value=true, set at pre-compile, default-value=INPUT_DISABLED  # Vendor specific: Used to configure the XbOut03 input 3.
        boolean TrgMuxXOut0LockEn: origin=NXP, post-build-variant-value=true, set at pre-compile, default-value=false  # Vendor specific: Configures if register XbOut03 must be locked(read-only).
        enumeration TrgMuxXOut1Input0: {INPUT_DISABLED, VDD, INPUT_0, INPUT_1, INPUT_2, INPUT_3, INPUT_4, INPUT_5, INPUT_6, INPUT_7, INPUT_8, INPUT_9, INPUT_10, INPUT_11, CMP0, LPIT_CH0, LPIT_CH1, LPIT_CH2, LPIT_CH3, LPTMR0_TRIGGER, FTM0_INT, FTM0_EXT, FTM1_INT, FTM1_EXT, FTM2_INT, FTM2_EXT, FTM3_INT, FTM3_EXT, ADC0_COCOA, ADC0_COCOB, ADC1_COCOA, ADC1_COCOB, PDB0_CH0, PDB0_PULSE_OUT, PDB1_CH0, PDB1_PULSE_OUT, RTC_ALARM, RTC_SEC_COUNTER, FLEXIO_TRIG0, FLEXIO_TRIG1, FLEXIO_TRIG2, FLEXIO_TRIG3, LPUART0_RX_DATA, LPUART0_TX_DATA, LPUART0_RX_IDLE, LPUART1_RX_DATA, LPUART1_TX_DATA, LPUART1_RX_IDLE, LPI2C0_MASTER_TRIGGER, LPI2C0_SLAVE_TRIGGER, LPSPI0_FRAME, LPSPI0_RX_DATA, LPSPI1_FRAME, LPSPI1_RX_DATA, SIM_SW_TRIGGER, LPI2C1_MASTER_TRIGGER, LPI2C1_SLAVE_TRIGGER, FTM4_INT, FTM4_EXT, FTM5_INT, FTM5_EXT, FTM6_INT, FTM6_EXT, FTM7_INT, FTM7_EXT}, origin=NXP, post-build-variant-value=true, set at pre-compile, default-value=INPUT_DISABLED  # Vendor specific: Used to configure the XbOut47 input 0.
        enumeration TrgMuxXOut1Input1: {INPUT_DISABLED, VDD, INPUT_0, INPUT_1, INPUT_2, INPUT_3, INPUT_4, INPUT_5, INPUT_6, INPUT_7, INPUT_8, INPUT_9, INPUT_10, INPUT_11, CMP0, LPIT_CH0, LPIT_CH1, LPIT_CH2, LPIT_CH3, LPTMR0_TRIGGER, FTM0_INT, FTM0_EXT, FTM1_INT, FTM1_EXT, FTM2_INT, FTM2_EXT, FTM3_INT, FTM3_EXT, ADC0_COCOA, ADC0_COCOB, ADC1_COCOA, ADC1_COCOB, PDB0_CH0, PDB0_PULSE_OUT, PDB1_CH0, PDB1_PULSE_OUT, RTC_ALARM, RTC_SEC_COUNTER, FLEXIO_TRIG0, FLEXIO_TRIG1, FLEXIO_TRIG2, FLEXIO_TRIG3, LPUART0_RX_DATA, LPUART0_TX_DATA, LPUART0_RX_IDLE, LPUART1_RX_DATA, LPUART1_TX_DATA, LPUART1_RX_IDLE, LPI2C0_MASTER_TRIGGER, LPI2C0_SLAVE_TRIGGER, LPSPI0_FRAME, LPSPI0_RX_DATA, LPSPI1_FRAME, LPSPI1_RX_DATA, SIM_SW_TRIGGER, LPI2C1_MASTER_TRIGGER, LPI2C1_SLAVE_TRIGGER, FTM4_INT, FTM4_EXT, FTM5_INT, FTM5_EXT, FTM6_INT, FTM6_EXT, FTM7_INT, FTM7_EXT}, origin=NXP, post-build-variant-value=true, set at pre-compile, default-value=INPUT_DISABLED  # Vendor specific: Used to configure the XbOut47 input 1.
        enumeration TrgMuxXOut1Input2: {INPUT_DISABLED, VDD, INPUT_0, INPUT_1, INPUT_2, INPUT_3, INPUT_4, INPUT_5, INPUT_6, INPUT_7, INPUT_8, INPUT_9, INPUT_10, INPUT_11, CMP0, LPIT_CH0, LPIT_CH1, LPIT_CH2, LPIT_CH3, LPTMR0_TRIGGER, FTM0_INT, FTM0_EXT, FTM1_INT, FTM1_EXT, FTM2_INT, FTM2_EXT, FTM3_INT, FTM3_EXT, ADC0_COCOA, ADC0_COCOB, ADC1_COCOA, ADC1_COCOB, PDB0_CH0, PDB0_PULSE_OUT, PDB1_CH0, PDB1_PULSE_OUT, RTC_ALARM, RTC_SEC_COUNTER, FLEXIO_TRIG0, FLEXIO_TRIG1, FLEXIO_TRIG2, FLEXIO_TRIG3, LPUART0_RX_DATA, LPUART0_TX_DATA, LPUART0_RX_IDLE, LPUART1_RX_DATA, LPUART1_TX_DATA, LPUART1_RX_IDLE, LPI2C0_MASTER_TRIGGER, LPI2C0_SLAVE_TRIGGER, LPSPI0_FRAME, LPSPI0_RX_DATA, LPSPI1_FRAME, LPSPI1_RX_DATA, SIM_SW_TRIGGER, LPI2C1_MASTER_TRIGGER, LPI2C1_SLAVE_TRIGGER, FTM4_INT, FTM4_EXT, FTM5_INT, FTM5_EXT, FTM6_INT, FTM6_EXT, FTM7_INT, FTM7_EXT}, origin=NXP, post-build-variant-value=true, set at pre-compile, default-value=INPUT_DISABLED  # Vendor specific: Used to configure the XbOut47 input 2.
        enumeration TrgMuxXOut1Input3: {INPUT_DISABLED, VDD, INPUT_0, INPUT_1, INPUT_2, INPUT_3, INPUT_4, INPUT_5, INPUT_6, INPUT_7, INPUT_8, INPUT_9, INPUT_10, INPUT_11, CMP0, LPIT_CH0, LPIT_CH1, LPIT_CH2, LPIT_CH3, LPTMR0_TRIGGER, FTM0_INT, FTM0_EXT, FTM1_INT, FTM1_EXT, FTM2_INT, FTM2_EXT, FTM3_INT, FTM3_EXT, ADC0_COCOA, ADC0_COCOB, ADC1_COCOA, ADC1_COCOB, PDB0_CH0, PDB0_PULSE_OUT, PDB1_CH0, PDB1_PULSE_OUT, RTC_ALARM, RTC_SEC_COUNTER, FLEXIO_TRIG0, FLEXIO_TRIG1, FLEXIO_TRIG2, FLEXIO_TRIG3, LPUART0_RX_DATA, LPUART0_TX_DATA, LPUART0_RX_IDLE, LPUART1_RX_DATA, LPUART1_TX_DATA, LPUART1_RX_IDLE, LPI2C0_MASTER_TRIGGER, LPI2C0_SLAVE_TRIGGER, LPSPI0_FRAME, LPSPI0_RX_DATA, LPSPI1_FRAME, LPSPI1_RX_DATA, SIM_SW_TRIGGER, LPI2C1_MASTER_TRIGGER, LPI2C1_SLAVE_TRIGGER, FTM4_INT, FTM4_EXT, FTM5_INT, FTM5_EXT, FTM6_INT, FTM6_EXT, FTM7_INT, FTM7_EXT}, origin=NXP, post-build-variant-value=true, set at pre-compile, default-value=INPUT_DISABLED  # Vendor specific: Used to configure the XbOut47 input 3.
        boolean TrgMuxXOut1LockEn: origin=NXP, post-build-variant-value=true, set at pre-compile, default-value=false  # Vendor specific: Configures if register XbOut47 must be locked(read-only).
        enumeration TrgMuxAdc0Input0: {INPUT_DISABLED, VDD, INPUT_0, INPUT_1, INPUT_2, INPUT_3, INPUT_4, INPUT_5, INPUT_6, INPUT_7, INPUT_8, INPUT_9, INPUT_10, INPUT_11, CMP0, LPIT_CH0, LPIT_CH1, LPIT_CH2, LPIT_CH3, LPTMR0_TRIGGER, FTM0_INT, FTM0_EXT, FTM1_INT, FTM1_EXT, FTM2_INT, FTM2_EXT, FTM3_INT, FTM3_EXT, ADC0_COCOA, ADC0_COCOB, ADC1_COCOA, ADC1_COCOB, PDB0_CH0, PDB0_PULSE_OUT, PDB1_CH0, PDB1_PULSE_OUT, RTC_ALARM, RTC_SEC_COUNTER, FLEXIO_TRIG0, FLEXIO_TRIG1, FLEXIO_TRIG2, FLEXIO_TRIG3, LPUART0_RX_DATA, LPUART0_TX_DATA, LPUART0_RX_IDLE, LPUART1_RX_DATA, LPUART1_TX_DATA, LPUART1_RX_IDLE, LPI2C0_MASTER_TRIGGER, LPI2C0_SLAVE_TRIGGER, LPSPI0_FRAME, LPSPI0_RX_DATA, LPSPI1_FRAME, LPSPI1_RX_DATA, SIM_SW_TRIGGER, LPI2C1_MASTER_TRIGGER, LPI2C1_SLAVE_TRIGGER, FTM4_INT, FTM4_EXT, FTM5_INT, FTM5_EXT, FTM6_INT, FTM6_EXT, FTM7_INT, FTM7_EXT}, origin=NXP, post-build-variant-value=true, set at pre-compile, default-value=INPUT_DISABLED  # Vendor specific: Used to configure the Adc0 input 0.
        enumeration TrgMuxAdc0Input1: {INPUT_DISABLED, VDD, INPUT_0, INPUT_1, INPUT_2, INPUT_3, INPUT_4, INPUT_5, INPUT_6, INPUT_7, INPUT_8, INPUT_9, INPUT_10, INPUT_11, CMP0, LPIT_CH0, LPIT_CH1, LPIT_CH2, LPIT_CH3, LPTMR0_TRIGGER, FTM0_INT, FTM0_EXT, FTM1_INT, FTM1_EXT, FTM2_INT, FTM2_EXT, FTM3_INT, FTM3_EXT, ADC0_COCOA, ADC0_COCOB, ADC1_COCOA, ADC1_COCOB, PDB0_CH0, PDB0_PULSE_OUT, PDB1_CH0, PDB1_PULSE_OUT, RTC_ALARM, RTC_SEC_COUNTER, FLEXIO_TRIG0, FLEXIO_TRIG1, FLEXIO_TRIG2, FLEXIO_TRIG3, LPUART0_RX_DATA, LPUART0_TX_DATA, LPUART0_RX_IDLE, LPUART1_RX_DATA, LPUART1_TX_DATA, LPUART1_RX_IDLE, LPI2C0_MASTER_TRIGGER, LPI2C0_SLAVE_TRIGGER, LPSPI0_FRAME, LPSPI0_RX_DATA, LPSPI1_FRAME, LPSPI1_RX_DATA, SIM_SW_TRIGGER, LPI2C1_MASTER_TRIGGER, LPI2C1_SLAVE_TRIGGER, FTM4_INT, FTM4_EXT, FTM5_INT, FTM5_EXT, FTM6_INT, FTM6_EXT, FTM7_INT, FTM7_EXT}, origin=NXP, post-build-variant-value=true, set at pre-compile, default-value=INPUT_DISABLED  # Vendor specific: Used to configure the Adc0 input 1.
        enumeration TrgMuxAdc0Input2: {INPUT_DISABLED, VDD, INPUT_0, INPUT_1, INPUT_2, INPUT_3, INPUT_4, INPUT_5, INPUT_6, INPUT_7, INPUT_8, INPUT_9, INPUT_10, INPUT_11, CMP0, LPIT_CH0, LPIT_CH1, LPIT_CH2, LPIT_CH3, LPTMR0_TRIGGER, FTM0_INT, FTM0_EXT, FTM1_INT, FTM1_EXT, FTM2_INT, FTM2_EXT, FTM3_INT, FTM3_EXT, ADC0_COCOA, ADC0_COCOB, ADC1_COCOA, ADC1_COCOB, PDB0_CH0, PDB0_PULSE_OUT, PDB1_CH0, PDB1_PULSE_OUT, RTC_ALARM, RTC_SEC_COUNTER, FLEXIO_TRIG0, FLEXIO_TRIG1, FLEXIO_TRIG2, FLEXIO_TRIG3, LPUART0_RX_DATA, LPUART0_TX_DATA, LPUART0_RX_IDLE, LPUART1_RX_DATA, LPUART1_TX_DATA, LPUART1_RX_IDLE, LPI2C0_MASTER_TRIGGER, LPI2C0_SLAVE_TRIGGER, LPSPI0_FRAME, LPSPI0_RX_DATA, LPSPI1_FRAME, LPSPI1_RX_DATA, SIM_SW_TRIGGER, LPI2C1_MASTER_TRIGGER, LPI2C1_SLAVE_TRIGGER, FTM4_INT, FTM4_EXT, FTM5_INT, FTM5_EXT, FTM6_INT, FTM6_EXT, FTM7_INT, FTM7_EXT}, origin=NXP, post-build-variant-value=true, set at pre-compile, default-value=INPUT_DISABLED  # Vendor specific: Used to configure the Adc0 input 2.
        enumeration TrgMuxAdc0Input3: {INPUT_DISABLED, VDD, INPUT_0, INPUT_1, INPUT_2, INPUT_3, INPUT_4, INPUT_5, INPUT_6, INPUT_7, INPUT_8, INPUT_9, INPUT_10, INPUT_11, CMP0, LPIT_CH0, LPIT_CH1, LPIT_CH2, LPIT_CH3, LPTMR0_TRIGGER, FTM0_INT, FTM0_EXT, FTM1_INT, FTM1_EXT, FTM2_INT, FTM2_EXT, FTM3_INT, FTM3_EXT, ADC0_COCOA, ADC0_COCOB, ADC1_COCOA, ADC1_COCOB, PDB0_CH0, PDB0_PULSE_OUT, PDB1_CH0, PDB1_PULSE_OUT, RTC_ALARM, RTC_SEC_COUNTER, FLEXIO_TRIG0, FLEXIO_TRIG1, FLEXIO_TRIG2, FLEXIO_TRIG3, LPUART0_RX_DATA, LPUART0_TX_DATA, LPUART0_RX_IDLE, LPUART1_RX_DATA, LPUART1_TX_DATA, LPUART1_RX_IDLE, LPI2C0_MASTER_TRIGGER, LPI2C0_SLAVE_TRIGGER, LPSPI0_FRAME, LPSPI0_RX_DATA, LPSPI1_FRAME, LPSPI1_RX_DATA, SIM_SW_TRIGGER, LPI2C1_MASTER_TRIGGER, LPI2C1_SLAVE_TRIGGER, FTM4_INT, FTM4_EXT, FTM5_INT, FTM5_EXT, FTM6_INT, FTM6_EXT, FTM7_INT, FTM7_EXT}, origin=NXP, post-build-variant-value=true, set at pre-compile, default-value=INPUT_DISABLED  # Vendor specific: Used to configure the Adc0 input 3.
        boolean TrgMuxAdc0LockEn: origin=NXP, post-build-variant-value=true, set at pre-compile, default-value=false  # Vendor specific: Configures if register Adc0 must be locked(read-only).
        enumeration TrgMuxAdc1Input0: {INPUT_DISABLED, VDD, INPUT_0, INPUT_1, INPUT_2, INPUT_3, INPUT_4, INPUT_5, INPUT_6, INPUT_7, INPUT_8, INPUT_9, INPUT_10, INPUT_11, CMP0, LPIT_CH0, LPIT_CH1, LPIT_CH2, LPIT_CH3, LPTMR0_TRIGGER, FTM0_INT, FTM0_EXT, FTM1_INT, FTM1_EXT, FTM2_INT, FTM2_EXT, FTM3_INT, FTM3_EXT, ADC0_COCOA, ADC0_COCOB, ADC1_COCOA, ADC1_COCOB, PDB0_CH0, PDB0_PULSE_OUT, PDB1_CH0, PDB1_PULSE_OUT, RTC_ALARM, RTC_SEC_COUNTER, FLEXIO_TRIG0, FLEXIO_TRIG1, FLEXIO_TRIG2, FLEXIO_TRIG3, LPUART0_RX_DATA, LPUART0_TX_DATA, LPUART0_RX_IDLE, LPUART1_RX_DATA, LPUART1_TX_DATA, LPUART1_RX_IDLE, LPI2C0_MASTER_TRIGGER, LPI2C0_SLAVE_TRIGGER, LPSPI0_FRAME, LPSPI0_RX_DATA, LPSPI1_FRAME, LPSPI1_RX_DATA, SIM_SW_TRIGGER, LPI2C1_MASTER_TRIGGER, LPI2C1_SLAVE_TRIGGER, FTM4_INT, FTM4_EXT, FTM5_INT, FTM5_EXT, FTM6_INT, FTM6_EXT, FTM7_INT, FTM7_EXT}, origin=NXP, post-build-variant-value=true, set at pre-compile, default-value=INPUT_DISABLED  # Vendor specific: Used to configure the Adc1 input 0.
        enumeration TrgMuxAdc1Input1: {INPUT_DISABLED, VDD, INPUT_0, INPUT_1, INPUT_2, INPUT_3, INPUT_4, INPUT_5, INPUT_6, INPUT_7, INPUT_8, INPUT_9, INPUT_10, INPUT_11, CMP0, LPIT_CH0, LPIT_CH1, LPIT_CH2, LPIT_CH3, LPTMR0_TRIGGER, FTM0_INT, FTM0_EXT, FTM1_INT, FTM1_EXT, FTM2_INT, FTM2_EXT, FTM3_INT, FTM3_EXT, ADC0_COCOA, ADC0_COCOB, ADC1_COCOA, ADC1_COCOB, PDB0_CH0, PDB0_PULSE_OUT, PDB1_CH0, PDB1_PULSE_OUT, RTC_ALARM, RTC_SEC_COUNTER, FLEXIO_TRIG0, FLEXIO_TRIG1, FLEXIO_TRIG2, FLEXIO_TRIG3, LPUART0_RX_DATA, LPUART0_TX_DATA, LPUART0_RX_IDLE, LPUART1_RX_DATA, LPUART1_TX_DATA, LPUART1_RX_IDLE, LPI2C0_MASTER_TRIGGER, LPI2C0_SLAVE_TRIGGER, LPSPI0_FRAME, LPSPI0_RX_DATA, LPSPI1_FRAME, LPSPI1_RX_DATA, SIM_SW_TRIGGER, LPI2C1_MASTER_TRIGGER, LPI2C1_SLAVE_TRIGGER, FTM4_INT, FTM4_EXT, FTM5_INT, FTM5_EXT, FTM6_INT, FTM6_EXT, FTM7_INT, FTM7_EXT}, origin=NXP, post-build-variant-value=true, set at pre-compile, default-value=INPUT_DISABLED  # Vendor specific: Used to configure the Adc1 input 1.
        enumeration TrgMuxAdc1Input2: {INPUT_DISABLED, VDD, INPUT_0, INPUT_1, INPUT_2, INPUT_3, INPUT_4, INPUT_5, INPUT_6, INPUT_7, INPUT_8, INPUT_9, INPUT_10, INPUT_11, CMP0, LPIT_CH0, LPIT_CH1, LPIT_CH2, LPIT_CH3, LPTMR0_TRIGGER, FTM0_INT, FTM0_EXT, FTM1_INT, FTM1_EXT, FTM2_INT, FTM2_EXT, FTM3_INT, FTM3_EXT, ADC0_COCOA, ADC0_COCOB, ADC1_COCOA, ADC1_COCOB, PDB0_CH0, PDB0_PULSE_OUT, PDB1_CH0, PDB1_PULSE_OUT, RTC_ALARM, RTC_SEC_COUNTER, FLEXIO_TRIG0, FLEXIO_TRIG1, FLEXIO_TRIG2, FLEXIO_TRIG3, LPUART0_RX_DATA, LPUART0_TX_DATA, LPUART0_RX_IDLE, LPUART1_RX_DATA, LPUART1_TX_DATA, LPUART1_RX_IDLE, LPI2C0_MASTER_TRIGGER, LPI2C0_SLAVE_TRIGGER, LPSPI0_FRAME, LPSPI0_RX_DATA, LPSPI1_FRAME, LPSPI1_RX_DATA, SIM_SW_TRIGGER, LPI2C1_MASTER_TRIGGER, LPI2C1_SLAVE_TRIGGER, FTM4_INT, FTM4_EXT, FTM5_INT, FTM5_EXT, FTM6_INT, FTM6_EXT, FTM7_INT, FTM7_EXT}, origin=NXP, post-build-variant-value=true, set at pre-compile, default-value=INPUT_DISABLED  # Vendor specific: Used to configure the Adc1 input 2.
        enumeration TrgMuxAdc1Input3: {INPUT_DISABLED, VDD, INPUT_0, INPUT_1, INPUT_2, INPUT_3, INPUT_4, INPUT_5, INPUT_6, INPUT_7, INPUT_8, INPUT_9, INPUT_10, INPUT_11, CMP0, LPIT_CH0, LPIT_CH1, LPIT_CH2, LPIT_CH3, LPTMR0_TRIGGER, FTM0_INT, FTM0_EXT, FTM1_INT, FTM1_EXT, FTM2_INT, FTM2_EXT, FTM3_INT, FTM3_EXT, ADC0_COCOA, ADC0_COCOB, ADC1_COCOA, ADC1_COCOB, PDB0_CH0, PDB0_PULSE_OUT, PDB1_CH0, PDB1_PULSE_OUT, RTC_ALARM, RTC_SEC_COUNTER, FLEXIO_TRIG0, FLEXIO_TRIG1, FLEXIO_TRIG2, FLEXIO_TRIG3, LPUART0_RX_DATA, LPUART0_TX_DATA, LPUART0_RX_IDLE, LPUART1_RX_DATA, LPUART1_TX_DATA, LPUART1_RX_IDLE, LPI2C0_MASTER_TRIGGER, LPI2C0_SLAVE_TRIGGER, LPSPI0_FRAME, LPSPI0_RX_DATA, LPSPI1_FRAME, LPSPI1_RX_DATA, SIM_SW_TRIGGER, LPI2C1_MASTER_TRIGGER, LPI2C1_SLAVE_TRIGGER, FTM4_INT, FTM4_EXT, FTM5_INT, FTM5_EXT, FTM6_INT, FTM6_EXT, FTM7_INT, FTM7_EXT}, origin=NXP, post-build-variant-value=true, set at pre-compile, default-value=INPUT_DISABLED  # Vendor specific: Used to configure the Adc1 input 3.
        boolean TrgMuxAdc1LockEn: origin=NXP, post-build-variant-value=true, set at pre-compile, default-value=false  # Vendor specific: Configures if register Adc1 must be locked(read-only).
        enumeration TrgMuxCmp0Input0: {INPUT_DISABLED, VDD, INPUT_0, INPUT_1, INPUT_2, INPUT_3, INPUT_4, INPUT_5, INPUT_6, INPUT_7, INPUT_8, INPUT_9, INPUT_10, INPUT_11, CMP0, LPIT_CH0, LPIT_CH1, LPIT_CH2, LPIT_CH3, LPTMR0_TRIGGER, FTM0_INT, FTM0_EXT, FTM1_INT, FTM1_EXT, FTM2_INT, FTM2_EXT, FTM3_INT, FTM3_EXT, ADC0_COCOA, ADC0_COCOB, ADC1_COCOA, ADC1_COCOB, PDB0_CH0, PDB0_PULSE_OUT, PDB1_CH0, PDB1_PULSE_OUT, RTC_ALARM, RTC_SEC_COUNTER, FLEXIO_TRIG0, FLEXIO_TRIG1, FLEXIO_TRIG2, FLEXIO_TRIG3, LPUART0_RX_DATA, LPUART0_TX_DATA, LPUART0_RX_IDLE, LPUART1_RX_DATA, LPUART1_TX_DATA, LPUART1_RX_IDLE, LPI2C0_MASTER_TRIGGER, LPI2C0_SLAVE_TRIGGER, LPSPI0_FRAME, LPSPI0_RX_DATA, LPSPI1_FRAME, LPSPI1_RX_DATA, SIM_SW_TRIGGER, LPI2C1_MASTER_TRIGGER, LPI2C1_SLAVE_TRIGGER, FTM4_INT, FTM4_EXT, FTM5_INT, FTM5_EXT, FTM6_INT, FTM6_EXT, FTM7_INT, FTM7_EXT}, origin=NXP, post-build-variant-value=true, set at pre-compile, default-value=INPUT_DISABLED  # Vendor specific: Used to configure the Cmp0 input 0.
        boolean TrgMuxCmp0LockEn: origin=NXP, post-build-variant-value=true, set at pre-compile, default-value=false  # Vendor specific: Configures if register Cmp0 must be locked(read-only).
        enumeration TrgMuxFtm0Input0: {INPUT_DISABLED, VDD, INPUT_0, INPUT_1, INPUT_2, INPUT_3, INPUT_4, INPUT_5, INPUT_6, INPUT_7, INPUT_8, INPUT_9, INPUT_10, INPUT_11, CMP0, LPIT_CH0, LPIT_CH1, LPIT_CH2, LPIT_CH3, LPTMR0_TRIGGER, FTM0_INT, FTM0_EXT, FTM1_INT, FTM1_EXT, FTM2_INT, FTM2_EXT, FTM3_INT, FTM3_EXT, ADC0_COCOA, ADC0_COCOB, ADC1_COCOA, ADC1_COCOB, PDB0_CH0, PDB0_PULSE_OUT, PDB1_CH0, PDB1_PULSE_OUT, RTC_ALARM, RTC_SEC_COUNTER, FLEXIO_TRIG0, FLEXIO_TRIG1, FLEXIO_TRIG2, FLEXIO_TRIG3, LPUART0_RX_DATA, LPUART0_TX_DATA, LPUART0_RX_IDLE, LPUART1_RX_DATA, LPUART1_TX_DATA, LPUART1_RX_IDLE, LPI2C0_MASTER_TRIGGER, LPI2C0_SLAVE_TRIGGER, LPSPI0_FRAME, LPSPI0_RX_DATA, LPSPI1_FRAME, LPSPI1_RX_DATA, SIM_SW_TRIGGER, LPI2C1_MASTER_TRIGGER, LPI2C1_SLAVE_TRIGGER, FTM4_INT, FTM4_EXT, FTM5_INT, FTM5_EXT, FTM6_INT, FTM6_EXT, FTM7_INT, FTM7_EXT}, origin=NXP, post-build-variant-value=true, set at pre-compile, default-value=INPUT_DISABLED  # Vendor specific: Used to configure the Ftm0 input 0.
        enumeration TrgMuxFtm0Input1: {INPUT_DISABLED, VDD, INPUT_0, INPUT_1, INPUT_2, INPUT_3, INPUT_4, INPUT_5, INPUT_6, INPUT_7, INPUT_8, INPUT_9, INPUT_10, INPUT_11, CMP0, LPIT_CH0, LPIT_CH1, LPIT_CH2, LPIT_CH3, LPTMR0_TRIGGER, FTM0_INT, FTM0_EXT, FTM1_INT, FTM1_EXT, FTM2_INT, FTM2_EXT, FTM3_INT, FTM3_EXT, ADC0_COCOA, ADC0_COCOB, ADC1_COCOA, ADC1_COCOB, PDB0_CH0, PDB0_PULSE_OUT, PDB1_CH0, PDB1_PULSE_OUT, RTC_ALARM, RTC_SEC_COUNTER, FLEXIO_TRIG0, FLEXIO_TRIG1, FLEXIO_TRIG2, FLEXIO_TRIG3, LPUART0_RX_DATA, LPUART0_TX_DATA, LPUART0_RX_IDLE, LPUART1_RX_DATA, LPUART1_TX_DATA, LPUART1_RX_IDLE, LPI2C0_MASTER_TRIGGER, LPI2C0_SLAVE_TRIGGER, LPSPI0_FRAME, LPSPI0_RX_DATA, LPSPI1_FRAME, LPSPI1_RX_DATA, SIM_SW_TRIGGER, LPI2C1_MASTER_TRIGGER, LPI2C1_SLAVE_TRIGGER, FTM4_INT, FTM4_EXT, FTM5_INT, FTM5_EXT, FTM6_INT, FTM6_EXT, FTM7_INT, FTM7_EXT}, origin=NXP, post-build-variant-value=true, set at pre-compile, default-value=INPUT_DISABLED  # Vendor specific: Used to configure the Ftm0 input 1.
        enumeration TrgMuxFtm0Input2: {INPUT_DISABLED, VDD, INPUT_0, INPUT_1, INPUT_2, INPUT_3, INPUT_4, INPUT_5, INPUT_6, INPUT_7, INPUT_8, INPUT_9, INPUT_10, INPUT_11, CMP0, LPIT_CH0, LPIT_CH1, LPIT_CH2, LPIT_CH3, LPTMR0_TRIGGER, FTM0_INT, FTM0_EXT, FTM1_INT, FTM1_EXT, FTM2_INT, FTM2_EXT, FTM3_INT, FTM3_EXT, ADC0_COCOA, ADC0_COCOB, ADC1_COCOA, ADC1_COCOB, PDB0_CH0, PDB0_PULSE_OUT, PDB1_CH0, PDB1_PULSE_OUT, RTC_ALARM, RTC_SEC_COUNTER, FLEXIO_TRIG0, FLEXIO_TRIG1, FLEXIO_TRIG2, FLEXIO_TRIG3, LPUART0_RX_DATA, LPUART0_TX_DATA, LPUART0_RX_IDLE, LPUART1_RX_DATA, LPUART1_TX_DATA, LPUART1_RX_IDLE, LPI2C0_MASTER_TRIGGER, LPI2C0_SLAVE_TRIGGER, LPSPI0_FRAME, LPSPI0_RX_DATA, LPSPI1_FRAME, LPSPI1_RX_DATA, SIM_SW_TRIGGER, LPI2C1_MASTER_TRIGGER, LPI2C1_SLAVE_TRIGGER, FTM4_INT, FTM4_EXT, FTM5_INT, FTM5_EXT, FTM6_INT, FTM6_EXT, FTM7_INT, FTM7_EXT}, origin=NXP, post-build-variant-value=true, set at pre-compile, default-value=INPUT_DISABLED  # Vendor specific: Used to configure the Ftm0 input 2.
        enumeration TrgMuxFtm0Input3: {INPUT_DISABLED, VDD, INPUT_0, INPUT_1, INPUT_2, INPUT_3, INPUT_4, INPUT_5, INPUT_6, INPUT_7, INPUT_8, INPUT_9, INPUT_10, INPUT_11, CMP0, LPIT_CH0, LPIT_CH1, LPIT_CH2, LPIT_CH3, LPTMR0_TRIGGER, FTM0_INT, FTM0_EXT, FTM1_INT, FTM1_EXT, FTM2_INT, FTM2_EXT, FTM3_INT, FTM3_EXT, ADC0_COCOA, ADC0_COCOB, ADC1_COCOA, ADC1_COCOB, PDB0_CH0, PDB0_PULSE_OUT, PDB1_CH0, PDB1_PULSE_OUT, RTC_ALARM, RTC_SEC_COUNTER, FLEXIO_TRIG0, FLEXIO_TRIG1, FLEXIO_TRIG2, FLEXIO_TRIG3, LPUART0_RX_DATA, LPUART0_TX_DATA, LPUART0_RX_IDLE, LPUART1_RX_DATA, LPUART1_TX_DATA, LPUART1_RX_IDLE, LPI2C0_MASTER_TRIGGER, LPI2C0_SLAVE_TRIGGER, LPSPI0_FRAME, LPSPI0_RX_DATA, LPSPI1_FRAME, LPSPI1_RX_DATA, SIM_SW_TRIGGER, LPI2C1_MASTER_TRIGGER, LPI2C1_SLAVE_TRIGGER, FTM4_INT, FTM4_EXT, FTM5_INT, FTM5_EXT, FTM6_INT, FTM6_EXT, FTM7_INT, FTM7_EXT}, origin=NXP, post-build-variant-value=true, set at pre-compile, default-value=INPUT_DISABLED  # Vendor specific: Used to configure the Ftm0 input 3.
        boolean TrgMuxFtm0LockEn: origin=NXP, post-build-variant-value=true, set at pre-compile, default-value=false  # Vendor specific: Configures if register Ftm0 must be locked(read-only).
        enumeration TrgMuxFtm1Input0: {INPUT_DISABLED, VDD, INPUT_0, INPUT_1, INPUT_2, INPUT_3, INPUT_4, INPUT_5, INPUT_6, INPUT_7, INPUT_8, INPUT_9, INPUT_10, INPUT_11, CMP0, LPIT_CH0, LPIT_CH1, LPIT_CH2, LPIT_CH3, LPTMR0_TRIGGER, FTM0_INT, FTM0_EXT, FTM1_INT, FTM1_EXT, FTM2_INT, FTM2_EXT, FTM3_INT, FTM3_EXT, ADC0_COCOA, ADC0_COCOB, ADC1_COCOA, ADC1_COCOB, PDB0_CH0, PDB0_PULSE_OUT, PDB1_CH0, PDB1_PULSE_OUT, RTC_ALARM, RTC_SEC_COUNTER, FLEXIO_TRIG0, FLEXIO_TRIG1, FLEXIO_TRIG2, FLEXIO_TRIG3, LPUART0_RX_DATA, LPUART0_TX_DATA, LPUART0_RX_IDLE, LPUART1_RX_DATA, LPUART1_TX_DATA, LPUART1_RX_IDLE, LPI2C0_MASTER_TRIGGER, LPI2C0_SLAVE_TRIGGER, LPSPI0_FRAME, LPSPI0_RX_DATA, LPSPI1_FRAME, LPSPI1_RX_DATA, SIM_SW_TRIGGER, LPI2C1_MASTER_TRIGGER, LPI2C1_SLAVE_TRIGGER, FTM4_INT, FTM4_EXT, FTM5_INT, FTM5_EXT, FTM6_INT, FTM6_EXT, FTM7_INT, FTM7_EXT}, origin=NXP, post-build-variant-value=true, set at pre-compile, default-value=INPUT_DISABLED  # Vendor specific: Used to configure Ftm1 input 0.
        enumeration TrgMuxFtm1Input1: {INPUT_DISABLED, VDD, INPUT_0, INPUT_1, INPUT_2, INPUT_3, INPUT_4, INPUT_5, INPUT_6, INPUT_7, INPUT_8, INPUT_9, INPUT_10, INPUT_11, CMP0, LPIT_CH0, LPIT_CH1, LPIT_CH2, LPIT_CH3, LPTMR0_TRIGGER, FTM0_INT, FTM0_EXT, FTM1_INT, FTM1_EXT, FTM2_INT, FTM2_EXT, FTM3_INT, FTM3_EXT, ADC0_COCOA, ADC0_COCOB, ADC1_COCOA, ADC1_COCOB, PDB0_CH0, PDB0_PULSE_OUT, PDB1_CH0, PDB1_PULSE_OUT, RTC_ALARM, RTC_SEC_COUNTER, FLEXIO_TRIG0, FLEXIO_TRIG1, FLEXIO_TRIG2, FLEXIO_TRIG3, LPUART0_RX_DATA, LPUART0_TX_DATA, LPUART0_RX_IDLE, LPUART1_RX_DATA, LPUART1_TX_DATA, LPUART1_RX_IDLE, LPI2C0_MASTER_TRIGGER, LPI2C0_SLAVE_TRIGGER, LPSPI0_FRAME, LPSPI0_RX_DATA, LPSPI1_FRAME, LPSPI1_RX_DATA, SIM_SW_TRIGGER, LPI2C1_MASTER_TRIGGER, LPI2C1_SLAVE_TRIGGER, FTM4_INT, FTM4_EXT, FTM5_INT, FTM5_EXT, FTM6_INT, FTM6_EXT, FTM7_INT, FTM7_EXT}, origin=NXP, post-build-variant-value=true, set at pre-compile, default-value=INPUT_DISABLED  # Vendor specific: Used to configure Ftm1 input 1.
        enumeration TrgMuxFtm1Input2: {INPUT_DISABLED, VDD, INPUT_0, INPUT_1, INPUT_2, INPUT_3, INPUT_4, INPUT_5, INPUT_6, INPUT_7, INPUT_8, INPUT_9, INPUT_10, INPUT_11, CMP0, LPIT_CH0, LPIT_CH1, LPIT_CH2, LPIT_CH3, LPTMR0_TRIGGER, FTM0_INT, FTM0_EXT, FTM1_INT, FTM1_EXT, FTM2_INT, FTM2_EXT, FTM3_INT, FTM3_EXT, ADC0_COCOA, ADC0_COCOB, ADC1_COCOA, ADC1_COCOB, PDB0_CH0, PDB0_PULSE_OUT, PDB1_CH0, PDB1_PULSE_OUT, RTC_ALARM, RTC_SEC_COUNTER, FLEXIO_TRIG0, FLEXIO_TRIG1, FLEXIO_TRIG2, FLEXIO_TRIG3, LPUART0_RX_DATA, LPUART0_TX_DATA, LPUART0_RX_IDLE, LPUART1_RX_DATA, LPUART1_TX_DATA, LPUART1_RX_IDLE, LPI2C0_MASTER_TRIGGER, LPI2C0_SLAVE_TRIGGER, LPSPI0_FRAME, LPSPI0_RX_DATA, LPSPI1_FRAME, LPSPI1_RX_DATA, SIM_SW_TRIGGER, LPI2C1_MASTER_TRIGGER, LPI2C1_SLAVE_TRIGGER, FTM4_INT, FTM4_EXT, FTM5_INT, FTM5_EXT, FTM6_INT, FTM6_EXT, FTM7_INT, FTM7_EXT}, origin=NXP, post-build-variant-value=true, set at pre-compile, default-value=INPUT_DISABLED  # Vendor specific: Used to configure Ftm1 input 2.
        enumeration TrgMuxFtm1Input3: {INPUT_DISABLED, VDD, INPUT_0, INPUT_1, INPUT_2, INPUT_3, INPUT_4, INPUT_5, INPUT_6, INPUT_7, INPUT_8, INPUT_9, INPUT_10, INPUT_11, CMP0, LPIT_CH0, LPIT_CH1, LPIT_CH2, LPIT_CH3, LPTMR0_TRIGGER, FTM0_INT, FTM0_EXT, FTM1_INT, FTM1_EXT, FTM2_INT, FTM2_EXT, FTM3_INT, FTM3_EXT, ADC0_COCOA, ADC0_COCOB, ADC1_COCOA, ADC1_COCOB, PDB0_CH0, PDB0_PULSE_OUT, PDB1_CH0, PDB1_PULSE_OUT, RTC_ALARM, RTC_SEC_COUNTER, FLEXIO_TRIG0, FLEXIO_TRIG1, FLEXIO_TRIG2, FLEXIO_TRIG3, LPUART0_RX_DATA, LPUART0_TX_DATA, LPUART0_RX_IDLE, LPUART1_RX_DATA, LPUART1_TX_DATA, LPUART1_RX_IDLE, LPI2C0_MASTER_TRIGGER, LPI2C0_SLAVE_TRIGGER, LPSPI0_FRAME, LPSPI0_RX_DATA, LPSPI1_FRAME, LPSPI1_RX_DATA, SIM_SW_TRIGGER, LPI2C1_MASTER_TRIGGER, LPI2C1_SLAVE_TRIGGER, FTM4_INT, FTM4_EXT, FTM5_INT, FTM5_EXT, FTM6_INT, FTM6_EXT, FTM7_INT, FTM7_EXT}, origin=NXP, post-build-variant-value=true, set at pre-compile, default-value=INPUT_DISABLED  # Vendor specific: Used to configure Ftm1 input 3.
        boolean TrgMuxFtm1LockEn: origin=NXP, post-build-variant-value=true, set at pre-compile, default-value=false  # Vendor specific: Configures if register Ftm1 must be locked(read-only).
        enumeration TrgMuxFtm2Input0: {INPUT_DISABLED, VDD, INPUT_0, INPUT_1, INPUT_2, INPUT_3, INPUT_4, INPUT_5, INPUT_6, INPUT_7, INPUT_8, INPUT_9, INPUT_10, INPUT_11, CMP0, LPIT_CH0, LPIT_CH1, LPIT_CH2, LPIT_CH3, LPTMR0_TRIGGER, FTM0_INT, FTM0_EXT, FTM1_INT, FTM1_EXT, FTM2_INT, FTM2_EXT, FTM3_INT, FTM3_EXT, ADC0_COCOA, ADC0_COCOB, ADC1_COCOA, ADC1_COCOB, PDB0_CH0, PDB0_PULSE_OUT, PDB1_CH0, PDB1_PULSE_OUT, RTC_ALARM, RTC_SEC_COUNTER, FLEXIO_TRIG0, FLEXIO_TRIG1, FLEXIO_TRIG2, FLEXIO_TRIG3, LPUART0_RX_DATA, LPUART0_TX_DATA, LPUART0_RX_IDLE, LPUART1_RX_DATA, LPUART1_TX_DATA, LPUART1_RX_IDLE, LPI2C0_MASTER_TRIGGER, LPI2C0_SLAVE_TRIGGER, LPSPI0_FRAME, LPSPI0_RX_DATA, LPSPI1_FRAME, LPSPI1_RX_DATA, SIM_SW_TRIGGER, LPI2C1_MASTER_TRIGGER, LPI2C1_SLAVE_TRIGGER, FTM4_INT, FTM4_EXT, FTM5_INT, FTM5_EXT, FTM6_INT, FTM6_EXT, FTM7_INT, FTM7_EXT}, origin=NXP, post-build-variant-value=true, set at pre-compile, default-value=INPUT_DISABLED  # Vendor specific: Used to configure the Ftm2 input 0.
        enumeration TrgMuxFtm2Input1: {INPUT_DISABLED, VDD, INPUT_0, INPUT_1, INPUT_2, INPUT_3, INPUT_4, INPUT_5, INPUT_6, INPUT_7, INPUT_8, INPUT_9, INPUT_10, INPUT_11, CMP0, LPIT_CH0, LPIT_CH1, LPIT_CH2, LPIT_CH3, LPTMR0_TRIGGER, FTM0_INT, FTM0_EXT, FTM1_INT, FTM1_EXT, FTM2_INT, FTM2_EXT, FTM3_INT, FTM3_EXT, ADC0_COCOA, ADC0_COCOB, ADC1_COCOA, ADC1_COCOB, PDB0_CH0, PDB0_PULSE_OUT, PDB1_CH0, PDB1_PULSE_OUT, RTC_ALARM, RTC_SEC_COUNTER, FLEXIO_TRIG0, FLEXIO_TRIG1, FLEXIO_TRIG2, FLEXIO_TRIG3, LPUART0_RX_DATA, LPUART0_TX_DATA, LPUART0_RX_IDLE, LPUART1_RX_DATA, LPUART1_TX_DATA, LPUART1_RX_IDLE, LPI2C0_MASTER_TRIGGER, LPI2C0_SLAVE_TRIGGER, LPSPI0_FRAME, LPSPI0_RX_DATA, LPSPI1_FRAME, LPSPI1_RX_DATA, SIM_SW_TRIGGER, LPI2C1_MASTER_TRIGGER, LPI2C1_SLAVE_TRIGGER, FTM4_INT, FTM4_EXT, FTM5_INT, FTM5_EXT, FTM6_INT, FTM6_EXT, FTM7_INT, FTM7_EXT}, origin=NXP, post-build-variant-value=true, set at pre-compile, default-value=INPUT_DISABLED  # Vendor specific: Used to configure the Ftm2 input 1.
        enumeration TrgMuxFtm2Input2: {INPUT_DISABLED, VDD, INPUT_0, INPUT_1, INPUT_2, INPUT_3, INPUT_4, INPUT_5, INPUT_6, INPUT_7, INPUT_8, INPUT_9, INPUT_10, INPUT_11, CMP0, LPIT_CH0, LPIT_CH1, LPIT_CH2, LPIT_CH3, LPTMR0_TRIGGER, FTM0_INT, FTM0_EXT, FTM1_INT, FTM1_EXT, FTM2_INT, FTM2_EXT, FTM3_INT, FTM3_EXT, ADC0_COCOA, ADC0_COCOB, ADC1_COCOA, ADC1_COCOB, PDB0_CH0, PDB0_PULSE_OUT, PDB1_CH0, PDB1_PULSE_OUT, RTC_ALARM, RTC_SEC_COUNTER, FLEXIO_TRIG0, FLEXIO_TRIG1, FLEXIO_TRIG2, FLEXIO_TRIG3, LPUART0_RX_DATA, LPUART0_TX_DATA, LPUART0_RX_IDLE, LPUART1_RX_DATA, LPUART1_TX_DATA, LPUART1_RX_IDLE, LPI2C0_MASTER_TRIGGER, LPI2C0_SLAVE_TRIGGER, LPSPI0_FRAME, LPSPI0_RX_DATA, LPSPI1_FRAME, LPSPI1_RX_DATA, SIM_SW_TRIGGER, LPI2C1_MASTER_TRIGGER, LPI2C1_SLAVE_TRIGGER, FTM4_INT, FTM4_EXT, FTM5_INT, FTM5_EXT, FTM6_INT, FTM6_EXT, FTM7_INT, FTM7_EXT}, origin=NXP, post-build-variant-value=true, set at pre-compile, default-value=INPUT_DISABLED  # Vendor specific: Used to configure the Ftm2 input 2.
        enumeration TrgMuxFtm2Input3: {INPUT_DISABLED, VDD, INPUT_0, INPUT_1, INPUT_2, INPUT_3, INPUT_4, INPUT_5, INPUT_6, INPUT_7, INPUT_8, INPUT_9, INPUT_10, INPUT_11, CMP0, LPIT_CH0, LPIT_CH1, LPIT_CH2, LPIT_CH3, LPTMR0_TRIGGER, FTM0_INT, FTM0_EXT, FTM1_INT, FTM1_EXT, FTM2_INT, FTM2_EXT, FTM3_INT, FTM3_EXT, ADC0_COCOA, ADC0_COCOB, ADC1_COCOA, ADC1_COCOB, PDB0_CH0, PDB0_PULSE_OUT, PDB1_CH0, PDB1_PULSE_OUT, RTC_ALARM, RTC_SEC_COUNTER, FLEXIO_TRIG0, FLEXIO_TRIG1, FLEXIO_TRIG2, FLEXIO_TRIG3, LPUART0_RX_DATA, LPUART0_TX_DATA, LPUART0_RX_IDLE, LPUART1_RX_DATA, LPUART1_TX_DATA, LPUART1_RX_IDLE, LPI2C0_MASTER_TRIGGER, LPI2C0_SLAVE_TRIGGER, LPSPI0_FRAME, LPSPI0_RX_DATA, LPSPI1_FRAME, LPSPI1_RX_DATA, SIM_SW_TRIGGER, LPI2C1_MASTER_TRIGGER, LPI2C1_SLAVE_TRIGGER, FTM4_INT, FTM4_EXT, FTM5_INT, FTM5_EXT, FTM6_INT, FTM6_EXT, FTM7_INT, FTM7_EXT}, origin=NXP, post-build-variant-value=true, set at pre-compile, default-value=INPUT_DISABLED  # Vendor specific: Used to configure the Ftm2 input 3.
        boolean TrgMuxFtm2LockEn: origin=NXP, post-build-variant-value=true, set at pre-compile, default-value=false  # Vendor specific: Configures if register Ftm2 must be locked(read-only).
        enumeration TrgMuxFtm3Input0: {INPUT_DISABLED, VDD, INPUT_0, INPUT_1, INPUT_2, INPUT_3, INPUT_4, INPUT_5, INPUT_6, INPUT_7, INPUT_8, INPUT_9, INPUT_10, INPUT_11, CMP0, LPIT_CH0, LPIT_CH1, LPIT_CH2, LPIT_CH3, LPTMR0_TRIGGER, FTM0_INT, FTM0_EXT, FTM1_INT, FTM1_EXT, FTM2_INT, FTM2_EXT, FTM3_INT, FTM3_EXT, ADC0_COCOA, ADC0_COCOB, ADC1_COCOA, ADC1_COCOB, PDB0_CH0, PDB0_PULSE_OUT, PDB1_CH0, PDB1_PULSE_OUT, RTC_ALARM, RTC_SEC_COUNTER, FLEXIO_TRIG0, FLEXIO_TRIG1, FLEXIO_TRIG2, FLEXIO_TRIG3, LPUART0_RX_DATA, LPUART0_TX_DATA, LPUART0_RX_IDLE, LPUART1_RX_DATA, LPUART1_TX_DATA, LPUART1_RX_IDLE, LPI2C0_MASTER_TRIGGER, LPI2C0_SLAVE_TRIGGER, LPSPI0_FRAME, LPSPI0_RX_DATA, LPSPI1_FRAME, LPSPI1_RX_DATA, SIM_SW_TRIGGER, LPI2C1_MASTER_TRIGGER, LPI2C1_SLAVE_TRIGGER, FTM4_INT, FTM4_EXT, FTM5_INT, FTM5_EXT, FTM6_INT, FTM6_EXT, FTM7_INT, FTM7_EXT}, origin=NXP, post-build-variant-value=true, set at pre-compile, default-value=INPUT_DISABLED  # Vendor specific: Used to configure Ftm3 input 0.
        enumeration TrgMuxFtm3Input1: {INPUT_DISABLED, VDD, INPUT_0, INPUT_1, INPUT_2, INPUT_3, INPUT_4, INPUT_5, INPUT_6, INPUT_7, INPUT_8, INPUT_9, INPUT_10, INPUT_11, CMP0, LPIT_CH0, LPIT_CH1, LPIT_CH2, LPIT_CH3, LPTMR0_TRIGGER, FTM0_INT, FTM0_EXT, FTM1_INT, FTM1_EXT, FTM2_INT, FTM2_EXT, FTM3_INT, FTM3_EXT, ADC0_COCOA, ADC0_COCOB, ADC1_COCOA, ADC1_COCOB, PDB0_CH0, PDB0_PULSE_OUT, PDB1_CH0, PDB1_PULSE_OUT, RTC_ALARM, RTC_SEC_COUNTER, FLEXIO_TRIG0, FLEXIO_TRIG1, FLEXIO_TRIG2, FLEXIO_TRIG3, LPUART0_RX_DATA, LPUART0_TX_DATA, LPUART0_RX_IDLE, LPUART1_RX_DATA, LPUART1_TX_DATA, LPUART1_RX_IDLE, LPI2C0_MASTER_TRIGGER, LPI2C0_SLAVE_TRIGGER, LPSPI0_FRAME, LPSPI0_RX_DATA, LPSPI1_FRAME, LPSPI1_RX_DATA, SIM_SW_TRIGGER, LPI2C1_MASTER_TRIGGER, LPI2C1_SLAVE_TRIGGER, FTM4_INT, FTM4_EXT, FTM5_INT, FTM5_EXT, FTM6_INT, FTM6_EXT, FTM7_INT, FTM7_EXT}, origin=NXP, post-build-variant-value=true, set at pre-compile, default-value=INPUT_DISABLED  # Vendor specific: Used to configure Ftm3 input 1.
        enumeration TrgMuxFtm3Input2: {INPUT_DISABLED, VDD, INPUT_0, INPUT_1, INPUT_2, INPUT_3, INPUT_4, INPUT_5, INPUT_6, INPUT_7, INPUT_8, INPUT_9, INPUT_10, INPUT_11, CMP0, LPIT_CH0, LPIT_CH1, LPIT_CH2, LPIT_CH3, LPTMR0_TRIGGER, FTM0_INT, FTM0_EXT, FTM1_INT, FTM1_EXT, FTM2_INT, FTM2_EXT, FTM3_INT, FTM3_EXT, ADC0_COCOA, ADC0_COCOB, ADC1_COCOA, ADC1_COCOB, PDB0_CH0, PDB0_PULSE_OUT, PDB1_CH0, PDB1_PULSE_OUT, RTC_ALARM, RTC_SEC_COUNTER, FLEXIO_TRIG0, FLEXIO_TRIG1, FLEXIO_TRIG2, FLEXIO_TRIG3, LPUART0_RX_DATA, LPUART0_TX_DATA, LPUART0_RX_IDLE, LPUART1_RX_DATA, LPUART1_TX_DATA, LPUART1_RX_IDLE, LPI2C0_MASTER_TRIGGER, LPI2C0_SLAVE_TRIGGER, LPSPI0_FRAME, LPSPI0_RX_DATA, LPSPI1_FRAME, LPSPI1_RX_DATA, SIM_SW_TRIGGER, LPI2C1_MASTER_TRIGGER, LPI2C1_SLAVE_TRIGGER, FTM4_INT, FTM4_EXT, FTM5_INT, FTM5_EXT, FTM6_INT, FTM6_EXT, FTM7_INT, FTM7_EXT}, origin=NXP, post-build-variant-value=true, set at pre-compile, default-value=INPUT_DISABLED  # Vendor specific: Used to configure Ftm3 input 2.
        enumeration TrgMuxFtm3Input3: {INPUT_DISABLED, VDD, INPUT_0, INPUT_1, INPUT_2, INPUT_3, INPUT_4, INPUT_5, INPUT_6, INPUT_7, INPUT_8, INPUT_9, INPUT_10, INPUT_11, CMP0, LPIT_CH0, LPIT_CH1, LPIT_CH2, LPIT_CH3, LPTMR0_TRIGGER, FTM0_INT, FTM0_EXT, FTM1_INT, FTM1_EXT, FTM2_INT, FTM2_EXT, FTM3_INT, FTM3_EXT, ADC0_COCOA, ADC0_COCOB, ADC1_COCOA, ADC1_COCOB, PDB0_CH0, PDB0_PULSE_OUT, PDB1_CH0, PDB1_PULSE_OUT, RTC_ALARM, RTC_SEC_COUNTER, FLEXIO_TRIG0, FLEXIO_TRIG1, FLEXIO_TRIG2, FLEXIO_TRIG3, LPUART0_RX_DATA, LPUART0_TX_DATA, LPUART0_RX_IDLE, LPUART1_RX_DATA, LPUART1_TX_DATA, LPUART1_RX_IDLE, LPI2C0_MASTER_TRIGGER, LPI2C0_SLAVE_TRIGGER, LPSPI0_FRAME, LPSPI0_RX_DATA, LPSPI1_FRAME, LPSPI1_RX_DATA, SIM_SW_TRIGGER, LPI2C1_MASTER_TRIGGER, LPI2C1_SLAVE_TRIGGER, FTM4_INT, FTM4_EXT, FTM5_INT, FTM5_EXT, FTM6_INT, FTM6_EXT, FTM7_INT, FTM7_EXT}, origin=NXP, post-build-variant-value=true, set at pre-compile, default-value=INPUT_DISABLED  # Vendor specific: Used to configure Ftm3 input 3.
        boolean TrgMuxFtm3LockEn: origin=NXP, post-build-variant-value=true, set at pre-compile, default-value=false  # Vendor specific: Configures if register Ftm3 must be locked(read-only).
        enumeration TrgMuxPdb0Input0: {INPUT_DISABLED, VDD, INPUT_0, INPUT_1, INPUT_2, INPUT_3, INPUT_4, INPUT_5, INPUT_6, INPUT_7, INPUT_8, INPUT_9, INPUT_10, INPUT_11, CMP0, LPIT_CH0, LPIT_CH1, LPIT_CH2, LPIT_CH3, LPTMR0_TRIGGER, FTM0_INT, FTM0_EXT, FTM1_INT, FTM1_EXT, FTM2_INT, FTM2_EXT, FTM3_INT, FTM3_EXT, ADC0_COCOA, ADC0_COCOB, ADC1_COCOA, ADC1_COCOB, PDB0_CH0, PDB0_PULSE_OUT, PDB1_CH0, PDB1_PULSE_OUT, RTC_ALARM, RTC_SEC_COUNTER, FLEXIO_TRIG0, FLEXIO_TRIG1, FLEXIO_TRIG2, FLEXIO_TRIG3, LPUART0_RX_DATA, LPUART0_TX_DATA, LPUART0_RX_IDLE, LPUART1_RX_DATA, LPUART1_TX_DATA, LPUART1_RX_IDLE, LPI2C0_MASTER_TRIGGER, LPI2C0_SLAVE_TRIGGER, LPSPI0_FRAME, LPSPI0_RX_DATA, LPSPI1_FRAME, LPSPI1_RX_DATA, SIM_SW_TRIGGER, LPI2C1_MASTER_TRIGGER, LPI2C1_SLAVE_TRIGGER, FTM4_INT, FTM4_EXT, FTM5_INT, FTM5_EXT, FTM6_INT, FTM6_EXT, FTM7_INT, FTM7_EXT}, origin=NXP, post-build-variant-value=true, set at pre-compile, default-value=INPUT_DISABLED  # Vendor specific: Used to configure the Pdb0input 0.
        boolean TrgMuxPdb0LockEn: origin=NXP, post-build-variant-value=true, set at pre-compile, default-value=false  # Vendor specific: Configures if register Pdb0 must be locked(read-only).
        enumeration TrgMuxPdb1Input0: {INPUT_DISABLED, VDD, INPUT_0, INPUT_1, INPUT_2, INPUT_3, INPUT_4, INPUT_5, INPUT_6, INPUT_7, INPUT_8, INPUT_9, INPUT_10, INPUT_11, CMP0, LPIT_CH0, LPIT_CH1, LPIT_CH2, LPIT_CH3, LPTMR0_TRIGGER, FTM0_INT, FTM0_EXT, FTM1_INT, FTM1_EXT, FTM2_INT, FTM2_EXT, FTM3_INT, FTM3_EXT, ADC0_COCOA, ADC0_COCOB, ADC1_COCOA, ADC1_COCOB, PDB0_CH0, PDB0_PULSE_OUT, PDB1_CH0, PDB1_PULSE_OUT, RTC_ALARM, RTC_SEC_COUNTER, FLEXIO_TRIG0, FLEXIO_TRIG1, FLEXIO_TRIG2, FLEXIO_TRIG3, LPUART0_RX_DATA, LPUART0_TX_DATA, LPUART0_RX_IDLE, LPUART1_RX_DATA, LPUART1_TX_DATA, LPUART1_RX_IDLE, LPI2C0_MASTER_TRIGGER, LPI2C0_SLAVE_TRIGGER, LPSPI0_FRAME, LPSPI0_RX_DATA, LPSPI1_FRAME, LPSPI1_RX_DATA, SIM_SW_TRIGGER, LPI2C1_MASTER_TRIGGER, LPI2C1_SLAVE_TRIGGER, FTM4_INT, FTM4_EXT, FTM5_INT, FTM5_EXT, FTM6_INT, FTM6_EXT, FTM7_INT, FTM7_EXT}, origin=NXP, post-build-variant-value=true, set at pre-compile, default-value=INPUT_DISABLED  # Vendor specific: Used to configure the Pdb1 input 0.
        boolean TrgMuxPdb1LockEn: origin=NXP, post-build-variant-value=true, set at pre-compile, default-value=false  # Vendor specific: Configures if register Pdb1 must be locked(read-only).
        enumeration TrgMuxFlexIoInput0: {INPUT_DISABLED, VDD, INPUT_0, INPUT_1, INPUT_2, INPUT_3, INPUT_4, INPUT_5, INPUT_6, INPUT_7, INPUT_8, INPUT_9, INPUT_10, INPUT_11, CMP0, LPIT_CH0, LPIT_CH1, LPIT_CH2, LPIT_CH3, LPTMR0_TRIGGER, FTM0_INT, FTM0_EXT, FTM1_INT, FTM1_EXT, FTM2_INT, FTM2_EXT, FTM3_INT, FTM3_EXT, ADC0_COCOA, ADC0_COCOB, ADC1_COCOA, ADC1_COCOB, PDB0_CH0, PDB0_PULSE_OUT, PDB1_CH0, PDB1_PULSE_OUT, RTC_ALARM, RTC_SEC_COUNTER, FLEXIO_TRIG0, FLEXIO_TRIG1, FLEXIO_TRIG2, FLEXIO_TRIG3, LPUART0_RX_DATA, LPUART0_TX_DATA, LPUART0_RX_IDLE, LPUART1_RX_DATA, LPUART1_TX_DATA, LPUART1_RX_IDLE, LPI2C0_MASTER_TRIGGER, LPI2C0_SLAVE_TRIGGER, LPSPI0_FRAME, LPSPI0_RX_DATA, LPSPI1_FRAME, LPSPI1_RX_DATA, SIM_SW_TRIGGER, LPI2C1_MASTER_TRIGGER, LPI2C1_SLAVE_TRIGGER, FTM4_INT, FTM4_EXT, FTM5_INT, FTM5_EXT, FTM6_INT, FTM6_EXT, FTM7_INT, FTM7_EXT}, origin=NXP, post-build-variant-value=true, set at pre-compile, default-value=INPUT_DISABLED  # Vendor specific: Used to configure the FlexIo input 0.
        enumeration TrgMuxFlexIoInput1: {INPUT_DISABLED, VDD, INPUT_0, INPUT_1, INPUT_2, INPUT_3, INPUT_4, INPUT_5, INPUT_6, INPUT_7, INPUT_8, INPUT_9, INPUT_10, INPUT_11, CMP0, LPIT_CH0, LPIT_CH1, LPIT_CH2, LPIT_CH3, LPTMR0_TRIGGER, FTM0_INT, FTM0_EXT, FTM1_INT, FTM1_EXT, FTM2_INT, FTM2_EXT, FTM3_INT, FTM3_EXT, ADC0_COCOA, ADC0_COCOB, ADC1_COCOA, ADC1_COCOB, PDB0_CH0, PDB0_PULSE_OUT, PDB1_CH0, PDB1_PULSE_OUT, RTC_ALARM, RTC_SEC_COUNTER, FLEXIO_TRIG0, FLEXIO_TRIG1, FLEXIO_TRIG2, FLEXIO_TRIG3, LPUART0_RX_DATA, LPUART0_TX_DATA, LPUART0_RX_IDLE, LPUART1_RX_DATA, LPUART1_TX_DATA, LPUART1_RX_IDLE, LPI2C0_MASTER_TRIGGER, LPI2C0_SLAVE_TRIGGER, LPSPI0_FRAME, LPSPI0_RX_DATA, LPSPI1_FRAME, LPSPI1_RX_DATA, SIM_SW_TRIGGER, LPI2C1_MASTER_TRIGGER, LPI2C1_SLAVE_TRIGGER, FTM4_INT, FTM4_EXT, FTM5_INT, FTM5_EXT, FTM6_INT, FTM6_EXT, FTM7_INT, FTM7_EXT}, origin=NXP, post-build-variant-value=true, set at pre-compile, default-value=INPUT_DISABLED  # Vendor specific: Used to configure the FlexIo input 1.
        enumeration TrgMuxFlexIoInput2: {INPUT_DISABLED, VDD, INPUT_0, INPUT_1, INPUT_2, INPUT_3, INPUT_4, INPUT_5, INPUT_6, INPUT_7, INPUT_8, INPUT_9, INPUT_10, INPUT_11, CMP0, LPIT_CH0, LPIT_CH1, LPIT_CH2, LPIT_CH3, LPTMR0_TRIGGER, FTM0_INT, FTM0_EXT, FTM1_INT, FTM1_EXT, FTM2_INT, FTM2_EXT, FTM3_INT, FTM3_EXT, ADC0_COCOA, ADC0_COCOB, ADC1_COCOA, ADC1_COCOB, PDB0_CH0, PDB0_PULSE_OUT, PDB1_CH0, PDB1_PULSE_OUT, RTC_ALARM, RTC_SEC_COUNTER, FLEXIO_TRIG0, FLEXIO_TRIG1, FLEXIO_TRIG2, FLEXIO_TRIG3, LPUART0_RX_DATA, LPUART0_TX_DATA, LPUART0_RX_IDLE, LPUART1_RX_DATA, LPUART1_TX_DATA, LPUART1_RX_IDLE, LPI2C0_MASTER_TRIGGER, LPI2C0_SLAVE_TRIGGER, LPSPI0_FRAME, LPSPI0_RX_DATA, LPSPI1_FRAME, LPSPI1_RX_DATA, SIM_SW_TRIGGER, LPI2C1_MASTER_TRIGGER, LPI2C1_SLAVE_TRIGGER, FTM4_INT, FTM4_EXT, FTM5_INT, FTM5_EXT, FTM6_INT, FTM6_EXT, FTM7_INT, FTM7_EXT}, origin=NXP, post-build-variant-value=true, set at pre-compile, default-value=INPUT_DISABLED  # Vendor specific: Used to configure the FlexIo input 2.
        enumeration TrgMuxFlexIoInput3: {INPUT_DISABLED, VDD, INPUT_0, INPUT_1, INPUT_2, INPUT_3, INPUT_4, INPUT_5, INPUT_6, INPUT_7, INPUT_8, INPUT_9, INPUT_10, INPUT_11, CMP0, LPIT_CH0, LPIT_CH1, LPIT_CH2, LPIT_CH3, LPTMR0_TRIGGER, FTM0_INT, FTM0_EXT, FTM1_INT, FTM1_EXT, FTM2_INT, FTM2_EXT, FTM3_INT, FTM3_EXT, ADC0_COCOA, ADC0_COCOB, ADC1_COCOA, ADC1_COCOB, PDB0_CH0, PDB0_PULSE_OUT, PDB1_CH0, PDB1_PULSE_OUT, RTC_ALARM, RTC_SEC_COUNTER, FLEXIO_TRIG0, FLEXIO_TRIG1, FLEXIO_TRIG2, FLEXIO_TRIG3, LPUART0_RX_DATA, LPUART0_TX_DATA, LPUART0_RX_IDLE, LPUART1_RX_DATA, LPUART1_TX_DATA, LPUART1_RX_IDLE, LPI2C0_MASTER_TRIGGER, LPI2C0_SLAVE_TRIGGER, LPSPI0_FRAME, LPSPI0_RX_DATA, LPSPI1_FRAME, LPSPI1_RX_DATA, SIM_SW_TRIGGER, LPI2C1_MASTER_TRIGGER, LPI2C1_SLAVE_TRIGGER, FTM4_INT, FTM4_EXT, FTM5_INT, FTM5_EXT, FTM6_INT, FTM6_EXT, FTM7_INT, FTM7_EXT}, origin=NXP, post-build-variant-value=true, set at pre-compile, default-value=INPUT_DISABLED  # Vendor specific: Used to configure the FlexIo input 3.
        boolean TrgMuxFlexIoLockEn: origin=NXP, post-build-variant-value=true, set at pre-compile, default-value=false  # Vendor specific: Configures if register FlexIo must be locked(read-only).
        enumeration TrgMuxLpitInput0: {INPUT_DISABLED, VDD, INPUT_0, INPUT_1, INPUT_2, INPUT_3, INPUT_4, INPUT_5, INPUT_6, INPUT_7, INPUT_8, INPUT_9, INPUT_10, INPUT_11, CMP0, LPIT_CH0, LPIT_CH1, LPIT_CH2, LPIT_CH3, LPTMR0_TRIGGER, FTM0_INT, FTM0_EXT, FTM1_INT, FTM1_EXT, FTM2_INT, FTM2_EXT, FTM3_INT, FTM3_EXT, ADC0_COCOA, ADC0_COCOB, ADC1_COCOA, ADC1_COCOB, PDB0_CH0, PDB0_PULSE_OUT, PDB1_CH0, PDB1_PULSE_OUT, RTC_ALARM, RTC_SEC_COUNTER, FLEXIO_TRIG0, FLEXIO_TRIG1, FLEXIO_TRIG2, FLEXIO_TRIG3, LPUART0_RX_DATA, LPUART0_TX_DATA, LPUART0_RX_IDLE, LPUART1_RX_DATA, LPUART1_TX_DATA, LPUART1_RX_IDLE, LPI2C0_MASTER_TRIGGER, LPI2C0_SLAVE_TRIGGER, LPSPI0_FRAME, LPSPI0_RX_DATA, LPSPI1_FRAME, LPSPI1_RX_DATA, SIM_SW_TRIGGER, LPI2C1_MASTER_TRIGGER, LPI2C1_SLAVE_TRIGGER, FTM4_INT, FTM4_EXT, FTM5_INT, FTM5_EXT, FTM6_INT, FTM6_EXT, FTM7_INT, FTM7_EXT}, origin=NXP, post-build-variant-value=true, set at pre-compile, default-value=INPUT_DISABLED  # Vendor specific: Used to configure the Lpit input 0.
        enumeration TrgMuxLpitInput1: {INPUT_DISABLED, VDD, INPUT_0, INPUT_1, INPUT_2, INPUT_3, INPUT_4, INPUT_5, INPUT_6, INPUT_7, INPUT_8, INPUT_9, INPUT_10, INPUT_11, CMP0, LPIT_CH0, LPIT_CH1, LPIT_CH2, LPIT_CH3, LPTMR0_TRIGGER, FTM0_INT, FTM0_EXT, FTM1_INT, FTM1_EXT, FTM2_INT, FTM2_EXT, FTM3_INT, FTM3_EXT, ADC0_COCOA, ADC0_COCOB, ADC1_COCOA, ADC1_COCOB, PDB0_CH0, PDB0_PULSE_OUT, PDB1_CH0, PDB1_PULSE_OUT, RTC_ALARM, RTC_SEC_COUNTER, FLEXIO_TRIG0, FLEXIO_TRIG1, FLEXIO_TRIG2, FLEXIO_TRIG3, LPUART0_RX_DATA, LPUART0_TX_DATA, LPUART0_RX_IDLE, LPUART1_RX_DATA, LPUART1_TX_DATA, LPUART1_RX_IDLE, LPI2C0_MASTER_TRIGGER, LPI2C0_SLAVE_TRIGGER, LPSPI0_FRAME, LPSPI0_RX_DATA, LPSPI1_FRAME, LPSPI1_RX_DATA, SIM_SW_TRIGGER, LPI2C1_MASTER_TRIGGER, LPI2C1_SLAVE_TRIGGER, FTM4_INT, FTM4_EXT, FTM5_INT, FTM5_EXT, FTM6_INT, FTM6_EXT, FTM7_INT, FTM7_EXT}, origin=NXP, post-build-variant-value=true, set at pre-compile, default-value=INPUT_DISABLED  # Vendor specific: Used to configure the Lpit input 1.
        enumeration TrgMuxLpitInput2: {INPUT_DISABLED, VDD, INPUT_0, INPUT_1, INPUT_2, INPUT_3, INPUT_4, INPUT_5, INPUT_6, INPUT_7, INPUT_8, INPUT_9, INPUT_10, INPUT_11, CMP0, LPIT_CH0, LPIT_CH1, LPIT_CH2, LPIT_CH3, LPTMR0_TRIGGER, FTM0_INT, FTM0_EXT, FTM1_INT, FTM1_EXT, FTM2_INT, FTM2_EXT, FTM3_INT, FTM3_EXT, ADC0_COCOA, ADC0_COCOB, ADC1_COCOA, ADC1_COCOB, PDB0_CH0, PDB0_PULSE_OUT, PDB1_CH0, PDB1_PULSE_OUT, RTC_ALARM, RTC_SEC_COUNTER, FLEXIO_TRIG0, FLEXIO_TRIG1, FLEXIO_TRIG2, FLEXIO_TRIG3, LPUART0_RX_DATA, LPUART0_TX_DATA, LPUART0_RX_IDLE, LPUART1_RX_DATA, LPUART1_TX_DATA, LPUART1_RX_IDLE, LPI2C0_MASTER_TRIGGER, LPI2C0_SLAVE_TRIGGER, LPSPI0_FRAME, LPSPI0_RX_DATA, LPSPI1_FRAME, LPSPI1_RX_DATA, SIM_SW_TRIGGER, LPI2C1_MASTER_TRIGGER, LPI2C1_SLAVE_TRIGGER, FTM4_INT, FTM4_EXT, FTM5_INT, FTM5_EXT, FTM6_INT, FTM6_EXT, FTM7_INT, FTM7_EXT}, origin=NXP, post-build-variant-value=true, set at pre-compile, default-value=INPUT_DISABLED  # Vendor specific: Used to configure the Lpit input 2.
        enumeration TrgMuxLpitInput3: {INPUT_DISABLED, VDD, INPUT_0, INPUT_1, INPUT_2, INPUT_3, INPUT_4, INPUT_5, INPUT_6, INPUT_7, INPUT_8, INPUT_9, INPUT_10, INPUT_11, CMP0, LPIT_CH0, LPIT_CH1, LPIT_CH2, LPIT_CH3, LPTMR0_TRIGGER, FTM0_INT, FTM0_EXT, FTM1_INT, FTM1_EXT, FTM2_INT, FTM2_EXT, FTM3_INT, FTM3_EXT, ADC0_COCOA, ADC0_COCOB, ADC1_COCOA, ADC1_COCOB, PDB0_CH0, PDB0_PULSE_OUT, PDB1_CH0, PDB1_PULSE_OUT, RTC_ALARM, RTC_SEC_COUNTER, FLEXIO_TRIG0, FLEXIO_TRIG1, FLEXIO_TRIG2, FLEXIO_TRIG3, LPUART0_RX_DATA, LPUART0_TX_DATA, LPUART0_RX_IDLE, LPUART1_RX_DATA, LPUART1_TX_DATA, LPUART1_RX_IDLE, LPI2C0_MASTER_TRIGGER, LPI2C0_SLAVE_TRIGGER, LPSPI0_FRAME, LPSPI0_RX_DATA, LPSPI1_FRAME, LPSPI1_RX_DATA, SIM_SW_TRIGGER, LPI2C1_MASTER_TRIGGER, LPI2C1_SLAVE_TRIGGER, FTM4_INT, FTM4_EXT, FTM5_INT, FTM5_EXT, FTM6_INT, FTM6_EXT, FTM7_INT, FTM7_EXT}, origin=NXP, post-build-variant-value=true, set at pre-compile, default-value=INPUT_DISABLED  # Vendor specific: Used to configure the Lpit input 3.
        boolean TrgMuxLpitLockEn: origin=NXP, post-build-variant-value=true, set at pre-compile, default-value=false  # Vendor specific: Configures if register Lpit must be locked(read-only).
        enumeration TrgMuxLpuart0Input0: {INPUT_DISABLED, VDD, INPUT_0, INPUT_1, INPUT_2, INPUT_3, INPUT_4, INPUT_5, INPUT_6, INPUT_7, INPUT_8, INPUT_9, INPUT_10, INPUT_11, CMP0, LPIT_CH0, LPIT_CH1, LPIT_CH2, LPIT_CH3, LPTMR0_TRIGGER, FTM0_INT, FTM0_EXT, FTM1_INT, FTM1_EXT, FTM2_INT, FTM2_EXT, FTM3_INT, FTM3_EXT, ADC0_COCOA, ADC0_COCOB, ADC1_COCOA, ADC1_COCOB, PDB0_CH0, PDB0_PULSE_OUT, PDB1_CH0, PDB1_PULSE_OUT, RTC_ALARM, RTC_SEC_COUNTER, FLEXIO_TRIG0, FLEXIO_TRIG1, FLEXIO_TRIG2, FLEXIO_TRIG3, LPUART0_RX_DATA, LPUART0_TX_DATA, LPUART0_RX_IDLE, LPUART1_RX_DATA, LPUART1_TX_DATA, LPUART1_RX_IDLE, LPI2C0_MASTER_TRIGGER, LPI2C0_SLAVE_TRIGGER, LPSPI0_FRAME, LPSPI0_RX_DATA, LPSPI1_FRAME, LPSPI1_RX_DATA, SIM_SW_TRIGGER, LPI2C1_MASTER_TRIGGER, LPI2C1_SLAVE_TRIGGER, FTM4_INT, FTM4_EXT, FTM5_INT, FTM5_EXT, FTM6_INT, FTM6_EXT, FTM7_INT, FTM7_EXT}, origin=NXP, post-build-variant-value=true, set at pre-compile, default-value=INPUT_DISABLED  # Vendor specific: Used to configure the Lpuart0 input 0.
        boolean TrgMuxLpuart0LockEn: origin=NXP, post-build-variant-value=true, set at pre-compile, default-value=false  # Vendor specific: Configures if register Lpuart0 must be locked(read-only).
        enumeration TrgMuxLpuart1Input0: {INPUT_DISABLED, VDD, INPUT_0, INPUT_1, INPUT_2, INPUT_3, INPUT_4, INPUT_5, INPUT_6, INPUT_7, INPUT_8, INPUT_9, INPUT_10, INPUT_11, CMP0, LPIT_CH0, LPIT_CH1, LPIT_CH2, LPIT_CH3, LPTMR0_TRIGGER, FTM0_INT, FTM0_EXT, FTM1_INT, FTM1_EXT, FTM2_INT, FTM2_EXT, FTM3_INT, FTM3_EXT, ADC0_COCOA, ADC0_COCOB, ADC1_COCOA, ADC1_COCOB, PDB0_CH0, PDB0_PULSE_OUT, PDB1_CH0, PDB1_PULSE_OUT, RTC_ALARM, RTC_SEC_COUNTER, FLEXIO_TRIG0, FLEXIO_TRIG1, FLEXIO_TRIG2, FLEXIO_TRIG3, LPUART0_RX_DATA, LPUART0_TX_DATA, LPUART0_RX_IDLE, LPUART1_RX_DATA, LPUART1_TX_DATA, LPUART1_RX_IDLE, LPI2C0_MASTER_TRIGGER, LPI2C0_SLAVE_TRIGGER, LPSPI0_FRAME, LPSPI0_RX_DATA, LPSPI1_FRAME, LPSPI1_RX_DATA, SIM_SW_TRIGGER, LPI2C1_MASTER_TRIGGER, LPI2C1_SLAVE_TRIGGER, FTM4_INT, FTM4_EXT, FTM5_INT, FTM5_EXT, FTM6_INT, FTM6_EXT, FTM7_INT, FTM7_EXT}, origin=NXP, post-build-variant-value=true, set at pre-compile, default-value=INPUT_DISABLED  # Vendor specific: Used to configure the Lpuart1 input 0.
        boolean TrgMuxLpuart1LockEn: origin=NXP, post-build-variant-value=true, set at pre-compile, default-value=false  # Vendor specific: Configures if register Lpuart1 must be locked(read-only).
        enumeration TrgMuxLpi2c0Input0: {INPUT_DISABLED, VDD, INPUT_0, INPUT_1, INPUT_2, INPUT_3, INPUT_4, INPUT_5, INPUT_6, INPUT_7, INPUT_8, INPUT_9, INPUT_10, INPUT_11, CMP0, LPIT_CH0, LPIT_CH1, LPIT_CH2, LPIT_CH3, LPTMR0_TRIGGER, FTM0_INT, FTM0_EXT, FTM1_INT, FTM1_EXT, FTM2_INT, FTM2_EXT, FTM3_INT, FTM3_EXT, ADC0_COCOA, ADC0_COCOB, ADC1_COCOA, ADC1_COCOB, PDB0_CH0, PDB0_PULSE_OUT, PDB1_CH0, PDB1_PULSE_OUT, RTC_ALARM, RTC_SEC_COUNTER, FLEXIO_TRIG0, FLEXIO_TRIG1, FLEXIO_TRIG2, FLEXIO_TRIG3, LPUART0_RX_DATA, LPUART0_TX_DATA, LPUART0_RX_IDLE, LPUART1_RX_DATA, LPUART1_TX_DATA, LPUART1_RX_IDLE, LPI2C0_MASTER_TRIGGER, LPI2C0_SLAVE_TRIGGER, LPSPI0_FRAME, LPSPI0_RX_DATA, LPSPI1_FRAME, LPSPI1_RX_DATA, SIM_SW_TRIGGER, LPI2C1_MASTER_TRIGGER, LPI2C1_SLAVE_TRIGGER, FTM4_INT, FTM4_EXT, FTM5_INT, FTM5_EXT, FTM6_INT, FTM6_EXT, FTM7_INT, FTM7_EXT}, origin=NXP, post-build-variant-value=true, set at pre-compile, default-value=INPUT_DISABLED  # Vendor specific: Used to configure the Lpi2c0 input 0.
        boolean TrgMuxLpi2c0LockEn: origin=NXP, post-build-variant-value=true, set at pre-compile, default-value=false  # Vendor specific: Configures if register Lpi2c0 must be locked(read-only).
        enumeration TrgMuxLpspi0Input0: {INPUT_DISABLED, VDD, INPUT_0, INPUT_1, INPUT_2, INPUT_3, INPUT_4, INPUT_5, INPUT_6, INPUT_7, INPUT_8, INPUT_9, INPUT_10, INPUT_11, CMP0, LPIT_CH0, LPIT_CH1, LPIT_CH2, LPIT_CH3, LPTMR0_TRIGGER, FTM0_INT, FTM0_EXT, FTM1_INT, FTM1_EXT, FTM2_INT, FTM2_EXT, FTM3_INT, FTM3_EXT, ADC0_COCOA, ADC0_COCOB, ADC1_COCOA, ADC1_COCOB, PDB0_CH0, PDB0_PULSE_OUT, PDB1_CH0, PDB1_PULSE_OUT, RTC_ALARM, RTC_SEC_COUNTER, FLEXIO_TRIG0, FLEXIO_TRIG1, FLEXIO_TRIG2, FLEXIO_TRIG3, LPUART0_RX_DATA, LPUART0_TX_DATA, LPUART0_RX_IDLE, LPUART1_RX_DATA, LPUART1_TX_DATA, LPUART1_RX_IDLE, LPI2C0_MASTER_TRIGGER, LPI2C0_SLAVE_TRIGGER, LPSPI0_FRAME, LPSPI0_RX_DATA, LPSPI1_FRAME, LPSPI1_RX_DATA, SIM_SW_TRIGGER, LPI2C1_MASTER_TRIGGER, LPI2C1_SLAVE_TRIGGER, FTM4_INT, FTM4_EXT, FTM5_INT, FTM5_EXT, FTM6_INT, FTM6_EXT, FTM7_INT, FTM7_EXT}, origin=NXP, post-build-variant-value=true, set at pre-compile, default-value=INPUT_DISABLED  # Vendor specific: Used to configure the Lpspi0 input 0.
        boolean TrgMuxLpspi0LockEn: origin=NXP, post-build-variant-value=true, set at pre-compile, default-value=false  # Vendor specific: Configures if register Lpspi0 must be locked(read-only).
        enumeration TrgMuxLpspi1Input0: {INPUT_DISABLED, VDD, INPUT_0, INPUT_1, INPUT_2, INPUT_3, INPUT_4, INPUT_5, INPUT_6, INPUT_7, INPUT_8, INPUT_9, INPUT_10, INPUT_11, CMP0, LPIT_CH0, LPIT_CH1, LPIT_CH2, LPIT_CH3, LPTMR0_TRIGGER, FTM0_INT, FTM0_EXT, FTM1_INT, FTM1_EXT, FTM2_INT, FTM2_EXT, FTM3_INT, FTM3_EXT, ADC0_COCOA, ADC0_COCOB, ADC1_COCOA, ADC1_COCOB, PDB0_CH0, PDB0_PULSE_OUT, PDB1_CH0, PDB1_PULSE_OUT, RTC_ALARM, RTC_SEC_COUNTER, FLEXIO_TRIG0, FLEXIO_TRIG1, FLEXIO_TRIG2, FLEXIO_TRIG3, LPUART0_RX_DATA, LPUART0_TX_DATA, LPUART0_RX_IDLE, LPUART1_RX_DATA, LPUART1_TX_DATA, LPUART1_RX_IDLE, LPI2C0_MASTER_TRIGGER, LPI2C0_SLAVE_TRIGGER, LPSPI0_FRAME, LPSPI0_RX_DATA, LPSPI1_FRAME, LPSPI1_RX_DATA, SIM_SW_TRIGGER, LPI2C1_MASTER_TRIGGER, LPI2C1_SLAVE_TRIGGER, FTM4_INT, FTM4_EXT, FTM5_INT, FTM5_EXT, FTM6_INT, FTM6_EXT, FTM7_INT, FTM7_EXT}, origin=NXP, post-build-variant-value=true, set at pre-compile, default-value=INPUT_DISABLED  # Vendor specific: Used to configure the Lpspi1 input 0.
        boolean TrgMuxLpspi1LockEn: origin=NXP, post-build-variant-value=true, set at pre-compile, default-value=false  # Vendor specific: Configures if register Lpspi1 must be locked(read-only).
        enumeration TrgMuxLptmr0Input0: {INPUT_DISABLED, VDD, INPUT_0, INPUT_1, INPUT_2, INPUT_3, INPUT_4, INPUT_5, INPUT_6, INPUT_7, INPUT_8, INPUT_9, INPUT_10, INPUT_11, CMP0, LPIT_CH0, LPIT_CH1, LPIT_CH2, LPIT_CH3, LPTMR0_TRIGGER, FTM0_INT, FTM0_EXT, FTM1_INT, FTM1_EXT, FTM2_INT, FTM2_EXT, FTM3_INT, FTM3_EXT, ADC0_COCOA, ADC0_COCOB, ADC1_COCOA, ADC1_COCOB, PDB0_CH0, PDB0_PULSE_OUT, PDB1_CH0, PDB1_PULSE_OUT, RTC_ALARM, RTC_SEC_COUNTER, FLEXIO_TRIG0, FLEXIO_TRIG1, FLEXIO_TRIG2, FLEXIO_TRIG3, LPUART0_RX_DATA, LPUART0_TX_DATA, LPUART0_RX_IDLE, LPUART1_RX_DATA, LPUART1_TX_DATA, LPUART1_RX_IDLE, LPI2C0_MASTER_TRIGGER, LPI2C0_SLAVE_TRIGGER, LPSPI0_FRAME, LPSPI0_RX_DATA, LPSPI1_FRAME, LPSPI1_RX_DATA, SIM_SW_TRIGGER, LPI2C1_MASTER_TRIGGER, LPI2C1_SLAVE_TRIGGER, FTM4_INT, FTM4_EXT, FTM5_INT, FTM5_EXT, FTM6_INT, FTM6_EXT, FTM7_INT, FTM7_EXT}, origin=NXP, post-build-variant-value=true, set at pre-compile, default-value=INPUT_DISABLED  # Vendor specific: Used to configure the Lptmr0 input 0.
        boolean TrgMuxLptmr0LockEn: origin=NXP, post-build-variant-value=true, set at pre-compile, default-value=false  # Vendor specific: Configures if register Lptmr0 must be locked(read-only).
        enumeration TrgMuxLpi2c1Input0: {INPUT_DISABLED, VDD, INPUT_0, INPUT_1, INPUT_2, INPUT_3, INPUT_4, INPUT_5, INPUT_6, INPUT_7, INPUT_8, INPUT_9, INPUT_10, INPUT_11, CMP0, LPIT_CH0, LPIT_CH1, LPIT_CH2, LPIT_CH3, LPTMR0_TRIGGER, FTM0_INT, FTM0_EXT, FTM1_INT, FTM1_EXT, FTM2_INT, FTM2_EXT, FTM3_INT, FTM3_EXT, ADC0_COCOA, ADC0_COCOB, ADC1_COCOA, ADC1_COCOB, PDB0_CH0, PDB0_PULSE_OUT, PDB1_CH0, PDB1_PULSE_OUT, RTC_ALARM, RTC_SEC_COUNTER, FLEXIO_TRIG0, FLEXIO_TRIG1, FLEXIO_TRIG2, FLEXIO_TRIG3, LPUART0_RX_DATA, LPUART0_TX_DATA, LPUART0_RX_IDLE, LPUART1_RX_DATA, LPUART1_TX_DATA, LPUART1_RX_IDLE, LPI2C0_MASTER_TRIGGER, LPI2C0_SLAVE_TRIGGER, LPSPI0_FRAME, LPSPI0_RX_DATA, LPSPI1_FRAME, LPSPI1_RX_DATA, SIM_SW_TRIGGER, LPI2C1_MASTER_TRIGGER, LPI2C1_SLAVE_TRIGGER, FTM4_INT, FTM4_EXT, FTM5_INT, FTM5_EXT, FTM6_INT, FTM6_EXT, FTM7_INT, FTM7_EXT}, origin=NXP, post-build-variant-value=true, set at pre-compile, default-value=INPUT_DISABLED  # Vendor specific: Used to configure the Lpi2c0 input 0.
        boolean TrgMuxLpi2c1LockEn: origin=NXP, post-build-variant-value=true, set at pre-compile, default-value=false  # Vendor specific: Configures if register Lpi2c0 must be locked(read-only).
        enumeration TrgMuxFtm4Input0: {INPUT_DISABLED, VDD, INPUT_0, INPUT_1, INPUT_2, INPUT_3, INPUT_4, INPUT_5, INPUT_6, INPUT_7, INPUT_8, INPUT_9, INPUT_10, INPUT_11, CMP0, LPIT_CH0, LPIT_CH1, LPIT_CH2, LPIT_CH3, LPTMR0_TRIGGER, FTM0_INT, FTM0_EXT, FTM1_INT, FTM1_EXT, FTM2_INT, FTM2_EXT, FTM3_INT, FTM3_EXT, ADC0_COCOA, ADC0_COCOB, ADC1_COCOA, ADC1_COCOB, PDB0_CH0, PDB0_PULSE_OUT, PDB1_CH0, PDB1_PULSE_OUT, RTC_ALARM, RTC_SEC_COUNTER, FLEXIO_TRIG0, FLEXIO_TRIG1, FLEXIO_TRIG2, FLEXIO_TRIG3, LPUART0_RX_DATA, LPUART0_TX_DATA, LPUART0_RX_IDLE, LPUART1_RX_DATA, LPUART1_TX_DATA, LPUART1_RX_IDLE, LPI2C0_MASTER_TRIGGER, LPI2C0_SLAVE_TRIGGER, LPSPI0_FRAME, LPSPI0_RX_DATA, LPSPI1_FRAME, LPSPI1_RX_DATA, SIM_SW_TRIGGER, LPI2C1_MASTER_TRIGGER, LPI2C1_SLAVE_TRIGGER, FTM4_INT, FTM4_EXT, FTM5_INT, FTM5_EXT, FTM6_INT, FTM6_EXT, FTM7_INT, FTM7_EXT}, origin=NXP, post-build-variant-value=true, set at pre-compile, default-value=INPUT_DISABLED  # Vendor specific: Used to configure the FTM4 input 0.
        boolean TrgMuxFtm4LockEn: origin=NXP, post-build-variant-value=true, set at pre-compile, default-value=false  # Vendor specific: Configures if register FTM4 must be locked(read-only).
        enumeration TrgMuxFtm5Input0: {INPUT_DISABLED, VDD, INPUT_0, INPUT_1, INPUT_2, INPUT_3, INPUT_4, INPUT_5, INPUT_6, INPUT_7, INPUT_8, INPUT_9, INPUT_10, INPUT_11, CMP0, LPIT_CH0, LPIT_CH1, LPIT_CH2, LPIT_CH3, LPTMR0_TRIGGER, FTM0_INT, FTM0_EXT, FTM1_INT, FTM1_EXT, FTM2_INT, FTM2_EXT, FTM3_INT, FTM3_EXT, ADC0_COCOA, ADC0_COCOB, ADC1_COCOA, ADC1_COCOB, PDB0_CH0, PDB0_PULSE_OUT, PDB1_CH0, PDB1_PULSE_OUT, RTC_ALARM, RTC_SEC_COUNTER, FLEXIO_TRIG0, FLEXIO_TRIG1, FLEXIO_TRIG2, FLEXIO_TRIG3, LPUART0_RX_DATA, LPUART0_TX_DATA, LPUART0_RX_IDLE, LPUART1_RX_DATA, LPUART1_TX_DATA, LPUART1_RX_IDLE, LPI2C0_MASTER_TRIGGER, LPI2C0_SLAVE_TRIGGER, LPSPI0_FRAME, LPSPI0_RX_DATA, LPSPI1_FRAME, LPSPI1_RX_DATA, SIM_SW_TRIGGER, LPI2C1_MASTER_TRIGGER, LPI2C1_SLAVE_TRIGGER, FTM4_INT, FTM4_EXT, FTM5_INT, FTM5_EXT, FTM6_INT, FTM6_EXT, FTM7_INT, FTM7_EXT}, origin=NXP, post-build-variant-value=true, set at pre-compile, default-value=INPUT_DISABLED  # Vendor specific: Used to configure the FTM5 input 0.
        boolean TrgMuxFtm5LockEn: origin=NXP, post-build-variant-value=true, set at pre-compile, default-value=false  # Vendor specific: Configures if register FTM5 must be locked(read-only).
        enumeration TrgMuxFtm6Input0: {INPUT_DISABLED, VDD, INPUT_0, INPUT_1, INPUT_2, INPUT_3, INPUT_4, INPUT_5, INPUT_6, INPUT_7, INPUT_8, INPUT_9, INPUT_10, INPUT_11, CMP0, LPIT_CH0, LPIT_CH1, LPIT_CH2, LPIT_CH3, LPTMR0_TRIGGER, FTM0_INT, FTM0_EXT, FTM1_INT, FTM1_EXT, FTM2_INT, FTM2_EXT, FTM3_INT, FTM3_EXT, ADC0_COCOA, ADC0_COCOB, ADC1_COCOA, ADC1_COCOB, PDB0_CH0, PDB0_PULSE_OUT, PDB1_CH0, PDB1_PULSE_OUT, RTC_ALARM, RTC_SEC_COUNTER, FLEXIO_TRIG0, FLEXIO_TRIG1, FLEXIO_TRIG2, FLEXIO_TRIG3, LPUART0_RX_DATA, LPUART0_TX_DATA, LPUART0_RX_IDLE, LPUART1_RX_DATA, LPUART1_TX_DATA, LPUART1_RX_IDLE, LPI2C0_MASTER_TRIGGER, LPI2C0_SLAVE_TRIGGER, LPSPI0_FRAME, LPSPI0_RX_DATA, LPSPI1_FRAME, LPSPI1_RX_DATA, SIM_SW_TRIGGER, LPI2C1_MASTER_TRIGGER, LPI2C1_SLAVE_TRIGGER, FTM4_INT, FTM4_EXT, FTM5_INT, FTM5_EXT, FTM6_INT, FTM6_EXT, FTM7_INT, FTM7_EXT}, origin=NXP, post-build-variant-value=true, set at pre-compile, default-value=INPUT_DISABLED  # Vendor specific: Used to configure the FTM6 input 0.
        boolean TrgMuxFtm6LockEn: origin=NXP, post-build-variant-value=true, set at pre-compile, default-value=false  # Vendor specific: Configures if register FTM6 must be locked(read-only).
        enumeration TrgMuxFtm7Input0: {INPUT_DISABLED, VDD, INPUT_0, INPUT_1, INPUT_2, INPUT_3, INPUT_4, INPUT_5, INPUT_6, INPUT_7, INPUT_8, INPUT_9, INPUT_10, INPUT_11, CMP0, LPIT_CH0, LPIT_CH1, LPIT_CH2, LPIT_CH3, LPTMR0_TRIGGER, FTM0_INT, FTM0_EXT, FTM1_INT, FTM1_EXT, FTM2_INT, FTM2_EXT, FTM3_INT, FTM3_EXT, ADC0_COCOA, ADC0_COCOB, ADC1_COCOA, ADC1_COCOB, PDB0_CH0, PDB0_PULSE_OUT, PDB1_CH0, PDB1_PULSE_OUT, RTC_ALARM, RTC_SEC_COUNTER, FLEXIO_TRIG0, FLEXIO_TRIG1, FLEXIO_TRIG2, FLEXIO_TRIG3, LPUART0_RX_DATA, LPUART0_TX_DATA, LPUART0_RX_IDLE, LPUART1_RX_DATA, LPUART1_TX_DATA, LPUART1_RX_IDLE, LPI2C0_MASTER_TRIGGER, LPI2C0_SLAVE_TRIGGER, LPSPI0_FRAME, LPSPI0_RX_DATA, LPSPI1_FRAME, LPSPI1_RX_DATA, SIM_SW_TRIGGER, LPI2C1_MASTER_TRIGGER, LPI2C1_SLAVE_TRIGGER, FTM4_INT, FTM4_EXT, FTM5_INT, FTM5_EXT, FTM6_INT, FTM6_EXT, FTM7_INT, FTM7_EXT}, origin=NXP, post-build-variant-value=true, set at pre-compile, default-value=INPUT_DISABLED  # Vendor specific: Used to configure the FTM7 input 0.
        boolean TrgMuxFtm7LockEn: origin=NXP, post-build-variant-value=true, set at pre-compile, default-value=false  # Vendor specific: Configures if register FTM7 must be locked(read-only).
      container FlexioConfig  # Vendor specific: Configuration of Flexio.
        container FlexioGeneral  # Vendor specific: Configuration of general Flexio.
          boolean DozenEnable: origin=NXP, set at post-build in variant post-build / pre-compile in variant pre-compile, default-value=false  # Vendor specific: FLEXIO_CTRL[DOZEN]. Doze Enable. 0 - FlexIO enabled in Doze modes. 1 - FlexIO disabled in Doze modes. Note: Implementation Specific Parameter.
          boolean DBGE: origin=NXP, set at post-build in variant post-build / pre-compile in variant pre-compile, default-value=false  # Vendor specific: FLEXIO_CTRL[DBGE]. Debug Enable. 0 - FlexIO is disabled in debug modes. 1 - FlexIO disabled in debug modes. Note: Implementation Specific Parameter.
    container CommonPublishedInformation  # Vendor specific: Common container, aggregated by all modules. It contains published information about vendor and versions.
      integer ArReleaseMajorVersion: 4..4, origin=NXP, set at published-information, default-value=4  # Vendor specific: Major version number of AUTOSAR specification on which the appropriate implementation is based on.
      integer ArReleaseMinorVersion: 2..2, origin=NXP, set at published-information, default-value=2  # Vendor specific: Minor version number of AUTOSAR specification on which the appropriate implementation is based on.
      integer ArReleaseRevisionVersion: 2..2, origin=NXP, set at published-information, default-value=2  # Vendor specific: Revision version number of AUTOSAR specification on which the appropriate implementation is based on.
      integer ModuleId: 255..255, origin=NXP, set at published-information, default-value=255  # Vendor specific: Module ID of this module from Module List.
      integer SwMajorVersion: 1..1, origin=NXP, set at published-information, default-value=1  # Vendor specific: Major version number of the vendor specific implementation of the module. The numbering is vendor specific.
      integer SwMinorVersion: 0..0, origin=NXP, set at published-information, default-value=0  # Vendor specific: Minor version number of the vendor specific implementation of the module. The numbering is vendor specific.
      integer SwPatchVersion: 2..2, origin=NXP, set at published-information, default-value=2  # Vendor specific: Patch level version number of the vendor specific implementation of the module. The numbering is vendor specific.
      string VendorApiInfix [0..1]: multiplicity set at published-information, origin=NXP, set at published-information  # Vendor specific: In driver modules which can be instantiated several times on a single ECU, BSW00347 requires that the name of APIs is extended by the VendorId and a vendor specific name. This parameter is used to specify the vendor specific name. In total, the implementation specific name is generated as follows: <ModuleName>_>VendorId>_<VendorApiInfix>. E.g. assuming that the VendorId of the implementor is 123 and the implementer chose a VendorApiInfix of "v11r456" a api name Can_Write defined in the SWS will translate to Can_123_v11r456Write. This parameter is mandatory for all modules with upper multiplicity > 1. It shall not be used for modules with upper multiplicity =1.
      integer VendorId: 43..43, origin=NXP, set at published-information, default-value=43  # Vendor specific: Vendor ID of the dedicated implementation of this module according to the AUTOSAR vendor list.
