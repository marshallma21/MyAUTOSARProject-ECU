AUTOSAR XML (schema 4-3-0)
package /TS_T40D2M10I2R0
  ecuc definition collection Fls_EcuParameterDefinition: module=Fls
  module definition Fls [1..*]: refined-module-def=Fls, variants post-build/pre-compile  # Configuration of the Fls (internal or external flash driver) module.
    container FlsConfigSet  # Container for runtime configuration parameters of the flash driver. Implementation Type: Fls_ConfigType.
      integer FlsAcErase: 0..4294967295, post-build-variant-value=true, set at post-build in variant post-build / pre-compile in variant pre-compile, default-value=1073751296  # Address offset in RAM to which the erase flash access code shall be loaded. Used as function pointer to access the erase flash access code. Note: To use Fls Access Code Erase be sure Fls Access Code Erase Pointer is NULL or NULL_PTR.
      integer FlsAcWrite: 0..4294967295, post-build-variant-value=true, set at post-build in variant post-build / pre-compile in variant pre-compile, default-value=1073751296  # Address offset in RAM to which the write flash access code shall be loaded. Used as function pointer to access the write flash access code. Note: To use Fls Access Code Write be sure Fls Access Code Write Pointer is NULL or NULL_PTR.
      function name FlsAcErasePointer: origin=NXP, post-build-variant-value=true, set at post-build in variant post-build / pre-compile in variant pre-compile, default-value=NULL_PTR  # Vendor specific: Pointer in RAM to which the erase flash access code shall be loaded.
      function name FlsAcWritePointer: origin=NXP, post-build-variant-value=true, set at post-build in variant post-build / pre-compile in variant pre-compile, default-value=NULL_PTR  # Vendor specific: Pointer in RAM to which the write flash access code shall be loaded. Used as function pointer to access the write flash access code.
      float FlsCallCycle: 0.0..1.0, post-build-variant-value=true, set at post-build in variant post-build / pre-compile in variant pre-compile, default-value=0.0  # Cycle time of calls of the flash driver main functionNote:Not supported by the driver.
      enumeration FlsDefaultMode: {MEMIF_MODE_FAST, MEMIF_MODE_SLOW}, post-build-variant-value=true, set at post-build in variant post-build / pre-compile in variant pre-compile, default-value=MEMIF_MODE_SLOW  # This parameter is the default FLS device mode after initialization.
      function name FlsACCallback [0..1]: multiplicity set at post-build in variant post-build / pre-compile in variant pre-compile, origin=NXP, post-build-variant-multiplicity=true, post-build-variant-value=true, set at post-build in variant post-build / pre-compile in variant pre-compile, default-value=Fls_AC_Callback  # Vendor specific: Mapped to the Access Code Callback provided by some upper layer module, typically the Wdg module. Note: Disable the Access Code Callback to have it set as NULL_PTR.
      function name FlsJobEndNotification [0..1]: multiplicity set at post-build in variant post-build / pre-compile in variant pre-compile, post-build-variant-multiplicity=true, post-build-variant-value=true, set at post-build in variant post-build / pre-compile in variant pre-compile, default-value=Fee_JobEndNotification  # Mapped to the job end notification routine provided by some upper layer module, typically the Fee module. Note: Disable the end notification to have it set as NULL_PTR
      function name FlsJobErrorNotification [0..1]: multiplicity set at post-build in variant post-build / pre-compile in variant pre-compile, post-build-variant-multiplicity=true, post-build-variant-value=true, set at post-build in variant post-build / pre-compile in variant pre-compile, default-value=Fee_JobErrorNotification  # Mapped to the job error notification routine provided by some upper layer module, typically the Fee module. Note: Disable the error notification to have it set as NULL_PTR
      function name FlsStartFlashAccessNotif [0..1]: multiplicity set at post-build in variant post-build / pre-compile in variant pre-compile, origin=NXP, post-build-variant-multiplicity=true, post-build-variant-value=true, set at post-build in variant post-build / pre-compile in variant pre-compile, default-value=Fls_StartFlashAccessNotif  # Start flash access. If configured, this notification will be called before any flash memory access. It is called before flash memory read accesses(in read, compare, verify write, verify erase jobs) and before flash memory program operations(in write and erase jobs). The purpose of this notification together with FlsFinishedFlashAccess, is to ensure that, if needed, no other executed code(other tasks, cores, masters) will access the affected flash area simultaneously with the access initiated by the driver. For more details, see Integration manual, chapter 5. Module requirements. Note: Disable the error notification to have it set as NULL_PTR
      function name FlsFinishedFlashAccessNotif [0..1]: multiplicity set at post-build in variant post-build / pre-compile in variant pre-compile, origin=NXP, post-build-variant-multiplicity=true, post-build-variant-value=true, set at post-build in variant post-build / pre-compile in variant pre-compile, default-value=Fls_FinishedFlashAccessNotif  # Finished flash access. If configured, this notification will be called after any flash memory access. It is called after flash memory read accesses(in read, compare, verify write, verify erase jobs) and after flash memory program operations(in write and erase jobs). The purpose of this notification together with FlsStartFlashAccess, is to ensure that, if needed, no other executed code(other tasks, cores, masters) will access the affected flash area simultaneously with the access initiated by the driver. For more details, see Integration manual, chapter 5. Module requirements. Note: Disable the error notification to have it set as NULL_PTR
      function name FlsQspiInitCallout [0..1]: multiplicity set at post-build in variant post-build / pre-compile in variant pre-compile, origin=NXP, post-build-variant-multiplicity=true, post-build-variant-value=true, set at post-build in variant post-build / pre-compile in variant pre-compile, default-value=FlsQspiInitCallout  # Callout function called by the driver at the end of the QSPI Init phase. The intended purpose of this callout is to provide to the application the possibility of performing additional configuration to the QSPI hardware IP or to the external memories connected(for ex: sending the lock/unlock sequences for the external flash sectors, altering QSPI IP timing, etc.) Note: Disable the callout in order to have it set as NULL_PTR. Note: The callout can be configured only if the FlsExternalDriver is enabled.
      function name FlsQspiResetCallout [0..1]: multiplicity set at post-build in variant post-build / pre-compile in variant pre-compile, origin=NXP, post-build-variant-multiplicity=true, post-build-variant-value=true, set at post-build in variant post-build / pre-compile in variant pre-compile, default-value=FlsQspiResetCallout  # Callout function called by the driver at the beginning of a new job. The intended purpose of this callout is to provide to the application the possibility of reseting the external memory to an idle and error free state. If the callout is disabled, at the beginnig of a new job the Fls_MainFunction will check the external memory status and if not, poll and wait for it to become idle. If the callout is enabled and the memory is not idle, the Fls_MainFunction will also call the configured function to allow the application to send extra commands to the external memory(software reset, abort any suspended operation, error flags clearing, etc.) Note: Disable the callout in order to have it set as NULL_PTR. Note: The callout can be configured only if the FlsExternalDriver is enabled.
      function name FlsQspiErrorCheckCallout [0..1]: multiplicity set at post-build in variant post-build / pre-compile in variant pre-compile, origin=NXP, post-build-variant-multiplicity=true, post-build-variant-value=true, set at post-build in variant post-build / pre-compile in variant pre-compile, default-value=FlsQspiErrorCheckCallout  # Callout function called by the driver at the end of each program and erase job The intended purpose of this callout is to provide to the application the possibility of interrogating the error status of the memory after each program and erase job. The application should check any error or status bits available and reset the memory after interrogation in case an error condition was detected. If the callout is enabled, at the end of each job, the callout is called and the return value is checked to determine if there was any error during the memory operation. Return values: E_OK(0) E_NOT_OK(1). If E_OK(0) is received, the job is considered successful. If E_NOT_OK(1) is received, the job is considered unsuccessful and marked as failed. If the callout is disabled, the job is assumed as successful from the memory status point of view. Note: Disable the callout in order to have it set as NULL_PTR. Note: The callout can be configured only if the FlsExternalDriver is enabled.
      function name FlsQspiEccCheckCallout [0..1]: multiplicity set at post-build in variant post-build / pre-compile in variant pre-compile, origin=NXP, post-build-variant-multiplicity=true, post-build-variant-value=true, set at post-build in variant post-build / pre-compile in variant pre-compile, default-value=FlsQspiEccCheckCallout  # Callout function called by the driver at the end of each read operation The intended purpose of this callout is to provide to the application the possibility of interrogating the ECC status of the memory after each read operation. The callout provide the hardware channel, start address and the size of the read operation. The application should check there is any ECC error in the current read data If the callout is enabled, at the end of each read operation, the callout is called and the return value is checked to determine if there was any error during the memory operation. Return values: E_OK(0) E_NOT_OK(1). If E_OK(0) is received, the job is considered successful. If E_NOT_OK(1) is received, the job is considered unsuccessful and marked as failed. If the callout is disabled, the job is assumed as successful from the memory status point of view. Note: Disable the callout in order to have it set as NULL_PTR. Note: The callout can be configured only if the FlsExternalDriver is enabled.
      integer FlsMaxReadFastMode: 0..4294967295, post-build-variant-value=true, set at post-build in variant post-build / pre-compile in variant pre-compile, default-value=1048576  # The maximum number of bytes to read or compare in one cycle of the flash driver's job processing function in fast mode. Note: If external sectors are configured and if FlsHwUnitWordAddressable is set, the FlsMaxReadFastMode must be an even value(two bytes aligned).
      integer FlsMaxReadNormalMode: 0..4294967295, post-build-variant-value=true, set at post-build in variant post-build / pre-compile in variant pre-compile, default-value=1024  # The maximum number of bytes to read or compare in one cycle of the flash driver's job processing function in normal mode. Note: If external sectors are configured and if FlsHwUnitWordAddressable is set, the FlsMaxReadNormalMode must be an even value(two bytes aligned).
      integer FlsMaxWriteFastMode: 0..4294967295, post-build-variant-value=true, set at post-build in variant post-build / pre-compile in variant pre-compile, default-value=256  # The maximum number of bytes to write in one cycle of the flash driver's job processing function in fast mode. Note: If external sectors are configured, the FlsMaxWriteFastMode must be an integer multiple of the FlsPageSize.
      integer FlsMaxWriteNormalMode: 0..4294967295, post-build-variant-value=true, set at post-build in variant post-build / pre-compile in variant pre-compile, default-value=8  # The maximum number of bytes to write in one cycle of the flash driver's job processing function in normal mode. Note: If external sectors are configured, the FlsMaxWriteFastMode must be an integer multiple of the FlsPageSize.
      integer FlsProtection: 0..4294967295, post-build-variant-value=true, set at post-build in variant post-build / pre-compile in variant pre-compile, default-value=0  # Erase/write protection settings. Only relevant if supported by hardware.Note:Not supported by the driver.
      container FlsDemEventParameterRefs [0..1]: multiplicity set at pre-compile in variant pre-compile / post-build in variant post-build  # Container for the references to DemEventParameter elements which shall be invoked using the Dem_ReportErrorStatus API in case the corresponding error occurs. The EventId is taken from the referenced DemEventParameter's DemEventId value. The standardized errors are provided in the container and can be extended by vendor specific error references. Note: This container is set to obsolete and will be removed in release 4.3.
        symbolic name reference FLS_E_COMPARE_FAILED [0..1]: multiplicity set at pre-compile in variant pre-compile / post-build in variant post-build, post-build-variant-multiplicity=true, post-build-variant-value=true, set at pre-compile in variant pre-compile / post-build in variant post-build, destination=DemEventParameter  # Reference to the DemEventParameter which shall be issued when the error "Flash compare failed (HW)" has occurred. Note: This container is set to obsolete and will be removed in release 4.3.
        symbolic name reference FLS_E_ERASE_FAILED [0..1]: multiplicity set at post-build in variant post-build / pre-compile in variant pre-compile, post-build-variant-multiplicity=true, post-build-variant-value=true, set at post-build in variant post-build / pre-compile in variant pre-compile, destination=DemEventParameter  # Reference to the DemEventParameter which shall be issued when the error "Flash erase failed (HW)" has occurred. Note: This container is set to obsolete and will be removed in release 4.3.
        symbolic name reference FLS_E_READ_FAILED [0..1]: multiplicity set at post-build in variant post-build / pre-compile in variant pre-compile, post-build-variant-multiplicity=true, post-build-variant-value=true, set at post-build in variant post-build / pre-compile in variant pre-compile, destination=DemEventParameter  # Reference to the DemEventParameter which shall be issued when the error "Flash read failed (HW)" has occurred. Note: This container is set to obsolete and will be removed in release 4.3.
        symbolic name reference FLS_E_UNEXPECTED_FLASH_ID [0..1]: multiplicity set at post-build in variant post-build / pre-compile in variant pre-compile, post-build-variant-multiplicity=true, post-build-variant-value=true, set at post-build in variant post-build / pre-compile in variant pre-compile, destination=DemEventParameter  # Reference to the DemEventParameter which shall be issued when the error "Expected hardware ID not matched" has occurred. Note: This error is applicable only for external flash, if available. Note: When this error is enabled, the user should enable and configure also the FlsLUTReadIdSequenceIdRef LUT sequence reference and the FlsQspiDeviceID. Note: This container is set to obsolete and will be removed in release 4.3.
        symbolic name reference FLS_E_WRITE_FAILED [0..1]: multiplicity set at post-build in variant post-build / pre-compile in variant pre-compile, post-build-variant-multiplicity=true, post-build-variant-value=true, set at post-build in variant post-build / pre-compile in variant pre-compile, destination=DemEventParameter  # Reference to the DemEventParameter which shall be issued when the error "Flash write failed (HW)" has occurred. Note: This container is set to obsolete and will be removed in release 4.3.
      container FlsExternalDriver [0..1]: multiplicity set at pre-compile in variant pre-compile / post-build in variant post-build  # This container is present for external Flash drivers only. Internal Flash drivers do not use the parameter listed in this container, hence its multiplicity is 0 for internal drivers.
        symbolic name reference FlsSpiReference [0..1]: multiplicity set at pre-compile, set at pre-compile, destination=SpiSequence  # Reference to SPI sequence. Not used in current implementation.
        container FlsHwUnit [1..*]: multiplicity set at post-build in variant post-build / pre-compile in variant pre-compile  # Container for the configuration of the avaialable external flash memory hardware units.
          enumeration FlsHwUnitName: {FLS_QSPI_0}, origin=NXP, post-build-variant-value=true, set at post-build in variant post-build / pre-compile in variant pre-compile, default-value=FLS_QSPI_0  # The name of the configured harwdare unit name. The configured parameters will apply to this hardware unit name only. The name of the hardware unit name represents the physical hardware unit available on chip.
          enumeration FlsHwUnitReadMode: {FLS_SDR, FLS_DDR}, origin=NXP, post-build-variant-value=true, set at post-build in variant post-build / pre-compile in variant pre-compile, default-value=FLS_SDR  # The hardware unit read mode: FLS_SDR (single data rate) which samples incoming data on a single edge. FLS_DDR (double data rate) which samples incoming data on both edges.
          boolean FlsHwUnitDqsMode: origin=NXP, post-build-variant-value=true, set at post-build in variant post-build / pre-compile in variant pre-compile, default-value=false  # Enables DQS sampling mode. If enabled, two DQS sampling modes are available(Internal loopback DQS and Pad loopback DQS). If disabled, only Internal sampling mode is available.
          boolean FlsHwUnitInputPadsBufferEn: origin=NXP, post-build-variant-value=true, set at post-build in variant post-build / pre-compile in variant pre-compile, default-value=true  # Enables input buffer of QSPI pads for SDR modes. SCLKCFG[7].
          enumeration FlsHwUnitInputClockSel: {FLS_QSPI_SYS_CLK, FLS_QSPI_BUS_CLK}, origin=NXP, post-build-variant-value=true, set at post-build in variant post-build / pre-compile in variant pre-compile, default-value=FLS_QSPI_SYS_CLK  # Select source for AHB read interface clock, module clock and bus interface clock. SCLKCFG[6] bit. Option 1: BUS_CLK. Option 2: SYS_CLK.
          enumeration FlsHwUnitInternalRefClockSel: {FLS_QSPI_SPLLDIV1, FLS_QSPI_FIRCDIV1}, origin=NXP, post-build-variant-value=true, set at post-build in variant post-build / pre-compile in variant pre-compile, default-value=FLS_QSPI_SPLLDIV1  # Source clock for external QSPI clock(SFCK) sent to the memory. SCLKCFG[4] bit. Option 1: SPLLDIV1. Option 2: FIRCDIV1.
          enumeration FlsHwUnitDqsBStage2ClkSource: {FLS_QSPI_DQS_INVERTED, FLS_QSPI_DQS_NONINVERTED}, origin=NXP, post-build-variant-value=true, set at post-build in variant post-build / pre-compile in variant pre-compile, default-value=FLS_QSPI_DQS_INVERTED  # Select source clock for DQS B Stage 2 clock. SCLKCFG[3] bit. Option 1: INVERTED. Option 2: NON-INVERTED.
          enumeration FlsHwUnitDqsBStage1ClkSource: {FLS_QSPI_DQS_INTERNAL, FLS_QSPI_DQS_LOOPBACK}, origin=NXP, post-build-variant-value=true, set at post-build in variant post-build / pre-compile in variant pre-compile, default-value=FLS_QSPI_DQS_INTERNAL  # Select source clock for DQS B Stage 1 clock. SCLKCFG[2] bit. Option 1: DQS_INTERNAL. DQS internal loopback clock. Option 2: DQS_LOOPBACK. DQS pad loopback clock, derived from SCKB pad.
          enumeration FlsHwUnitDqsAStage2ClkSource: {FLS_QSPI_DQS_INVERTED, FLS_QSPI_DQS_NONINVERTED}, origin=NXP, post-build-variant-value=true, set at post-build in variant post-build / pre-compile in variant pre-compile, default-value=FLS_QSPI_DQS_INVERTED  # Select source clock for DQS A Stage 2 clock. SCLKCFG[1] bit. Option 1: INVERTED. Option 2: NON-INVERTED.
          enumeration FlsHwUnitDqsAStage1ClkSource: {FLS_QSPI_DQS_INTERNAL, FLS_QSPI_DQS_LOOPBACK}, origin=NXP, post-build-variant-value=true, set at post-build in variant post-build / pre-compile in variant pre-compile, default-value=FLS_QSPI_DQS_INTERNAL  # Select source clock for DQS A Stage 1 clock. SCLKCFG[0] bit. Option 1: DQS_INTERNAL. DQS internal loopback clock. Option 2: DQS_LOOPBACK. DQS pad loopback clock, derived from SCKB pad.
          boolean FlsHwUnitPendingReadBusGasket: origin=NXP, post-build-variant-value=true, set at post-build in variant post-build / pre-compile in variant pre-compile, default-value=false  # Pending read enable controls the bus gasket?s handling of pending read transactions. SOCCFG[16]. 0: Pending reads are disabled. 1: Pending reads are enabled, yielding a performance improvement through the gasket.
          boolean FlsHwUnitBurstReadBusGasket: origin=NXP, post-build-variant-value=true, set at post-build in variant post-build / pre-compile in variant pre-compile, default-value=false  # Burst read enable controls the bus gasket?s handling of burst read transactions. SOCCFG[17]. 0: Burst reads are converted into a series of single transactions on the slave side of the gasket. 1: Burst reads are optimized for best system performance.
          boolean FlsHwUnitBurstWriteBusGasket: origin=NXP, post-build-variant-value=true, set at post-build in variant post-build / pre-compile in variant pre-compile, default-value=false  # Burst writes enable controls the bus gasket?s handling of burst read transactions. SOCCFG[18]. 0: Burst writes are converted into a series of single transactions on the slave side of the gasket. 1: Burst writes are optimized for best system performance. Note this setting treats writes as imprecise such that an error response on any beat of the burst is reported on the last beat.
          enumeration FlsHwUnitProgrammableDivider: {FLS_PGM_DIV_1, FLS_PGM_DIV_2, FLS_PGM_DIV_3, FLS_PGM_DIV_4, FLS_PGM_DIV_5, FLS_PGM_DIV_6, FLS_PGM_DIV_7, FLS_PGM_DIV_8}, origin=NXP, post-build-variant-value=true, set at post-build in variant post-build / pre-compile in variant pre-compile, default-value=FLS_PGM_DIV_1  # Programmable divider configuration selection. Based on this devider value, the external memory clock and internal sampling clock is derived.
          boolean IdleSignalDriveIOFB3HighLvl: origin=NXP, post-build-variant-value=true, set at post-build in variant post-build / pre-compile in variant pre-compile, default-value=true  # Idle Signal Drive IOFB[3] Flash B. This bit determines the logic level the IOFB[3] output of the QuadSPI module is driven to in the inactive state.
          boolean IdleSignalDriveIOFB2HighLvl: origin=NXP, post-build-variant-value=true, set at post-build in variant post-build / pre-compile in variant pre-compile, default-value=true  # Idle Signal Drive IOFB[2] Flash B. This bit determines the logic level the IOFB[2] output of the QuadSPI module is driven to in the inactive state.
          boolean IdleSignalDriveIOFA3HighLvl: origin=NXP, post-build-variant-value=true, set at post-build in variant post-build / pre-compile in variant pre-compile, default-value=true  # Idle Signal Drive IOFA[3] Flash A. This bit determines the logic level the IOFA[3] output of the QuadSPI module is driven to in the inactive state.
          boolean IdleSignalDriveIOFA2HighLvl: origin=NXP, post-build-variant-value=true, set at post-build in variant post-build / pre-compile in variant pre-compile, default-value=true  # Idle Signal Drive IOFA[2] Flash A. This bit determines the logic level the IOFA[2] output of the QuadSPI module is driven to in the inactive state.
          enumeration FlsHwUnitSamplingEdge: {FLS_RISING, FLS_FALLING}, origin=NXP, post-build-variant-value=true, set at post-build in variant post-build / pre-compile in variant pre-compile, default-value=FLS_RISING  # The hardware unit sampling edge. Selects the edge of the sampling clock valid for full speed commands. This option is also used in DQS mode and ignored when using non-DQS DDR instructions. FLS_RISING: Select sampling at non-inverted internal DQS (use rising edge). FLS_FALLING: Select sampling at inverted internal DQS (use falling edge). The sampling edge selection is valid only for FLS_SDR mode, not FLS_DDR.
          enumeration FlsHwUnitSamplingDly: {FLS_1SAMPLE_DLY, FLS_2SAMPLE_DLY}, origin=NXP, post-build-variant-value=true, set at post-build in variant post-build / pre-compile in variant pre-compile, default-value=FLS_1SAMPLE_DLY  # Full Speed Delay selection for SDR instructions. Select the delay with respect to the reference edge for the sample point valid for full speed commands. This option is also used in DQS mode and ignored when using non-DQS DDR instructions. FLS_1SAMPLE_DLY: Select sampling with one samples delay. FLS_2SAMPLE_DLY: Select sampling with two samples delay. The sampling delay selection is valid only for FLS_SDR mode, not FLS_DDR.
          integer FlsHwUnitSamplingPoint: 0..7, origin=NXP, post-build-variant-value=true, set at post-build in variant post-build / pre-compile in variant pre-compile, default-value=0  # DDR Sampling point. Selects the sampling point for incoming data when serial flash is executing a DDR instruction. The sampling edge selection is valid only for FLS_DDR mode, not FLS_SDR.
          boolean FlsHwUnitDqsLatencyEnable: origin=NXP, post-build-variant-value=true, set at post-build in variant post-build / pre-compile in variant pre-compile, default-value=false  # DQS Latency Enable. Feature used to support external devices which add latency cycles in the DQS signal. When no signal is provided by the external devices, data is not sampled, thus the memory stretches the timing. DQS Latency is applicable only for DQS sampling mode: FLS_EXTERNAL_DQS.
          integer FlsHwUnitFineDelayA: 0..127, origin=NXP, post-build-variant-value=true, set at post-build in variant post-build / pre-compile in variant pre-compile, default-value=0  # The hardware unit fine delay: Coarse delay value, applicable for FLS_INTERNAL_DQS and FLS_EXTERNAL_DQS sampling modes. Fine delay applicable to Flash A. 0 - 63 delay units.
          integer FlsHwUnitFineDelayB: 0..127, origin=NXP, post-build-variant-value=true, set at post-build in variant post-build / pre-compile in variant pre-compile, default-value=0  # The hardware unit fine delay: Coarse delay value, applicable for FLS_INTERNAL_DQS and FLS_EXTERNAL_DQS sampling modes. Fine delay applicable to Flash B. 0 - 63 delay units.
          enumeration FlsHwUnitTdh: {FLS_ALIGNED_INT_REF_CLK, FLS_ALIGNED_2X_CLK, FLS_ALIGNED_4X_CLK}, origin=NXP, post-build-variant-value=true, set at post-build in variant post-build / pre-compile in variant pre-compile, default-value=FLS_ALIGNED_INT_REF_CLK  # TDH: Serial flash data in hold time. Should be set to FLS_ALIGNED_INT_REF_CLK for FLS_SDR mode. TDH parameter delays data sent to flash, in order to meet the input hold time requirement of flash. FLS_ALIGNED_INT_REF_CLK = Data aligned with the posedge of Internal reference clock of QuadSPI. FLS_ALIGNED_2X_CLK = Data aligned with 2x serial flash half clock. FLS_ALIGNED_4X_CLK = Data aligned with 4x serial flash half clock.
          integer FlsHwUnitTcsh: 0..15, origin=NXP, post-build-variant-value=true, set at post-build in variant post-build / pre-compile in variant pre-compile, default-value=0  # TCSH: Serial flash CS hold time in terms of serial flash clock cycles. A bigger value will release the CS signal later after the transaction ends. The actual delay between chip select and clock is defined as: TCSH = 1 SCK clk if N= 0/1 else, N SCK clk if N>1, where N is the setting of TCSH
          integer FlsHwUnitTcss: 0..15, origin=NXP, post-build-variant-value=true, set at post-build in variant post-build / pre-compile in variant pre-compile, default-value=0  # TCSS: Serial flash CS setup time in terms of serial flash clock cycles. A bigger value will pull the CS signal earlier before the transaction starts. The actual delay between chip select and clock is defined as: TCSS = 0.5 SCK clk if N= 0/1 else, N+0.5 SCK clk if N>1, where N is the setting of TCSS.
          enumeration FlsHwUnitEndianness: {FLS_BIG_ENDIAN_64, FLS_LITTLE_ENDIAN_32, FLS_BIG_ENDIAN_32, FLS_LITTLE_ENDIAN_64}, origin=NXP, post-build-variant-value=true, set at post-build in variant post-build / pre-compile in variant pre-compile, default-value=FLS_LITTLE_ENDIAN_64  # Defines the endianness of the QuadSPI module, which can swap the orderd of the read/write data. By default the data is always returned in 64 bit LE format on the AHB bus and 32 bit LE format on the IPS interface when read via the RX buffer and written in 32 bit LE format when written via the TX buffer. FLS_BIG_ENDIAN_64 = 64 bit BE. FLS_LITTLE_ENDIAN_32 = 32 bit LE. FLS_BIG_ENDIAN_32 = 32 bit BE. FLS_LITTLE_ENDIAN_64 = 64 bit LE.
          enumeration FlsHwUnitReadBufferMode: {FLS_AHB_READ_MODE, FLS_IP_READ_MODE}, origin=NXP, post-build-variant-value=true, set at post-build in variant post-build / pre-compile in variant pre-compile, default-value=FLS_AHB_READ_MODE  # Selects the read buffer mode: IP buffer or AHB buffer. If AHB mode is used, read transactions are triggered by memory mapped access and data read from external flash device is stored inside the AHB buffers. If IP mode is used, read transactions are triggered by IP commands and data read from external flash device is stored inside the RX buffer. TBC.
          enumeration FlsHwUnitRxBufferAccessMode: {FLS_RXBUFFER_AHB_BUS_ACCESS, FLS_RXBUFFER_IP_BUS_ACCESS}, origin=NXP, post-build-variant-value=true, set at post-build in variant post-build / pre-compile in variant pre-compile, default-value=FLS_RXBUFFER_IP_BUS_ACCESS  # Selects the bus(AHB or IP) used to access the RX Buffer content. This setting is only applicable for RX Buffer, thus is applicable only for IP bus mode, otherwise the AHB buffers are used instead of the RX Buffer. TBC.
          integer FlsHwUnitColumnAddressWidth: 0..15, origin=NXP, post-build-variant-value=true, set at post-build in variant post-build / pre-compile in variant pre-compile, default-value=0  # Column Address Space. Defines the width of the column address. Example: If the coulmn address is for example [2:0] of QSPI_SFAR/AHB address, then CAS must be 3. If there is no column address separation in any serial flash this value must be programmed to 0.
          boolean FlsHwUnitWordAddressable: origin=NXP, post-build-variant-value=true, set at post-build in variant post-build / pre-compile in variant pre-compile, default-value=false  # Defines whether the serial flash is a byte addressable flash or a word addressable flash. According to this bit configuration the address is re-mapped to the flash interface. DISABLED: Byte addressable serial flash mode. ENABLED: Word (2 byte) addressable serial flash mode. If the incoming address is 0x2004, the controller re-maps this address to access the flash location 0x1002.
          integer FlsSerialFlashA1TopAddr: 0..4294967295, origin=NXP, post-build-variant-value=true, set at post-build in variant post-build / pre-compile in variant pre-compile, default-value=1811939328  # The address mapping for the serial flash A1 external memory device. All accesses targeting the memory range [TOP_ADDR_MEMA1(SFA1AD) - QSPI_AMBA_BASE] will be directed to flash memory A1. The memory range should be configured to the size of the external memory. If an external device is not attached, or not used on this channel, the value of the register can be set the same as the previous one, thus allocating no space.
          integer FlsSerialFlashA2TopAddr: 0..4294967295, origin=NXP, post-build-variant-value=true, set at post-build in variant post-build / pre-compile in variant pre-compile, default-value=1811939328  # The address mapping for the serial flash A2 external memory device. All accesses targeting the memory range [TOP_ADDR_MEMA2(SFA2AD) - TOP_ADDR_MEMA1(SFA1AD)] will be directed to flash memory A2. The memory range should be configured to the size of the external memory. If an external device is not attached, or not used on this channel, the value of the register can be set the same as the previous one, thus allocating no space.
          integer FlsSerialFlashB1TopAddr: 0..4294967295, origin=NXP, post-build-variant-value=true, set at post-build in variant post-build / pre-compile in variant pre-compile, default-value=1879048192  # The address mapping for the serial flash B1 external memory device. All accesses targeting the memory range [TOP_ADDR_MEMB1(SFB1AD) - TOP_ADDR_MEMA2(SFA2AD)] will be directed to flash memory B1. The memory range should be configured to the size of the external memory. If an external device is not attached, or not used on this channel, the value of the register can be set the same as the previous one, thus allocating no space.
          integer FlsSerialFlashB2TopAddr: 0..4294967295, origin=NXP, post-build-variant-value=true, set at post-build in variant post-build / pre-compile in variant pre-compile, default-value=1879048192  # The address mapping for the serial flash B2 external memory device. All accesses targeting the memory range [TOP_ADDR_MEMB2(SFB2AD) - TOP_ADDR_MEMB1(SFB1AD)] will be directed to flash memory B2. The memory range should be configured to the size of the external memory. If an external device is not attached, or not used on this channel, the value of the register can be set the same as the previous one, thus allocating no space.
          integer FlsExtUnitRegWidth: 1..4, origin=NXP, post-build-variant-value=true, set at post-build in variant post-build / pre-compile in variant pre-compile, default-value=1  # The external memory unit register width, expressed in bytes (For example the width of the Status register). 1 - External unit register width is 1 byte (8bits). 2 - External unit register width is 2 byte (16bits). 3 - External unit register width is 3 byte (24bits). 4 - External unit register width is 4 byte (32bits).
          integer FlsBusyBitValue: 0..1, origin=NXP, post-build-variant-value=true, set at post-build in variant post-build / pre-compile in variant pre-compile, default-value=1  # The busy bit flag value, from the external device status register, corresponding to the BUSY state. 0 - Busy flag in status register is 0 when flash devices are busy. 1 - Busy flag in status register is 1 when flash devices are busy.
          integer FlsBusyBitPositionOffset: 0..31, origin=NXP, post-build-variant-value=true, set at post-build in variant post-build / pre-compile in variant pre-compile, default-value=0  # The busy bit flag position offset, inside the status register of the external device status register. Valid range: 0 - 31, for a 32 bits status register. If the width of the status register si smaller, the range is restricted accordingly. Ex: 3 - Busy bit flag is bit number 3 in the status register.
          integer FlsQspiDeviceId: 0..65535, origin=NXP, post-build-variant-value=true, set at post-build in variant post-build / pre-compile in variant pre-compile, default-value=0  # External memory ID. If the associated "FLS_E_UNEXPECTED_FLASH_ID" error is enabled, at Init, the configured value is checked against the value read from memory. The memory ID is read from the memory using the configured READ_ID LUT sequence. Example for a Macronix device: Configured value of FlsQspiDeviceId = 0x16C2, meaning Manufacturer ID: 0xC2, Device ID: 0x16. The configured READ_ID LUT sequence schedules a read id command(ex:REMS 0x90) with read length 2 bytes. Note: The read ID command is sent only to the device attached to QSPI_x_A1 device. Note: This parameter can be configured only when FlsLUTReadIdSequenceIdRef reference is enabled.
          container FlsAhbBuffer [0..4]: multiplicity set at pre-compile  # Container for the configuration of the AHB read buffers. Holds the configuration for each AHB buffer configured for AHB read mode.
            enumeration FlsAhbBufferInstance: {AHB_BUFFER_0, AHB_BUFFER_1, AHB_BUFFER_2, AHB_BUFFER_3}, origin=NXP, post-build-variant-value=true, set at post-build in variant post-build / pre-compile in variant pre-compile, default-value=AHB_BUFFER_1  # Selects the AHB buffer instance for which this configuration applies. If an instance is not present, the corresponding AHB buffer will be configured with size 0. The size of the AHB_BUFFER_3 instance will be configured to at least the selected size, or more, up until the maximum value is reached. For more details about the maximum avaialable size see chip specific details.
            enumeration FlsAhbBufferMasterId: {FLS_CORTEX_M4_CODE, FLS_CORTEX_M4_SYS, FLS_DMA, FLS_ENET}, origin=NXP, post-build-variant-value=true, set at post-build in variant post-build / pre-compile in variant pre-compile, default-value=FLS_CORTEX_M4_SYS  # The ID of the AHB master associated with this buffer. Any AHB access with this master port number is routed to this buffer. It must be ensured that the master IDs associated with all buffers must be different.
            integer FlsAhbBufferSize: 0..4294967295, origin=NXP, post-build-variant-value=true, set at post-build in variant post-build / pre-compile in variant pre-compile, default-value=0  # The size allocated to this AHB Buffer instance. The minimum size is 8 bytes, the maximum size is the entire AHB Buffers section size(1024 bytes). There is no benefit in configuring a buffer size greater than FlsAhbBufferDataTransferSize, as the locations greater than this will never be used.
            integer FlsAhbBufferDataTransferSize: 0..4294967295, origin=NXP, post-build-variant-value=true, set at post-build in variant post-build / pre-compile in variant pre-compile, default-value=0  # Defines the data transfer size in bytes of an AHB triggered access to serial flash (ADATSZ bitfield). When value is 0, default, the data size mentioned the sequence pointed to by the SEQID field overrides this value. Software should ensure that this transfer size is not greater than the size of this buffer. Note: When this value is 0,the data size mentioned in the LUT sequence pointed to by the SEQID field overrides this value.
            boolean FlsAhbBufferAllMasters: origin=NXP, post-build-variant-value=true, set at post-build in variant post-build / pre-compile in variant pre-compile, default-value=false  # When set, buffer3 acts as an all-master buffer. Any AHB access with a master port number not matching with the master ID of buffer0 or buffer1 or buffer2 is routed to buffer3. When set, the Master ID parameter for this buffer is ignored.
            boolean FlsAhbBufferHighPriority: origin=NXP, post-build-variant-value=true, set at post-build in variant post-build / pre-compile in variant pre-compile, default-value=false  # When set, the master associated with buffer0 is assigned a priority higher than the rest of the masters. An access by a high priority master will suspend any ongoing prefetch by another AHB master and will be serviced on high priority.
          container FlsQspiLutSeqIdRefs [0..1]: multiplicity set at pre-compile in variant pre-compile / post-build in variant post-build  # Container for the references to the QSPI LUT Sequences ID. The ID is used as a pointer to the correct position of the LUT sequence inside the LUT.
            reference FlsLUTGetStatusSequenceIdRef: origin=NXP, post-build-variant-value=true, set at post-build in variant post-build / pre-compile in variant pre-compile, destination=FlsLUT  # Reference to the LUT Sequence ID which will be used for getting the status(idle/busy) of the external memory. Command is used for polling the job status of the external memory, usually by reading the external memory status register. TBC.
            reference FlsLUTReadSequenceIdRef: origin=NXP, post-build-variant-value=true, set at post-build in variant post-build / pre-compile in variant pre-compile, destination=FlsLUT  # Reference to the LUT Sequence ID which will be used for read and compare operations, in both AHB and IP modes.
            reference FlsLUTWriteEnableSequenceIdRef: origin=NXP, post-build-variant-value=true, set at post-build in variant post-build / pre-compile in variant pre-compile, destination=FlsLUT  # Reference to the LUT Sequence ID which will be used prior to write/erase operations, in order to set the write enable latch.
            reference FlsLUTWriteSequenceIdRef: origin=NXP, post-build-variant-value=true, set at post-build in variant post-build / pre-compile in variant pre-compile, destination=FlsLUT  # Reference to the LUT Sequence ID which will be used for write operations.
            reference FlsLUTEraseSequenceIdRef: origin=NXP, post-build-variant-value=true, set at post-build in variant post-build / pre-compile in variant pre-compile, destination=FlsLUT  # Reference to the LUT Sequence ID which will be used for erase operations.
            reference FlsLUTReadIdSequenceIdRef [0..1]: multiplicity set at post-build in variant post-build / pre-compile in variant pre-compile, origin=NXP, post-build-variant-multiplicity=true, post-build-variant-value=true, set at post-build in variant post-build / pre-compile in variant pre-compile, destination=FlsLUT  # Reference to the LUT Sequence ID which will be used for erase operations. Note: When this sequence reference is enabled, the user should enable and configure also the FLS_E_UNEXPECTED_FLASH_ID error and the FlsQspiDeviceID.
          container FlsLUT [0..16]: multiplicity set at pre-compile in variant pre-compile / post-build in variant post-build  # Container for the configuration of the Look Up Table holding all the Instruction/Operands sequences. A sequence consists of a series of up to 8 instruction/operands pairs, which can ocupy up to 4 LUTs, which are executed whenever a command is triggered to the external flash memory.
            integer FlsLUTIndex: 0..65534, origin=NXP, post-build-variant-value=true, set at post-build in variant post-build / pre-compile in variant pre-compile, default-value=0  # Vendor specific: Fls LUT Index is an invariant index, used to order the LUT entries and loop over them in the correct, configured order. Its value should be equal with the position of the configured LUT inside the configured LUT list (the same value as the shown index). Rationale: The generated .epc configuration might reorder the LUT elements (alphabetically), thus the default index parameter changes, becoming out of sync with the real intended order (the values are not generated in the intended order, they are sorted). Range: min = 0 max = 65534
            container FlsInstructionOperandPair [1..8]: multiplicity set at pre-compile in variant pre-compile / post-build in variant post-build  # TBC.
              integer FlsInstrOperPairIndex: 0..65534, origin=NXP, post-build-variant-value=true, set at post-build in variant post-build / pre-compile in variant pre-compile, default-value=0  # Vendor specific: Fls Instruction Operand Pair Index is an invariant index, used to order the Instr.Oper. entries and loop over them in the correct, configured order. Its value should be equal with the position of the configured pair inside the configured pair list (the same value as the shown index). Rationale: The generated .epc configuration might reorder the instr.oper. pairs (alphabetically), thus the index parameter changes, becoming out of sync with the real intended order (the values are not generated in the intended order, they are sorted). Range: min = 0 max = 65534
              enumeration FlsLUTInstruction: {FLS_LUT_INSTR_CMD, FLS_LUT_INSTR_ADDR, FLS_LUT_INSTR_DUMMY, FLS_LUT_INSTR_MODE, FLS_LUT_INSTR_MODE2, FLS_LUT_INSTR_MODE4, FLS_LUT_INSTR_READ, FLS_LUT_INSTR_WRITE, FLS_LUT_INSTR_JMP_ON_CS, FLS_LUT_INSTR_ADDR_DDR, FLS_LUT_INSTR_MODE_DDR, FLS_LUT_INSTR_MODE2_DDR, FLS_LUT_INSTR_MODE4_DDR, FLS_LUT_INSTR_READ_DDR, FLS_LUT_INSTR_WRITE_DDR, FLS_LUT_INSTR_DATA_LEARN, FLS_LUT_INSTR_CMD_DDR, FLS_LUT_INSTR_CADDR, FLS_LUT_INSTR_CADDR_DDR, FLS_LUT_INSTR_STOP}, origin=NXP, post-build-variant-value=true, set at post-build in variant post-build / pre-compile in variant pre-compile, default-value=FLS_LUT_INSTR_CMD  # TBC.
              enumeration FlsLUTPad: {FLS_LUT_PAD_1_PAD, FLS_LUT_PAD_2_PADS, FLS_LUT_PAD_4_PADS, FLS_LUT_PAD_8_PADS}, origin=NXP, post-build-variant-value=true, set at post-build in variant post-build / pre-compile in variant pre-compile, default-value=FLS_LUT_PAD_1_PAD  # TBC.
              integer FlsLUTOperand: 0..255, origin=NXP, post-build-variant-value=true, set at post-build in variant post-build / pre-compile in variant pre-compile, default-value=0  # TBC.
      container FlsSectorList  # List of flashable sectors and pages.
        container FlsSector [1..*]: multiplicity set at pre-compile in variant pre-compile / post-build in variant post-build  # Configuration description of a flashable sector
          integer FlsSectorIndex: 0..65534, origin=NXP, post-build-variant-value=true, set at post-build in variant post-build / pre-compile in variant pre-compile, default-value=0  # Vendor specific: Fls Sector Index is an invariant index, used to order flash sectors and loop over them in the correct, configured order. Its value should be equal with the position of the configured sector inside the configured sector list (the same value as the shown index). Rationale: The generated .epc configuration might reorder the flash sectors(alphabetically), thus the index parameter changes, becoming out of sync with the real intended order (for example: Fls Sector Start Addresses). Range: min = 0 max = 65534
          boolean FlsPhysicalSectorUnlock: origin=NXP, post-build-variant-value=true, set at post-build in variant post-build / pre-compile in variant pre-compile, default-value=true  # Vendor specific: Fls_Init ensures unlock modify operation for this Flash Physical Sector, it is not possible to lock until a new reset.
          enumeration FlsPhysicalSector: {FLS_DATA_ARRAY_0_BLOCK_1_S000, FLS_DATA_ARRAY_0_BLOCK_1_S001, FLS_DATA_ARRAY_0_BLOCK_1_S002, FLS_DATA_ARRAY_0_BLOCK_1_S003, FLS_DATA_ARRAY_0_BLOCK_1_S004, FLS_DATA_ARRAY_0_BLOCK_1_S005, FLS_DATA_ARRAY_0_BLOCK_1_S006, FLS_DATA_ARRAY_0_BLOCK_1_S007, FLS_DATA_ARRAY_0_BLOCK_1_S008, FLS_DATA_ARRAY_0_BLOCK_1_S009, FLS_DATA_ARRAY_0_BLOCK_1_S010, FLS_DATA_ARRAY_0_BLOCK_1_S011, FLS_DATA_ARRAY_0_BLOCK_1_S012, FLS_DATA_ARRAY_0_BLOCK_1_S013, FLS_DATA_ARRAY_0_BLOCK_1_S014, FLS_DATA_ARRAY_0_BLOCK_1_S015, FLS_DATA_ARRAY_0_BLOCK_1_S016, FLS_DATA_ARRAY_0_BLOCK_1_S017, FLS_DATA_ARRAY_0_BLOCK_1_S018, FLS_DATA_ARRAY_0_BLOCK_1_S019, FLS_DATA_ARRAY_0_BLOCK_1_S020, FLS_DATA_ARRAY_0_BLOCK_1_S021, FLS_DATA_ARRAY_0_BLOCK_1_S022, FLS_DATA_ARRAY_0_BLOCK_1_S023, FLS_DATA_ARRAY_0_BLOCK_1_S024, FLS_DATA_ARRAY_0_BLOCK_1_S025, FLS_DATA_ARRAY_0_BLOCK_1_S026, FLS_DATA_ARRAY_0_BLOCK_1_S027, FLS_DATA_ARRAY_0_BLOCK_1_S028, FLS_DATA_ARRAY_0_BLOCK_1_S029, FLS_DATA_ARRAY_0_BLOCK_1_S030, FLS_DATA_ARRAY_0_BLOCK_1_S031, FLS_CODE_ARRAY_0_BLOCK_0_S000, FLS_CODE_ARRAY_0_BLOCK_0_S001, FLS_CODE_ARRAY_0_BLOCK_0_S002, FLS_CODE_ARRAY_0_BLOCK_0_S003, FLS_CODE_ARRAY_0_BLOCK_0_S004, FLS_CODE_ARRAY_0_BLOCK_0_S005, FLS_CODE_ARRAY_0_BLOCK_0_S006, FLS_CODE_ARRAY_0_BLOCK_0_S007, FLS_CODE_ARRAY_0_BLOCK_0_S008, FLS_CODE_ARRAY_0_BLOCK_0_S009, FLS_CODE_ARRAY_0_BLOCK_0_S010, FLS_CODE_ARRAY_0_BLOCK_0_S011, FLS_CODE_ARRAY_0_BLOCK_0_S012, FLS_CODE_ARRAY_0_BLOCK_0_S013, FLS_CODE_ARRAY_0_BLOCK_0_S014, FLS_CODE_ARRAY_0_BLOCK_0_S015, FLS_CODE_ARRAY_0_BLOCK_0_S016, FLS_CODE_ARRAY_0_BLOCK_0_S017, FLS_CODE_ARRAY_0_BLOCK_0_S018, FLS_CODE_ARRAY_0_BLOCK_0_S019, FLS_CODE_ARRAY_0_BLOCK_0_S020, FLS_CODE_ARRAY_0_BLOCK_0_S021, FLS_CODE_ARRAY_0_BLOCK_0_S022, FLS_CODE_ARRAY_0_BLOCK_0_S023, FLS_CODE_ARRAY_0_BLOCK_0_S024, FLS_CODE_ARRAY_0_BLOCK_0_S025, FLS_CODE_ARRAY_0_BLOCK_0_S026, FLS_CODE_ARRAY_0_BLOCK_0_S027, FLS_CODE_ARRAY_0_BLOCK_0_S028, FLS_CODE_ARRAY_0_BLOCK_0_S029, FLS_CODE_ARRAY_0_BLOCK_0_S030, FLS_CODE_ARRAY_0_BLOCK_0_S031, FLS_CODE_ARRAY_0_BLOCK_0_S032, FLS_CODE_ARRAY_0_BLOCK_0_S033, FLS_CODE_ARRAY_0_BLOCK_0_S034, FLS_CODE_ARRAY_0_BLOCK_0_S035, FLS_CODE_ARRAY_0_BLOCK_0_S036, FLS_CODE_ARRAY_0_BLOCK_0_S037, FLS_CODE_ARRAY_0_BLOCK_0_S038, FLS_CODE_ARRAY_0_BLOCK_0_S039, FLS_CODE_ARRAY_0_BLOCK_0_S040, FLS_CODE_ARRAY_0_BLOCK_0_S041, FLS_CODE_ARRAY_0_BLOCK_0_S042, FLS_CODE_ARRAY_0_BLOCK_0_S043, FLS_CODE_ARRAY_0_BLOCK_0_S044, FLS_CODE_ARRAY_0_BLOCK_0_S045, FLS_CODE_ARRAY_0_BLOCK_0_S046, FLS_CODE_ARRAY_0_BLOCK_0_S047, FLS_CODE_ARRAY_0_BLOCK_0_S048, FLS_CODE_ARRAY_0_BLOCK_0_S049, FLS_CODE_ARRAY_0_BLOCK_0_S050, FLS_CODE_ARRAY_0_BLOCK_0_S051, FLS_CODE_ARRAY_0_BLOCK_0_S052, FLS_CODE_ARRAY_0_BLOCK_0_S053, FLS_CODE_ARRAY_0_BLOCK_0_S054, FLS_CODE_ARRAY_0_BLOCK_0_S055, FLS_CODE_ARRAY_0_BLOCK_0_S056, FLS_CODE_ARRAY_0_BLOCK_0_S057, FLS_CODE_ARRAY_0_BLOCK_0_S058, FLS_CODE_ARRAY_0_BLOCK_0_S059, FLS_CODE_ARRAY_0_BLOCK_0_S060, FLS_CODE_ARRAY_0_BLOCK_0_S061, FLS_CODE_ARRAY_0_BLOCK_0_S062, FLS_CODE_ARRAY_0_BLOCK_0_S063, FLS_CODE_ARRAY_0_BLOCK_0_S064, FLS_CODE_ARRAY_0_BLOCK_0_S065, FLS_CODE_ARRAY_0_BLOCK_0_S066, FLS_CODE_ARRAY_0_BLOCK_0_S067, FLS_CODE_ARRAY_0_BLOCK_0_S068, FLS_CODE_ARRAY_0_BLOCK_0_S069, FLS_CODE_ARRAY_0_BLOCK_0_S070, FLS_CODE_ARRAY_0_BLOCK_0_S071, FLS_CODE_ARRAY_0_BLOCK_0_S072, FLS_CODE_ARRAY_0_BLOCK_0_S073, FLS_CODE_ARRAY_0_BLOCK_0_S074, FLS_CODE_ARRAY_0_BLOCK_0_S075, FLS_CODE_ARRAY_0_BLOCK_0_S076, FLS_CODE_ARRAY_0_BLOCK_0_S077, FLS_CODE_ARRAY_0_BLOCK_0_S078, FLS_CODE_ARRAY_0_BLOCK_0_S079, FLS_CODE_ARRAY_0_BLOCK_0_S080, FLS_CODE_ARRAY_0_BLOCK_0_S081, FLS_CODE_ARRAY_0_BLOCK_0_S082, FLS_CODE_ARRAY_0_BLOCK_0_S083, FLS_CODE_ARRAY_0_BLOCK_0_S084, FLS_CODE_ARRAY_0_BLOCK_0_S085, FLS_CODE_ARRAY_0_BLOCK_0_S086, FLS_CODE_ARRAY_0_BLOCK_0_S087, FLS_CODE_ARRAY_0_BLOCK_0_S088, FLS_CODE_ARRAY_0_BLOCK_0_S089, FLS_CODE_ARRAY_0_BLOCK_0_S090, FLS_CODE_ARRAY_0_BLOCK_0_S091, FLS_CODE_ARRAY_0_BLOCK_0_S092, FLS_CODE_ARRAY_0_BLOCK_0_S093, FLS_CODE_ARRAY_0_BLOCK_0_S094, FLS_CODE_ARRAY_0_BLOCK_0_S095, FLS_CODE_ARRAY_0_BLOCK_0_S096, FLS_CODE_ARRAY_0_BLOCK_0_S097, FLS_CODE_ARRAY_0_BLOCK_0_S098, FLS_CODE_ARRAY_0_BLOCK_0_S099, FLS_CODE_ARRAY_0_BLOCK_0_S100, FLS_CODE_ARRAY_0_BLOCK_0_S101, FLS_CODE_ARRAY_0_BLOCK_0_S102, FLS_CODE_ARRAY_0_BLOCK_0_S103, FLS_CODE_ARRAY_0_BLOCK_0_S104, FLS_CODE_ARRAY_0_BLOCK_0_S105, FLS_CODE_ARRAY_0_BLOCK_0_S106, FLS_CODE_ARRAY_0_BLOCK_0_S107, FLS_CODE_ARRAY_0_BLOCK_0_S108, FLS_CODE_ARRAY_0_BLOCK_0_S109, FLS_CODE_ARRAY_0_BLOCK_0_S110, FLS_CODE_ARRAY_0_BLOCK_0_S111, FLS_CODE_ARRAY_0_BLOCK_0_S112, FLS_CODE_ARRAY_0_BLOCK_0_S113, FLS_CODE_ARRAY_0_BLOCK_0_S114, FLS_CODE_ARRAY_0_BLOCK_0_S115, FLS_CODE_ARRAY_0_BLOCK_0_S116, FLS_CODE_ARRAY_0_BLOCK_0_S117, FLS_CODE_ARRAY_0_BLOCK_0_S118, FLS_CODE_ARRAY_0_BLOCK_0_S119, FLS_CODE_ARRAY_0_BLOCK_0_S120, FLS_CODE_ARRAY_0_BLOCK_0_S121, FLS_CODE_ARRAY_0_BLOCK_0_S122, FLS_CODE_ARRAY_0_BLOCK_0_S123, FLS_CODE_ARRAY_0_BLOCK_0_S124, FLS_CODE_ARRAY_0_BLOCK_0_S125, FLS_CODE_ARRAY_0_BLOCK_0_S126, FLS_CODE_ARRAY_0_BLOCK_0_S127}, origin=NXP, post-build-variant-value=true, set at post-build in variant post-build / pre-compile in variant pre-compile, default-value=FLS_DATA_ARRAY_0_BLOCK_1_S000  # Vendor specific: Physical flash device sector.
          integer FlsNumberOfSectors: 0..65535, set at pre-compile, default-value=1  # Number of continuous sectors with the above characteristics.Note:Not supported by the driver.
          integer FlsPageSize: 0..4294967295, post-build-variant-value=true, set at pre-compile, default-value=8  # Size of one page of this sector. Implementation Type: Fls_LengthType. For internal flash, page size is 8 byte For external flash, page size is chip specific. Note: For external QSPI flash, the hardware IP requires a minimum size of 16 bytes for each write operations. The page size for external sectors must be configured to an integer multiple of 16 bytes.
          integer FlsSectorSize: 0..4294967295, post-build-variant-value=true, set at pre-compile, default-value=2048  # Size of this sector. Implementation Type: Fls_LengthType. Note: Size of the sector should be a multiple of the page size.
          integer FlsSectorStartaddress: 0..4294967295, post-build-variant-value=true, set at pre-compile, default-value=0  # Start address of this sector. Implementation Type: Fls_AddressType.
          enumeration FlsProgrammingSize: {FLS_WRITE_DOUBLE_WORD}, origin=NXP, post-build-variant-value=true, set at post-build in variant post-build / pre-compile in variant pre-compile, default-value=FLS_WRITE_DOUBLE_WORD  # Vendor specific: This is the maximum size which can be used to program Flash memory during one single High voltage operation or external transaction. Note: For internal flash sectors, the avaialable values are: FLS_WRITE_DOUBLE_WORD(8bytes), FLS_WRITE_PAGE(32bytes), FLS_WRITE_QUAD_PAGE(128bytes), etc, depending on hardware availability. Note: For external flash sectors, the avaialable values are: FLS_WRITE_128BYTES_PAGE(128bytes), FLS_WRITE_256BYTES_PAGE(256bytes), FLS_WRITE_512BYTES_PAGE(512bytes), etc, depending on hardware availability. For the external flash sectors, this value should be correlated with the memory internal buffer size and alignement restrictions. Internally, the flash driver will use this value to check the alignement boundaries, in order to avoid the memory buffer wrap-arround. This parameter setting will not override or increase the MaxWrite parameters in terms of maximum programming size per MainFunction iteration, it will just check the alignement and maximum size per hardware transaction.
          boolean FlsSectorEraseAsynch: origin=NXP, post-build-variant-value=true, set at post-build in variant post-build / pre-compile in variant pre-compile, default-value=false  # Vendor specific: Enable asynchronous execution of the erase job in the Fls_MainFunction function which doesn't wait (block) for completion of the sector erase operation. The flash driver doesn't use the erase access code to the erase flash sector in asynchronous mode so it can be used only on flash sectors which belong to flash array different from flash array the application is executing from. Note: If both FlsSectorEraseAsynch and FlsSectorIrqMode flags are set, the Async flag has priority and the sector is erased in normal, asynchronous context, not in interrupt context.
          boolean FlsPageWriteAsynch: origin=NXP, post-build-variant-value=true, set at post-build in variant post-build / pre-compile in variant pre-compile, default-value=false  # Vendor specific: Enable asynchronous execution of the write job in the Fls_MainFunction function which doesn't wait (block) for completion of the page write operation(s). The flash driver doesn't use the write access code to the write flash page(s) in asynchronous mode so it can be used only on flash sectors which belong to flash array different from flash array the application is executing from. Note: If both FlsPageWriteAsynch and FlsSectorIrqMode flags are set, the Async flag has priority and the sector is written in normal, asynchronous context, not in interrupt context.
          boolean FlsSectorIrqMode: origin=NXP, post-build-variant-value=true, set at post-build in variant post-build / pre-compile in variant pre-compile, default-value=false  # Vendor specific: Enable the flash jobs associated with this sector to be executed in interrupt context. This option applies for all type of jobs: read, write, erase. This option applies only for the sectors on which there is hardware support. For example, if a sector is assigned on the internal flash hardware channel, there might not be any interrupt capability avaialable. Note: Flash driver support to execute Sector Erase/Page Write job in either Asynch mode or Interrupt mode
          enumeration FlsHwCh: {FLS_CH_INTERN}, origin=NXP, post-build-variant-value=true, set at post-build in variant post-build / pre-compile in variant pre-compile, default-value=FLS_CH_INTERN  # The hardware channel type of the current sector: internal flash or external QSPI flash sector.
          enumeration FlsQspiSectorCh: {FLS_CH_EXTERN_QSPI_0_A1, FLS_CH_EXTERN_QSPI_0_A2, FLS_CH_EXTERN_QSPI_0_B1, FLS_CH_EXTERN_QSPI_0_B2, FLS_CH_EXTERN_QSPI_0_PARALLEL_A1B1, FLS_CH_EXTERN_QSPI_0_PARALLEL_A2B2, NOT_QSPI_CHANNEL}, origin=NXP, post-build-variant-value=true, set at post-build in variant post-build / pre-compile in variant pre-compile, default-value=NOT_QSPI_CHANNEL  # The QSPI hardware channel, the assigned external chip select for this sector. The value of the QSPI channel determines the external QSPI port pins on which all transactions targeting this sector will be triggered.
          integer FlsSectorHwAddress: 0..4294967295, origin=NXP, post-build-variant-value=true, set at post-build in variant post-build / pre-compile in variant pre-compile, default-value=0  # Hardware address of this sector, as needed by the external flash device (usually starting from 0). Applicable only to external sectors. This value is used to access the hardware sector on the attached device and will be sent as parameter of flash comands, so it should be completed to meet the requirements of the external flash memory type and configured operating mode. Internally, this address is added to the MCU base addresses of each channel, configured in SF{A/B}{1/2}AD registers, in order to select the corresponding external device hw channel. Example: FlsSectorHwAddress = 0x100 Sector hardware channel = FLS_CH_EXTERN_QSPI_0_A2 FlsSerialFlashA1TopAddr = 0x24000000 The address used by the driver internally will be 0x24000100, thus selecting external flash device A2 and accessing internal location 0x100 of the memory.
    container NonAutosar  # Vendor specific: This container contains the global Non-Autosar configuration parameters of the Fls driver. This container is a MultipleConfigurationContainer, i.e. this container and its sub-containers exist once per configuration set.
      boolean FlsDisableDemReportErrorStatus: origin=NXP, set at pre-compile, default-value=false  # Vendor specific: Switches the Diagnostic Error Reporting and Notification OFF. Note: This parameter is obsolete as DEM errors will be removed in release 4.3.
      boolean FlsCheckFlexNvmRatio: origin=NXP, set at pre-compile, default-value=false  # Vendor specific: Switches the FlexNvm partion ratio check ON at initialization. If check is ON, the driver initialization will fail if FlexNvm is partitioned otherwise than: Data flash only, no EEPROM emulation.
      boolean FlsEnableUserModeSupport: origin=NXP, set at pre-compile, default-value=false  # When this parameter is enabled, the FLS module will adapt to run from User Mode, with the following measures: configuring REG_PROT for Fls IPs so that the registers under protection can be accessed from user mode by setting UAA bit in REG_PROT_GCR to 1 for more information and availability on this platform, please see chapter User Mode Support in IM
      boolean FlsQspiLockLUT: origin=NXP, set at pre-compile, default-value=false  # Vendor specific parameter: Enable the Lock/Unlock of the LUT for the external QuadSPI memory. If Enabled, the LUT is unlocked at the beginning of the Init phase and locked at the end of it. If Disabled, the LUT has to be unlocked if the Init phase is supposed to populate it.
      boolean FlsSynchronizeCache: origin=NXP, set at pre-compile, default-value=false  # Vendor specific: Synchronize the memory by invalidating the cache after each flash hardware operation. The FLS driver needs to maintain the memory coherency by means of three methods: 1. Disable data cache, or 2. Configure the flash region upon which the driver operates, as non-cacheable, or 3. Enable the FlsSynchronizeCache feature. Depending on the application configuration, one option may be more beneficial than other. Enabled: The FLS driver will call Mcl cache API functions in order to invalidate the cache after each high voltage operation(write,erase) and before each read operation, in order to ensure that the cache and the modified flash memory are in sync. If enabled, the driver will attempt to invalidate only the modified lines from the cache. If the size of the region to be invalidated is greater than half of the cache size, then the entire cache is invalidated. Note: If enabled, the MclLmemEnableCacheApi parameter has to be enabled and the MCL plugin included as a dependency. Disabled: The upper layers have to ensure that the flash region upon which the driver operates is not cached. This can be obtained by either disabling the data cache or by configuring the memory region as non-cacheable. Note: This feature is applicable only if supported on the current platform.
      boolean FlsInternalSectorsConfigured: origin=NXP, set at pre-compile, default-value=false  # Vendor specific: Boolean parameter which must be enabled if internal flash sectors are configured. Enabled: At least one internal flash sector is configured in any variant. Disabled: No internal flash sector is configured in any variant, only external flash sectors are present.
      boolean FlsExternalSectorsConfigured: origin=NXP, set at pre-compile, default-value=false  # Vendor specific: Boolean parameter which must be enabled if external flash sectors are configured. Enabled: At least one external flash sector is configured in any variant. Disabled: No external flash sector is configured in any variant, only internal flash sectors are present.
    container FlsGeneral  # Container for general parameters of the flash driver. These parameters are always pre-compile.
      boolean FlsAcLoadOnJobStart: set at pre-compile, default-value=false  # The flash driver shall load the flash access code to RAM whenever an erase or write job is started and unload (overwrite) it after that job has been finished or canceled. true: Flash access code loaded on job start / unloaded on job end or error. false: Flash access code not loaded to / unloaded from RAM at all.
      integer FlsBaseAddress: 0..4294967295, set at pre-compile, default-value=0  # The flash memory start address (see also FLS118). FLS169: This parameter defines the lower boundary for read / write / erase and compare jobs.Note:Not needed / supported by the driver.
      boolean FlsBlankCheckApi: set at pre-compile, default-value=false  # Compile switch to enable and disable the Fls_BlankCheck function. true: API supported / function provided. false: API not supported / function not provided
      boolean FlsCancelApi: set at pre-compile, default-value=true  # Compile switch to enable and disable the Fls_Cancel function. true: API supported / function provided. false: API not supported / function not provided
      boolean FlsCompareApi: set at pre-compile, default-value=true  # Compile switch to enable and disable the Fls_Compare function. true: API supported / function provided. false: API not supported / function not provided
      boolean FlsDevErrorDetect: set at pre-compile, default-value=true  # Pre-processor switch to enable and disable development error detection. true: Development error detection enabled. false: Development error detection disabled.
      boolean FlsRuntimeErrorDetect: origin=NXP, set at pre-compile, default-value=true  # Vendor specific: Pre-processor switch to enable and disable runtime error detection. true: Runtime error detection enabled. false: Runtime error detection disabled.
      integer FlsDriverIndex: 0..254, scope=ECU, set at pre-compile, symbolic-name-value=true, default-value=0  # Index of the driver, used by FEE.
      boolean FlsGetJobResultApi: set at pre-compile, default-value=true  # Compile switch to enable and disable the Fls_GetJobResult function. true: API supported / function provided. false: API not supported / function not provided
      boolean FlsGetStatusApi: set at pre-compile, default-value=true  # Compile switch to enable and disable the Fls_GetStatus function. true: API supported / function provided. false: API not supported / function not provided
      boolean FlsSetModeApi: set at pre-compile, default-value=true  # Compile switch to enable and disable the Fls_SetMode function. true: API supported / function provided. false: API not supported / function not provided
      integer FlsTotalSize: 0..4294967295, set at pre-compile, default-value=0  # The total amount of flash memory in bytes (see also FLS118). FLS170: This parameter in conjunction with FLS_BASE_ADDRESS defines the upper boundary for read / write / erase and compare jobs. Note:Not needed / supported by the driver.
      boolean FlsUseInterrupts: set at pre-compile, default-value=false  # Job processing triggered by hardware interrupt. true: Job processing triggered by interrupt (hardware controlled) false: Job processing not triggered by interrupt (software controlled) Note: Available only on sectors which are assigned to a hardware channel which support interrupt processing. Note: The interrupt processing mode has to be also enabled individualy per each sector on which IRQ mode is needed.
      boolean FlsVersionInfoApi: set at pre-compile, default-value=true  # Pre-processor switch to enable / disable the API to read out the modules version information. true: Version info API enabled. false: Version info API disabled.
      boolean FlsDsiHandlerApi: origin=NXP, set at pre-compile, default-value=false  # Vendor specific: Pre-processor switch to enable / disable the API to report data storage (ECC) errors to the flash driver. true: Data storage handler API enabled. false: Data storage handler API disabled.
      boolean FlsEraseBlankCheck: origin=NXP, set at pre-compile, default-value=true  # Vendor specific: Pre-processor switch to enable / disable the erase blank check. After a flash block has been erased, the erase blank check compares the contents of the addressed memory area against the value of an erased flash cell to check that the block has been completely erased. true: Erase blank check enabled. false: Erase blank check disabled.
      boolean FlsWriteBlankCheck: origin=NXP, set at pre-compile, default-value=true  # Vendor specific: Pre-processor switch to enable / disable the write blank check. Before writing a flash block, the write blank check compares the contents of the addressed memory area against the value of an erased flash cell to check that the block has been completely erased. true: Write blank check enabled. false: Write blank check disabled.
      boolean FlsWriteVerifyCheck: origin=NXP, set at pre-compile, default-value=true  # Vendor specific: Pre-processor switch to enable / disable the write verify check. After writing a flash block, the write verify check compares the contents of the reprogrammed memory area against the contents of the provided application buffer to check that the block has been completely reprogrammed. true: Write verify check enabled. false: Write verify check disabled.
      integer FlsMaxEraseBlankCheck: 8..65536, origin=NXP, set at pre-compile, default-value=256  # Vendor specific: The maximum number of bytes to blank check in one cycle of the flash driver's job processing function. Affects only the flash blocks that have enabled asynchronous execution of the erase job (FlsSectorEraseAsynch=true).
      container FlsTimeouts [0..1]: multiplicity set at pre-compile  # Container for hardware timeout handling.
        integer FlsAsyncWriteTimeout: 0..2147483647, origin=NXP, set at pre-compile, default-value=2147483647  # Vendor specific: Fls Async Write Timeout is the timeout value for write operation in asynchronous mode.
        integer FlsAsyncEraseTimeout: 0..2147483647, origin=NXP, set at pre-compile, default-value=2147483647  # Vendor specific: Fls Async Erase Timeout is the timeout value for erase operation in asynchronous mode.
        integer FlsSyncWriteTimeout: 0..2147483647, origin=NXP, set at pre-compile, default-value=2147483647  # Vendor specific: Fls Sync Write Timeout is the timeout value for write operation in synchronous mode.
        integer FlsSyncEraseTimeout: 0..2147483647, origin=NXP, set at pre-compile, default-value=2147483647  # Vendor specific: Fls Sync Erase Timeout is the timeout value for erase operation in synchronous mode.
        integer FlsQspiSyncReadTimeout: 0..2147483647, origin=NXP, set at pre-compile, default-value=2147483647  # Vendor specific: Fls Qspi Sync Read Timeout is the timeout value for read operation.
        integer FlsQspiAsyncWriteTimeout: 0..2147483647, origin=NXP, set at pre-compile, default-value=2147483647  # Vendor specific: Fls Qspi Async Write Timeout is the timeout value for QSPI write operation in asynchronous mode.
        integer FlsQspiAsyncEraseTimeout: 0..2147483647, origin=NXP, set at pre-compile, default-value=2147483647  # Vendor specific: Fls Qspi Async Erase Timeout is the timeout value for QSPI erase operation in asynchronous mode.
        integer FlsQspiSyncWriteTimeout: 0..2147483647, origin=NXP, set at pre-compile, default-value=2147483647  # Vendor specific: Fls Qspi Sync Write Timeout is the timeout value for QSPI write operation in synchronous mode.
        integer FlsQspiSyncEraseTimeout: 0..2147483647, origin=NXP, set at pre-compile, default-value=2147483647  # Vendor specific: Fls Qspi Sync Erase Timeout is the timeout value for QSPI erase operation in synchronous mode.
        integer FlsQspiIrqReadTimeout: 0..2147483647, origin=NXP, set at pre-compile, default-value=2147483647  # Vendor specific: Fls Qspi Irq Read Timeout is the timeout value for QSPI read operation in interrupt mode. The value represents the number of Fls_MainFunctions it takes to complete the QSPI interrupt job.
        integer FlsQspiIrqEraseTimeout: 0..2147483647, origin=NXP, set at pre-compile, default-value=2147483647  # Vendor specific: Fls Qspi Irq Read Timeout is the timeout value for QSPI read operation in interrupt mode. The value represents the number of Fls_MainFunctions it takes to complete the QSPI interrupt job.
        integer FlsQspiIrqWriteTimeout: 0..2147483647, origin=NXP, set at pre-compile, default-value=2147483647  # Vendor specific: Fls Qspi Irq Write Timeout is the timeout value for QSPI read operation in interrupt mode. The value represents the number of Fls_MainFunctions it takes to complete the QSPI interrupt job.
        integer FlsAbortTimeout: 0..2147483647, origin=NXP, set at pre-compile, default-value=32767  # Vendor specific: Fls Abort Timeout is the timeout value for aborting an ongoing operation. The timeout is used also in Fls_Cancel API, if enabled and if the flash hardware channel does not support an immediate abort feature.
    container FlsPublishedInformation  # Additional published parameters not covered by CommonPublishedInformation container. Note that these parameters do not have any configuration class setting, since they are published information.
      integer FlsAcLocationErase: 0..4294967295, set at published-information, default-value=0  # Position in RAM, to which the erase flash access code has to be loaded. Only relevant if the erase flash access code is not position independent. If this information is not provided it is assumed that the erase flash access code is position independent and that therefore the RAM position can be freely configured.
      integer FlsAcLocationWrite: 0..4294967295, set at published-information, default-value=0  # Vendor specific: Position in RAM, to which the write flash access code has to be loaded. Only relevant if the write flash access code is not position independent. If this information is not provided it is assumed that the write flash access code is position independent and that therefore the RAM position can be freely configured.
      integer FlsAcSizeErase: 0..4294967295, set at published-information, default-value=0  # Number of bytes in RAM needed for the erase flash access code.
      integer FlsAcSizeWrite: 0..4294967295, set at published-information, default-value=0  # Number of bytes in RAM needed for the write flash access code.
      float FlsEraseTime: 0.0..5.0, set at published-information, default-value=5.0  # Maximum time to erase one complete flash sector [sec]. Note:This value can be found on DS as the maximum erase time occurs after the specified number of program/erase cycles .
      integer FlsErasedValue: 0..4294967295, set at published-information, default-value=4294967295  # The contents of an erased flash memory cell.
      string FlsExpectedHwId: set at published-information, default-value=0  # Unique identifier of the hardware device that is expected by this driver (the device for which this driver has been implemented). Only relevant for external flash drivers.
      integer FlsSpecifiedEraseCycles: 0..4294967295, set at published-information, default-value=100000  # Number of erase cycles specified for the flash device (usually given in the device data sheet). FLS198: If the number of specified erase cycles depends on the operating environment (temperature, voltage, ...) during reprogramming of the flash device, the minimum number for which a data retention of at least 15 years over the temperature range from -40C .. +125C can be guaranteed shall be given. Note:If there are different numbers of specified erase cycles for different flash sectors of the device this parameter has to be extended to a parameter list (similar to the sector list above).
      float FlsWriteTime: 0.0..5.0E-4, set at published-information, default-value=0.0005  # Maximum time to program one complete flash page [sec].
    container CommonPublishedInformation  # Common container, aggregated by all modules. It contains published information about vendor and versions.
      integer ArReleaseMajorVersion: 4..4, origin=NXP, set at published-information, default-value=4  # Vendor specific: Major version number of AUTOSAR specification on which the appropriate implementation is based on.
      integer ArReleaseMinorVersion: 2..2, origin=NXP, set at published-information, default-value=2  # Vendor specific: Minor version number of AUTOSAR specification on which the appropriate implementation is based on.
      integer ArReleaseRevisionVersion: 2..2, origin=NXP, set at published-information, default-value=2  # Vendor specific: Patch version number of AUTOSAR specification on which the appropriate implementation is based on.
      integer ModuleId: 92..92, origin=NXP, set at published-information, default-value=92  # Vendor specific: Module ID of this module.
      integer SwMajorVersion: 1..1, origin=NXP, set at published-information, default-value=1  # Major version number of the vendor specific implementation of the module. The numbering is vendor specific.
      integer SwMinorVersion: 0..0, origin=NXP, set at published-information, default-value=0  # Minor version number of the vendor specific implementation of the module. The numbering is vendor specific.
      integer SwPatchVersion: 2..2, origin=NXP, set at published-information, default-value=2  # Patch level version number of the vendor specific implementation of the module. The numbering is vendor specific.
      string VendorApiInfix [0..1]: multiplicity set at published-information, origin=NXP, set at published-information  # In driver modules which can be instantiated several times on a single ECU, BSW00347 requires that the name of APIs is extended by the VendorId and a vendor specific name. This parameter is used to specify the vendor specific name. In total, the implementation specific name is generated as follows: <ModuleName>_>VendorId>_<VendorApiInfix>. E.g. assuming that the VendorId of the implementor is 123 and the implementer chose a VendorApiInfix of "v11r456" a api name Can_Write defined in the SWS will translate to Can_123_v11r456Write. This parameter is mandatory for all modules with upper multiplicity > 1. It shall not be used for modules with upper multiplicity =1.
      integer VendorId: 43..43, origin=NXP, set at published-information, default-value=43  # Vendor ID of the dedicated implementation of this module according to the AUTOSAR vendor list.
