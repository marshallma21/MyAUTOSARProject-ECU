AUTOSAR XML (schema 4-3-0)
package /TS_T40D2M10I2R0
  ecuc definition collection Can_EcuParameterDefinition: module=Can
  module definition Can [1..*]: post-build-variant-support=true, refined-module-def=Can, variants post-build/pre-compile  # This container holds the configuration of a single CAN Driver.
    container CanConfigSet  # CAN343_Conf. This is the multiple configuration set container for CAN Driver.
      container CanController [1..*]: multiplicity set at pre-compile  # CAN354_Conf. This container contains the configuration parameters of the CAN controller(s).
        enumeration CanHwChannel: {FlexCAN_A, FlexCAN_B, FlexCAN_C}, origin=NXP, set at pre-compile, default-value=FlexCAN_A  # Specifies which one of the on-chip FlexCAN interfaces is associated with this controller ID. NoteImplementation Specific parameter. Not AutoSar Required.
        boolean CanControllerActivation: set at pre-compile, default-value=true  # CAN315_Conf. Defines if a CAN controller is used in the configuration. Deactivation of a particular CAN controller is equivalent to a CAN controller not used in the configuration.
        integer CanControllerBaseAddress: 0..4294967295, set at pre-compile, default-value=0  # CAN382_Conf. Specifies the CAN controller base address.
        boolean CanControllerIcomSupported: origin=NXP, set at pre-compile, default-value=false  # Define if the current controller support Pretended Networking (Icom)
        integer CanControllerId: 0..255, scope=ECU, set at pre-compile, symbolic-name-value=true, default-value=1  # CAN316_Conf: This parameter provides the controller ID which is unique in a given CAN Driver. The value for this parameter starts with 0 and continue without any gaps.
        enumeration CanRxProcessing: {INTERRUPT, POLLING}, set at pre-compile, derivation=informal-formula=verbatim=l-5=Mode of event triggering: INTERRUPT or POLLING., default-value=POLLING  # CAN317_Conf. Enables/Disables API Can_MainFunction_Read() for handling PDU reception events in POLLING mode.
        enumeration CanTxProcessing: {INTERRUPT, POLLING}, set at pre-compile, derivation=informal-formula=verbatim=l-5=Mode of event triggering: INTERRUPT or POLLING., default-value=POLLING  # CAN318_Conf. Enables/Disables API Can_MainFunction_Write() for handling PDU transmission events in POLLING mode
        enumeration CanBusoffProcessing: {INTERRUPT, POLLING}, set at pre-compile, derivation=informal-formula=verbatim=l-5=Mode of event triggering: INTERRUPT or POLLING., default-value=POLLING  # CAN314_Conf. Enables/Disables API Can_MainFunction_BusOff() for handling busoff events in POLLING mode.
        boolean CanWakeupFunctionalityAPI: set at pre-compile, default-value=false  # Adds / removes the service Can_CheckWakeup() from the code.
        enumeration CanWakeupProcessing: {INTERRUPT, POLLING}, set at pre-compile, derivation=informal-formula=verbatim=l-5=Mode of event triggering: INTERRUPT or POLLING., default-value=POLLING  # CAN319_Conf. Enables/Disables API Can_MainFunction_Wakeup() for handling wakeup events in POLLING mode. NoteThis option is enabled only if global parameter <CanController/CanWakeupsupport> is 'true'.
        boolean CanBccSupport: origin=NXP, set at pre-compile, default-value=false  # Defines if Backwards Compatibility Configuration (BCC) feature of CAN controller is used in the configuration. If BCC feature of CAN controller is enabled, Individual Rx masking and queue feature are disabled. If BCC feature of CAN controller is disabled, Individual Rx masking and queue feature are enabled. NoteImplementation Specific parameter.
        boolean CanWakeupSupport: set at pre-compile, default-value=false  # CAN330_Conf. CAN driver support for wakeup over CAN Bus. Every WakeUp process will be ignore if this checkbox is not set to ON. This parameter enables Internal Wakeup (using controller registers) and External Wakeup (using WKUP module). This is enabled only if internal Wakeup is supported by the platform.
        boolean CanListenOnlyMode: origin=NXP, set at pre-compile in variant pre-compile / post-build in variant post-build, default-value=false  # Enables the Listen Only Mode (CTRL[LOM] bit). In this mode, transmission is disabled, all error counters are frozen and the module operates in a CAN Error Passive mode. NoteImplementation specific Parameter. Not AutoSar Required.
        boolean CanLoopBackMode: origin=NXP, set at pre-compile in variant pre-compile / post-build in variant post-build, default-value=false  # CTRL[LPB]: Enables CAN to operate in Loop Back Mode. The bit stream output of the transmitter is fed back internally to the receiver input. The Rx CAN input pin is ignored and the Tx CAN output goes to the recessive state (logic "1"). NoteImplementation specific Parameter. Not AutoSar Required.
        boolean CanSoftwareBusOffRecovery: origin=NXP, set at pre-compile in variant pre-compile / post-build in variant post-build, default-value=false  # Enables Software Bus Off recovery when automatic recovering from BusOff state is disabled for CAN controller. NoteImplementation specific Parameter. This parameter is enabled when CanAutoBusOffRecovery is set to false.
        boolean CanAutoBusOffRecovery: origin=NXP, set at pre-compile in variant pre-compile / post-build in variant post-build, default-value=false  # Enable/Disable automatic BusOff recovery (CTRL[BOFF_REC] bit). 0(Checked) = Automatic recovering from Bus Off state occurs according to the CAN Specification 2.0B. 1(Unchecked) = Automatic recovering from Bus Off is disabled and the module remains in Bus Off state until the bit is negated(zero) by the user. NoteImplementation specific Parameter. Not AutoSar Required.
        boolean CanTrippleSamplingEnable: origin=NXP, set at pre-compile in variant pre-compile / post-build in variant post-build, default-value=false  # CTRL[SMP]: This bit defines the sampling mode of CAN bits at the Rx input. 1 - Enables acquisition of 3 samples and majority voting for the value of received bit. 0 - Just one sample is used to determine the bit value. NoteImplementation specific Parameter. Not AutoSar Required.
        boolean CanWakeUpSourceFilter: origin=NXP, set at pre-compile in variant pre-compile / post-build in variant post-build, default-value=false  # Defines whether the integrated low-pass filter is applied to protect the Rx CAN input from spurious wake up. 1 = FlexCAN uses the filtered Rx input to detect recessive to dominant edges on the CAN bus. 0 = FlexCAN uses the unfiltered Rx input to detect recessive to dominant edges on the CAN bus. This option will provide the setting for init the controller with MCR[WAK_SRC] bit set. NoteImplementation specific Parameter. Not AutoSar Required.
        boolean CanLowestBuffTransmitFirst: origin=NXP, set at pre-compile in variant pre-compile / post-build in variant post-build, default-value=true  # CTRL[LBUF]. This bit defines the ordering mechanism for Message Buffer transmission. When asserted, the MCR[LPRIO_EN] bit doesn't affect the priority arbitration. NoteImplementation specific Parameter. Not AutoSar Required.
        boolean CanLocalPriorityEn: origin=NXP, set at pre-compile in variant pre-compile / post-build in variant post-build, default-value=false  # MCR[LPRIO_EN]. This bit controls whether the local priority feature is enabled or not. NoteImplementation specific Parameter. Not AutoSar Required.
        boolean CanClockFromBus: origin=NXP, set at pre-compile, default-value=true  # Switches the source clock for the module to the system bus (rather than crystal). 1 = The CAN engine clock source is the bus clock.(from MCU) 0 = The CAN engine clock source is the oscillator clock. NoteImplementation specific Parameter. Not AutoSar Required.
        boolean CanControllerRxFifoEnable: origin=NXP, set at pre-compile in variant pre-compile / post-build in variant post-build, default-value=false  # Defines if RX FIFO feature of CAN controller is used in the configuration. If FIFO feature of CAN controller is enabled, First 8 Message Buffers will be used by FIFO engine. NoteImplementation Specific parameter.
        function name CanRxFifoWarningNotification: origin=NXP, set at pre-compile in variant pre-compile / post-build in variant post-build, default-value=NULL_PTR  # Set here the name of the handler for RxFifo Warning notification function. NoteImplementation Specific parameter
        function name CanRxFifoOverflowNotification: origin=NXP, set at pre-compile in variant pre-compile / post-build in variant post-build, default-value=NULL_PTR  # Set here the name of the handler for RxFifo Overflow notification function. NoteImplementation Specific parameter
        boolean CanErrorControllerNotifEn: origin=NXP, set at pre-compile in variant pre-compile / post-build in variant post-build, default-value=true  # Enables/Disables the Error Controller Notification. If Disabled, no error INTERRUPT or notification shall take place. NoteImplementation Specific parameter. Not AutoSar Required.
        function name CanErrorControllerNotification: origin=NXP, set at pre-compile in variant pre-compile / post-build in variant post-build, default-value=NULL_PTR  # Set here the name of the Error INTERRUPT controller notification function. NoteImplementation Specific parameter
        reference CanControllerDefaultBaudrate: post-build-variant-value=true, set at pre-compile in variant pre-compile / post-build in variant post-build, destination=CanControllerBaudrateConfig  # CAN435_Conf. Reference to baudrate configuration container configured for the Can Controller.
        reference CanCpuClockRef: set at pre-compile, destination=McuClockReferencePoint  # CAN313_Conf. Reference to the CPU clock configuration, which is set in the MCU driver configuration. This control is used only if "CanClockFromBus" = "true". MCU plugin need to be added and then give the reference to it.
        reference CanCpuClockRef_Alternate [0..1]: multiplicity set at pre-compile, origin=NXP, set at pre-compile, destination=McuClockReferencePoint  # Reference to the CPU clock configuration, which is set in the MCU driver configuration. This control is used only if "CanClockFromBus" = "true". MCU plugin need to be added and then give the reference to it. Note: This parameter is visible only if Can.CanConfig.DualClockMode=STD_ON from Resource files. Note: This parameter is editable only if CanGeneral/CanEnableDualClockMode is set to "true" and "CanClockFromBus" is set to true.
        symbolic name reference CanWakeupSourceRef [0..1]: multiplicity set at pre-compile, set at pre-compile, destination=EcuMWakeupSource  # CAN359_Conf. This parameter contains a reference to the Wakeup Source for this controller as defined in the ECU State Manager. Type: reference to EcuM_WakeupSourceType EcuM plugin need to be added and then give the reference to it.
        container CanControllerBaudrateConfig [1..*]: multiplicity set at pre-compile  # CAN351. This container contains the configuration (parameters) of the CAN Filter Mask(s).
          boolean CanControllerCheckCanStandard: origin=NXP, post-build-variant-value=true, set at pre-compile in variant pre-compile / post-build in variant post-build, default-value=true  # Note EN: If enabled, Can Plugin checks that CanControllerPropSeg, CanControllerSeg1, CanControllerSeg2 and CanControllerSyncJumpWidth settings match the CAN Standard Compliant Bit Time Segment Settings. See the following table for details: CanControllerPropSeg + CanControllerSeg1 CanControllerSeg2 CanControllerSyncJumpWidth [5 .. 10] 2 [1 .. 2] [4 .. 11] 3 [1 .. 3] [5 .. 12] 4 [1 .. 4] [6 .. 13] 5 [1 .. 4] [7 .. 14] 6 [1 .. 4] [8 .. 15] 7 [1 .. 4] [9 .. 16] 8 [1 .. 4] NoteImplementation Specific parameter. Not AutoSar Required.
          boolean CanAdvancedSetting: origin=NXP, post-build-variant-value=true, set at pre-compile in variant pre-compile / post-build in variant post-build, default-value=false  # If TRUE initiates the derivation of the CAN bit timing values from the CanControllerBaudRate parameter. When this option is True the CanControllerPropSeg, CanControllerSeg1, CanControllerSeg2, CanControllerSyncJumpWidth are disabled because are background calculated.
          integer CanBusLength: 1..5000, origin=NXP, post-build-variant-value=true, set at pre-compile in variant pre-compile / post-build in variant post-build, default-value=40  # Specifies the CAN Bus length in meters. This parameter is used for PROPSEG parameter calculation when "CanAdvancedSetting" control is set to true. NoteImplementation specific Parameter.
          float CanPropDelayTranceiver: 0.0..5000.0, origin=NXP, post-build-variant-value=true, set at pre-compile in variant pre-compile / post-build in variant post-build, default-value=150  # Propogation delay of Tranceiver used in nanoseconds. NoteImplementation specific Parameter. The calculation for the CAN bit timing is implemented in the code template. The Formulas used in the code template for calculation are as follows. Physical delay of bus = Bus length * Bus propagation delay. tPROP_SEG = 2(Physical delay of bus +CanPropDelayTranceiver ). PROP_SEG = ROUND_UP (tPROP_SEG/Bus propagation delay). Based on these calculations implemented in the Code template the consistency check is maintained for CanPropDelayTranceiver parameter. The PROP_SEG parameter need to be a integral value and not fractional value.
          integer CanTxArbitrationStartDelay: 0..63, origin=NXP, post-build-variant-value=true, set at pre-compile in variant pre-compile / post-build in variant post-build, default-value=12  # This 5-bit field indicates how many CAN bits the Tx arbitration process start point can be delayed from the first bit of CRC field on CAN bus. See Reference Manual to have a calculation method for the optimal TASD value.
          integer CanControllerPrescaller: 1..256, origin=NXP, post-build-variant-value=true, set at pre-compile in variant pre-compile / post-build in variant post-build, default-value=100  # Specifies the prescaller for the controller . The calculation of the resulting CanControllerTimeQuanta value depending on module clocking and prescaller shall be done offline. Prescaler = FreqCanClk / FreqTq; FreqTq = 1 / CanControllerTimeQuanta .
          integer CanControllerBaudRateConfigID: 0..65535, scope=ECU, post-build-variant-value=true, set at pre-compile in variant pre-compile / post-build in variant post-build, default-value=0  # Uniquely identifies a specific baud rate configuration. This ID is used by SetBaudrate API
          integer CanControllerPrescaller_Alt: 1..256, origin=NXP, post-build-variant-value=true, set at pre-compile in variant pre-compile / post-build in variant post-build, default-value=100  # Specifies the alternate prescaller for the controller . The calculation of the resulting CanControllerTimeQuanta_Alternate value depending on module clocking and prescaller shall be done offline. Prescaler = FreqCanClk / FreqTq; FreqTq = 1 / CanControllerTimeQuanta . Note: This parameter is visible only if Can.CanConfig.DualClockMode=STD_ON from Resource files. Note: This parameter is editable only if CanGeneral/CanEnableDualClockMode is set to "true".
          integer CanControllerBaudRate: 0..2000, post-build-variant-value=true, set at pre-compile in variant pre-compile / post-build in variant post-build, default-value=20  # CAN005_Conf. Specifies the buadrate of the controller in kbps. CAN maximum speed is 1Mbps.
          integer CanControllerSyncSeg: 1..1, origin=NXP, set at pre-compile in variant pre-compile / post-build in variant post-build, default-value=1  # The Synchronization Segment or SYNC_SEG time interval is used to synchronize all the nodes across the network. The SYNC_SEG time interval has a fixed period of one Time Quantum (TQ).
          integer CanControllerPropSeg: 0..255, post-build-variant-value=true, set at pre-compile in variant pre-compile / post-build in variant post-build, default-value=5  # CAN073_Conf. It is used to compensate the physical delay within the CAN network (CTRL[PROPSEG] - 0..7).
          integer CanControllerSeg1: 0..255, post-build-variant-value=true, set at pre-compile in variant pre-compile / post-build in variant post-build, default-value=5  # CAN074_Conf. Specifies the Phase Segment 1 in time quantas (CTRL[PSEG1] = 0..7). CanControllerSeg1 = (PSEG1 + 1) * Tq . The CanControllerSeg1 valid values are 1-8 Tq.
          integer CanControllerSeg2: 0..255, post-build-variant-value=true, set at pre-compile in variant pre-compile / post-build in variant post-build, default-value=6  # Specifies the Phase Segment 1 in time quantas (CTRL[PSEG2] = 1..7). CanControllerSeg2 = (PSEG2 + 1) * Tq . The CanControllerSeg2 valid values are 2-8 Tq.
          integer CanControllerSyncJumpWidth: 0..255, post-build-variant-value=true, set at pre-compile in variant pre-compile / post-build in variant post-build, default-value=1  # NoteImplementation specific Parameter. Not AutoSar required.
          container CanControllerFdBaudrateConfig [0..1]: multiplicity set at pre-compile  # This optional container contains bit timing related configuration parameters of the CAN controller(s) for payload and CRC of a CAN FD frame. If this container exists the controller supports CAN FD frames.
            integer CanControllerFDPrescaller: 0..4294967295, origin=NXP, post-build-variant-value=true, set at pre-compile in variant pre-compile / post-build in variant post-build, default-value=100  # Specifies the prescaller for the controller in FD mode . The calculation of the resulting CanControllerTimeQuanta value depending on module clocking and prescaller shall be done offline. Prescaler = FreqCanClk / FreqTq; FreqTq = 1 / CanControllerTimeQuanta .
            integer CanControllerFdBaudRate: 0..8000, post-build-variant-value=true, set at pre-compile in variant pre-compile / post-build in variant post-build, default-value=0  # ECUC_Can_00481.Specifies the data segment baud rate of the controller in kbps.
            integer CanControllerFdSyncSeg: 1..1, origin=NXP, set at pre-compile in variant pre-compile / post-build in variant post-build, default-value=1  # The Synchronization Segment or SYNC_SEG time interval is used to synchronize all the nodes across the network. The SYNC_SEG time interval has a fixed period of one Time Quantum (TQ).
            integer CanControllerPropSeg: 0..255, post-build-variant-value=true, set at pre-compile in variant pre-compile / post-build in variant post-build, default-value=1  # ECUC_Can_00476.Specifies propagation delay in time quantas.
            integer CanControllerSeg1: 0..255, post-build-variant-value=true, set at pre-compile in variant pre-compile / post-build in variant post-build, default-value=1  # ECUC_Can_00477.Specifies phase segment 1 in time quantas.
            integer CanControllerSeg2: 0..255, post-build-variant-value=true, set at pre-compile in variant pre-compile / post-build in variant post-build, default-value=1  # ECUC_Can_00478.Specifies phase segment 2 in time quantas.
            integer CanControllerSyncJumpWidth: 0..255, post-build-variant-value=true, set at pre-compile in variant pre-compile / post-build in variant post-build, default-value=1  # ECUC_Can_00479.Specifies the synchronization jump width for the controller in time quantas.
            integer CanControllerTrcvDelayCompensationOffset [0..1]: 0..400, multiplicity set at pre-compile in variant pre-compile / post-build in variant post-build, post-build-variant-value=true, set at pre-compile in variant pre-compile / post-build in variant post-build, default-value=0  # ECUC_Can_00480.Specifies the Transceiver Delay Compensation Offset in ns. If not specified Transceiver Delay Compensation is disabled.
            boolean CanControllerTxBitRateSwitch: post-build-variant-value=true, set at post-build in variant post-build / pre-compile in variant pre-compile, default-value=true  # Specifies if the bit rate switching shall be used for transmissions.
            boolean CanControllerFdIsoCANFD: origin=NXP, set at post-build in variant post-build / pre-compile in variant pre-compile, default-value=true  # Add support for selecting ISO or non ISO for CAN FD feature.
            boolean CanControllerFdPrExcEn: origin=NXP, post-build-variant-value=true, set at post-build in variant post-build / pre-compile in variant pre-compile, default-value=false  # This bit enables the Protocol Exception feature.
            boolean CanControllerFdEdgeFilterDis: origin=NXP, post-build-variant-value=true, set at post-build in variant post-build / pre-compile in variant pre-compile, default-value=false  # This bit disables the Edge Filter.
          container CanControllerCBT  # This container contains CBT values
            boolean CanControllerCbtEnable: origin=NXP, post-build-variant-value=true, set at pre-compile in variant pre-compile / post-build in variant post-build, default-value=false  # Can CBT enable
            integer CanControllerCbtPrescaller: 0..4294967295, origin=NXP, post-build-variant-value=true, set at pre-compile in variant pre-compile / post-build in variant post-build, default-value=100  # Specifies the prescaller for the controller in Cbt mode . The calculation of the resulting CanControllerTimeQuanta value depending on module clocking and prescaller shall be done offline. Prescaler = FreqCanClk / FreqTq; FreqTq = 1 / CanControllerTimeQuanta .
            integer CanControllerCbtBaudRate: 0..4294967295, origin=NXP, post-build-variant-value=true, set at pre-compile in variant pre-compile / post-build in variant post-build, default-value=0  # ECUC_Can_00481.Specifies the data segment baud rate of the controller in kbps.
            integer CanControllerCbtSyncSeg: 1..1, origin=NXP, set at pre-compile in variant pre-compile / post-build in variant post-build, default-value=1  # The Synchronization Segment or SYNC_SEG time interval is used to synchronize all the nodes across the network. The SYNC_SEG time interval has a fixed period of one Time Quantum (TQ).
            integer CanControllerCbtPropSeg: 0..255, origin=NXP, post-build-variant-value=true, set at pre-compile in variant pre-compile / post-build in variant post-build, default-value=1  # ECUC_Can_00476.Specifies propagation delay in time quantas.
            integer CanControllerCbtSeg1: 0..255, origin=NXP, post-build-variant-value=true, set at pre-compile in variant pre-compile / post-build in variant post-build, default-value=1  # ECUC_Can_00477.Specifies phase segment 1 in time quantas.
            integer CanControllerCbtSeg2: 0..255, origin=NXP, post-build-variant-value=true, set at pre-compile in variant pre-compile / post-build in variant post-build, default-value=1  # ECUC_Can_00478.Specifies phase segment 2 in time quantas.
            integer CanControllerSyncJumpWidthCbt: 0..255, origin=NXP, post-build-variant-value=true, set at pre-compile in variant pre-compile / post-build in variant post-build, default-value=1  # ECUC_Can_00479.Specifies the synchronization jump width for the controller in time quantas.
        container CanRAMBlock [0..*]: multiplicity set at pre-compile  # This container contains the configuration (parameters) of RAM Message Buffer Data Size.
          enumeration CanRAMBlockName: {CAN_RAM_BLOCK_0, CAN_RAM_BLOCK_1, CAN_RAM_BLOCK_2}, origin=NXP, set at pre-compile in variant pre-compile / post-build in variant post-build, default-value=CAN_RAM_BLOCK_0  # The name of RAM block .
          enumeration CanRAMBlockSizeValue: {CAN_8_BYTES_PAYLOAD, CAN_16_BYTES_PAYLOAD, CAN_32_BYTES_PAYLOAD, CAN_64_BYTES_PAYLOAD}, origin=NXP, set at pre-compile in variant pre-compile / post-build in variant post-build, default-value=CAN_8_BYTES_PAYLOAD  # Specify Message Buffer Data Size for each RAM block
        container CanRxFifo  # This container contains the configuration (parameters) of the CAN RX FIFO. NoteThis container is ENABLED only when CanControllerRxFifoEnable is TRUE.
          enumeration CanControllerIDAcceptanceMode: {A, B, C, D}, origin=NXP, set at pre-compile in variant pre-compile / post-build in variant post-build, default-value=A  # This 2-bit field identifies the format of the elements of the Rx FIFO filter table. NoteImplementation Specific parameter. Format Explanation A : One full ID (standard or extended) per filter element. B : Two full standard IDs or two partial 14-bit extended IDs per filter element. C : Four partial 8-bit IDs (standard or extended) per filter element. D : All frames rejected. Note: The TableID and Filter Mask values don't care for this option.
          enumeration CanRxFifoFiltersNumber: {FILTERS_NUMBER_8, FILTERS_NUMBER_16, FILTERS_NUMBER_24, FILTERS_NUMBER_32, FILTERS_NUMBER_40, FILTERS_NUMBER_48, FILTERS_NUMBER_56, FILTERS_NUMBER_64, FILTERS_NUMBER_72, FILTERS_NUMBER_80, FILTERS_NUMBER_88, FILTERS_NUMBER_96, FILTERS_NUMBER_104, FILTERS_NUMBER_112, FILTERS_NUMBER_120, FILTERS_NUMBER_128}, origin=NXP, set at pre-compile in variant pre-compile / post-build in variant post-build, default-value=FILTERS_NUMBER_8  # This field defines the number of Rx FIFO filters. NoteImplementation Specific parameter. Values Explanation Number of Rx FIFO filters Rx FIFO ID Filter Table Elements Affected by Rx Individual Masks Rx FIFO ID Filter Table Elements Affected by Rx FIFO Global Mask FILTERS_NUMBER_8 Elements 0-7 none FILTERS_NUMBER_16 Elements 0-9 Elements 10-15 FILTERS_NUMBER_24 Elements 0-11 Elements 12-23 FILTERS_NUMBER_32 Elements 0-13 Elements 14-31 FILTERS_NUMBER_40 Elements 0-15 Elements 16-39 FILTERS_NUMBER_48 Elements 0-17 Elements 18-47 FILTERS_NUMBER_56 Elements 0-19 Elements 20-55 FILTERS_NUMBER_64 Elements 0-21 Elements 22-63 FILTERS_NUMBER_72 Elements 0-23 Elements 24-71 FILTERS_NUMBER_80 Elements 0-25 Elements 26-79 FILTERS_NUMBER_88 Elements 0-27 Elements 28-87 FILTERS_NUMBER_96 Elements 0-29 Elements 30-95 FILTERS_NUMBER_104 Elements 0-31 Elements 32-103 FILTERS_NUMBER_112 Elements 0-31 Elements 32-111 FILTERS_NUMBER_120 Elements 0-31 Elements 32-119 FILTERS_NUMBER_128 Elements 0-31 Elements 32-127
          integer CanRxFifoGlobalMaskValue: 0..4294967295, origin=NXP, set at pre-compile in variant pre-compile / post-build in variant post-build, default-value=2047  # Specifies Rx Fifo Global Filter Mask value to be used as acceptance criteria for the Rx Fifo filter IDs which are not covered by individual masks. NoteImplementation Specific parameter. Value for this parameter should be entered based on the CanControllerIDAcceptanceMode selected as explained below. A : Filtermask value for One full standard or Extended ID based on the CanTableIDType selected. B : Filtermask value for CanIDValue0(bit field : 0-11 for standard ID type and 0-14 for extended ID type) and CanIDValue1 (bit field : 12-22 for standard ID type and 15-28 for extended ID type). C : Filtermask value for CanIDValue0(bit field : 0-8), CanIDValue1(bit field : 9-16), CanIDValue2(bit field : 17-24) and CanIDValue3(bit field : 25-32). It shall be distinguished between: - Standard identifier mask - Extended identifier mask 0 - the corresponding bit in the filter is "don't care". 1 - the corresponding bit in the filter is used during the matching process.
          container CanRxFifoTable [0..*]: multiplicity set at pre-compile  # This container contains a multiple entry ID table information required to configure RX FIFO. The number of entries shall be equal to the number of RxFifo filters configured using CanRxFifoFiltersNumber parameter. NoteThis container is ENABLED only when CanControllerRxFifoEnable is TRUE. Explanation regarding the individual mask usage Number of Rx FIFO filters Rx FIFO ID Filter Table Elements Affected by Rx Individual Masks Rx FIFO ID Filter Table Elements Affected by Rx FIFO Global Mask FILTERS_NUMBER_8 Elements 0-7 none FILTERS_NUMBER_16 Elements 0-9 Elements 10-15 FILTERS_NUMBER_24 Elements 0-11 Elements 12-23 FILTERS_NUMBER_32 Elements 0-13 Elements 14-31 FILTERS_NUMBER_40 Elements 0-15 Elements 16-39 FILTERS_NUMBER_48 Elements 0-17 Elements 18-47 FILTERS_NUMBER_56 Elements 0-19 Elements 20-55 FILTERS_NUMBER_64 Elements 0-21 Elements 22-63 FILTERS_NUMBER_72 Elements 0-23 Elements 24-71 FILTERS_NUMBER_80 Elements 0-25 Elements 26-79 FILTERS_NUMBER_88 Elements 0-27 Elements 28-87 FILTERS_NUMBER_96 Elements 0-29 Elements 30-95 FILTERS_NUMBER_104 Elements 0-31 Elements 32-103 FILTERS_NUMBER_112 Elements 0-31 Elements 32-111 FILTERS_NUMBER_120 Elements 0-31 Elements 32-119 FILTERS_NUMBER_128 Elements 0-31 Elements 32-127
            integer CanIDValue0: 0..536870911, origin=NXP, set at pre-compile in variant pre-compile / post-build in variant post-build, default-value=255  # Specifies an ID to be used as acceptance criteria for the ID Table 0. NoteImplementation Specific parameter. Value for this parameter should be enterd based on the CanControllerIDAcceptanceMode selected as explained below. A : One full ID (standard or extended) per filter element. B : One full standard ID if the CanTableIDType is Standard or one 14 most significant bit value of Extended ID if the CanTableIDType is Extended. C : One 8 most significant bit value of Standard or Extended ID.
            integer CanIDValue1: 0..536870911, origin=NXP, set at pre-compile in variant pre-compile / post-build in variant post-build, default-value=255  # Specifies an ID to be used as acceptance criteria for the ID Table. NoteImplementation Specific parameter. Value for this parameter should be enterd based on the CanControllerIDAcceptanceMode selected as explained below. B : One full standard ID if the CanTableIDType is Standard or one 14 most significant bit value of Extended ID if the CanTableIDType is Extended. C : One 8 most significant bit value of Standard or Extended ID.
            integer CanIDValue2: 0..536870911, origin=NXP, set at pre-compile in variant pre-compile / post-build in variant post-build, default-value=255  # Specifies an ID to be used as acceptance criteria for the ID Table. NoteImplementation Specific parameter. Value for this parameter should be enterd based on the CanControllerIDAcceptanceMode selected as explained below. C : One 8 most significant bit value of Standard or Extended ID.
            integer CanIDValue3: 0..536870911, origin=NXP, set at pre-compile in variant pre-compile / post-build in variant post-build, default-value=255  # Specifies an ID to be used as acceptance criteria for the ID Table. NoteImplementation Specific parameter. Value for this parameter should be enterd based on the CanControllerIDAcceptanceMode selected as explained below. C : One 8 most significant bit value of Standard or Extended ID.
            enumeration CanTableIDType: {Standard, Extended}, origin=NXP, set at pre-compile in variant pre-compile / post-build in variant post-build, default-value=Standard  # Specifies whether extended or standard frames are accepted into the FIFO. NoteImplementation Specific parameter.
            integer CanMBFilterMaskValue: 0..4294967295, origin=NXP, set at pre-compile in variant pre-compile / post-build in variant post-build, default-value=2047  # Specifies Filetr Mask value to be used as acceptance criteria for the ID Table. NoteImplementation Specific parameter. Value for this parameter should be entered based on the CanControllerIDAcceptanceMode selected as explained below. A : Filtermask value for One full standard or Extended ID based on the CanTableIDType selected. B : Filtermask value for CanIDValue0(bit field : 0-11 for standard ID type and 0-14 for extended ID type) and CanIDValue1 (bit field : 12-22 for standard ID type and 15-28 for extended ID type). C : Filtermask value for CanIDValue0(bit field : 0-8), CanIDValue1(bit field : 9-16), CanIDValue2(bit field : 17-24) and CanIDValue3(bit field : 25-32).
        container CanTTController [0..1]: multiplicity set at pre-compile  # This container is only included and valid if TTCAN SWS is used and TTCAN is enabled.
          integer CanTTControllerApplWatchdogLimit: 0..255, scope=ECU, set at post-build in variant post-build / pre-compile in variant pre-compile, default-value=0  # Defines the maximum time period (unit is 256 times NTU) after which the application has to serve the watchdog.
          integer CanTTControllerCycleCountMax: 0..63, scope=ECU, set at post-build in variant post-build / pre-compile in variant pre-compile, default-value=0  # Defines the value for cycle_count_max.
          integer CanTTControllerExpectedTxTrigger: 0..255, set at post-build in variant post-build / pre-compile in variant pre-compile, default-value=0  # Number of expected_tx_trigger.
          boolean CanTTControllerExternalClockSynchronisation: scope=ECU, set at post-build in variant post-build / pre-compile in variant pre-compile, default-value=false  # Enables/disables the external clock synchronization.
          boolean CanTTControllerGlobalTimeFiltering: set at post-build in variant post-build / pre-compile in variant pre-compile, default-value=false  # Enables/disables the global time filtering.
          integer CanTTControllerInitialRefOffset: 0..127, scope=ECU, set at post-build in variant post-build / pre-compile in variant pre-compile, default-value=0  # Defines the initial value for ref trigger offset.
          integer CanTTControllerInterruptEnable: 0..1023, set at post-build in variant post-build / pre-compile in variant pre-compile, default-value=0  # Enables/disables the respective interrupts.
          boolean CanTTControllerLevel2: set at post-build in variant post-build / pre-compile in variant pre-compile, default-value=false  # Defines whether Level 2 or Level 1 is used.
          float CanTTControllerNTUConfig: 0.0..100.0, scope=ECU, set at post-build in variant post-build / pre-compile in variant pre-compile, default-value=0.0  # Defines the config value for NTU (network time unit).
          enumeration CanTTControllerOperationMode: {CAN_TT_EVENT_SYNC_TIME_TRIGGERED, CAN_TT_EVENT_TRIGGERED, CAN_TT_TIME_TRIGGERED}, scope=ECU, set at post-build in variant post-build / pre-compile in variant pre-compile, default-value=CAN_TT_EVENT_SYNC_TIME_TRIGGERED  # Defines the operation mode.
          float CanTTControllerSyncDeviation: 0.0..100.0, set at post-build in variant post-build / pre-compile in variant pre-compile, default-value=0.0  # Defines the maximum synchronization deviation:
          boolean CanTTControllerTURRestore: set at post-build in variant post-build / pre-compile in variant pre-compile, default-value=false  # Enables/disables the TUR restore.
          boolean CanTTControllerTimeMaster: scope=ECU, set at post-build in variant post-build / pre-compile in variant pre-compile, default-value=false  # Defines whether the controller acts as a potential time master.
          integer CanTTControllerTimeMasterPriority: 0..7, scope=ECU, set at post-build in variant post-build / pre-compile in variant pre-compile, default-value=0  # Defines the time master priority.
          integer CanTTControllerTxEnableWindowLength: 1..16, scope=ECU, set at post-build in variant post-build / pre-compile in variant pre-compile, default-value=1  # Length of the tx enable window given in CAN bit times.
          integer CanTTControllerWatchTriggerGapTimeMark: 0..65535, set at post-build in variant post-build / pre-compile in variant pre-compile, default-value=0  # watch trigger time mark after a gap
          integer CanTTControllerWatchTriggerTimeMark: 0..65535, set at post-build in variant post-build / pre-compile in variant pre-compile, default-value=0  # watch trigger time mark
          enumeration CanTTIRQProcessing: {INTERRUPT, POLLING}, scope=ECU, set at post-build in variant post-build / pre-compile in variant pre-compile, default-value=POLLING  # Enables / disables API Can_MainFunction_BusOff() for handling busoff events in POLLING mode.
      container CanHardwareObject [1..*]: multiplicity set at pre-compile  # SWS 324. This container contains the configuration (parameters) of CAN Hardware Objects. This configuration element is used as information for the CAN Interface only. The relevant CAN driver configuration is done with the filter mask and identifier.
        integer CanFdPaddingValue [0..1]: 0..255, scope=ECU, multiplicity set at pre-compile in variant pre-compile / post-build in variant post-build, post-build-variant-value=true, set at pre-compile in variant pre-compile / post-build in variant post-build, default-value=0  # MBCS[PRIO]: This value it is the padding value when FD it is used.
        enumeration CanHandleType: {BASIC, FULL}, scope=ECU, post-build-variant-value=true, set at pre-compile in variant pre-compile / post-build in variant post-build, default-value=BASIC  # CAN323_Conf. Specifies the type (Full-CAN or Basic-CAN) of a hardware object. NoteAll controllers which the Fifo is enabled shall define at least 1 RECEIVE hardware object. First RECEIVE hardware object defined for a controller which have the Fifo enabled is configured by CONVENTION to receive data from Fifo.
        enumeration CanIdType: {EXTENDED, MIXED, STANDARD}, post-build-variant-value=true, set at pre-compile in variant pre-compile / post-build in variant post-build, default-value=STANDARD  # CAN065_Conf. Specifies whether the IdValue is of type - standard identifier (ID - 11 bits length) - extended identifier (ID - 29 bits length) - mixed mode (standard or extended) NoteMBs configred as MIXED standard and RECEIVE type will be treated as EXTENDED.
        integer CanMBPrio: 0..7, origin=NXP, post-build-variant-value=true, set at pre-compile in variant pre-compile / post-build in variant post-build, default-value=0  # MBCS[PRIO]: Local priority. This 3-bit field is used when MCR[LPRIO_EN] is set and makes sense only for TX buffers. If CTRL[LBUF] is set this field is not used. These bits are not transmitted. They are appended to the regular ID to define the transmission priority. NoteImplementation specific Parameter. Not AutoSar Required.
        integer CanObjectId: 0..65535, scope=ECU, post-build-variant-value=true, set at pre-compile in variant pre-compile / post-build in variant post-build, symbolic-name-value=true, default-value=0  # CAN326_Conf. Holds the handle ID of HRH or HTH. The value of this parameter is unique in a given CAN Driver, and it should start with 0 and continue without any gaps. The HRH and HTH Ids are defined under two different name-spaces. Example: HRH0-0, HRH1-1, HTH0-2, HTH1-3
        enumeration CanObjectType: {RECEIVE, TRANSMIT}, scope=ECU, post-build-variant-value=true, set at pre-compile in variant pre-compile / post-build in variant post-build, default-value=RECEIVE  # CAN327_Conf. Specifies if the HardwareObject is used as Transmit or as Receive object. NoteMBs configred as MIXED standard and RECEIVE type will be treated as EXTENDED.
        boolean CanTriggerTransmitEnable [0..1]: scope=ECU, multiplicity set at pre-compile, set at pre-compile, default-value=false  # This parameter defines if or if not Can supports the trigger-transmit API for this handle.
        integer CanHwObjectCount: 1..65535, post-build-variant-value=true, set at pre-compile in variant pre-compile / post-build in variant post-build, default-value=1  # Number of hardware objects used to implement one HOH. In case of a HRH this parameter defines the number of elements in the hardware FIFO or the number of shadow buffers, in case of a HTH it defines the number of hardware objects used for multiplexed transmission or for a hardware FIFO used by a FullCAN HTH
        reference CanControllerRef: post-build-variant-value=true, set at pre-compile in variant pre-compile / post-build in variant post-build, destination=CanController  # CAN322_Conf. Reference to CAN Controller to which the HOH is associated to.
        reference CanMainFunctionRWPeriodRef [0..1]: multiplicity set at pre-compile in variant pre-compile / post-build in variant post-build, post-build-variant-value=true, set at pre-compile in variant pre-compile / post-build in variant post-build, destination=CanMainFunctionRWPeriods  # CAN438_Conf.Reference to CAN Controller to which the HOH is associated to.
        reference CanRAMBlockRef [0..1]: multiplicity set at pre-compile in variant pre-compile / post-build in variant post-build, origin=NXP, post-build-variant-value=true, set at pre-compile in variant pre-compile / post-build in variant post-build, destination=CanRAMBlock  # Select RAM block.
        container CanHwFilter [0..1]: multiplicity set at pre-compile  # ECUC_Can_00468 : This container is only valid for HRHs and contains the configuration (parameters) of one hardware filter.
          integer CanHwFilterCode: 0..4294967295, post-build-variant-value=true, set at pre-compile in variant pre-compile / post-build in variant post-build, default-value=0  # CAN325_Conf. Specifies (together with the filter mask)- the identifiers range that passes the hardware filter for of RX objects. Parameter ranges from 0 to 0x7FF (11 bits) for Standard IDs and 0 to 0x1FFFFFFF (29 bits) for Extended IDs. User can assign any code to this parameter, but must to respect the above rule related to Standard/Extended IDs.
          integer CanHwFilterMask: 0..4294967295, post-build-variant-value=true, set at pre-compile in variant pre-compile / post-build in variant post-build, default-value=0  # ECUC_Can_00469 : Specifies (together with the filter mask) the identifiers range that passes the hardware filter. EN: Different CanHardwareObjects with different CanIdTypes (STANDARD, MIXED, EXTENDED) can share the same CanFilterMask (i.e., the CanFilterMaskRef parameters of these CanHardwareObjects reference the very same CanFilterMask container). This shall be allowed and must be supported by the configuration generators. The CanFilterMaskRef is omitted for 1) CanHardwareObjects with CanObjectType set to TRANSMIT 2) CanHardwareObjects with CanObjectType set to RECEIVE if only a single Can ID shall be received via this CanHardwareObjects(i.e. exact match with CanIdValue requested when CanHandleType is configured as FULL) CAN321_Conf. Reference to the filter mask that is used for hardware filtering together with the CAN_ID_VALUE. This value is used as acceptance masks for ID filtering in RX MBs and the FIFO.
        container CanTTHardwareObjectTrigger [0..*]: multiplicity set at pre-compile  # This container is only included and valid if TTCAN SWS is used and TTCAN is enabled.
          integer CanTTHardwareObjectBaseCycle: 0..63, scope=ECU, set at post-build in variant post-build / pre-compile in variant pre-compile, default-value=0  # Defines the cycle_offset.
          integer CanTTHardwareObjectCycleRepetition: 1..64, scope=ECU, set at post-build in variant post-build / pre-compile in variant pre-compile, default-value=1  # Defines the repeat_factor.
          integer CanTTHardwareObjectTimeMark: 0..65535, set at post-build in variant post-build / pre-compile in variant pre-compile, default-value=0  # Defines the point in time, when the trigger will be activated.
          integer CanTTHardwareObjectTriggerId: 0..63, set at post-build in variant post-build / pre-compile in variant pre-compile, symbolic-name-value=true, default-value=0  # Sequential number which allows separation of different TTCAN triggers configured for one and the same hardware object.
          enumeration CanTTHardwareObjectTriggerType: {CAN_TT_RX_TRIGGER, CAN_TT_TX_REF_TRIGGER, CAN_TT_TX_REF_TRIGGER_GAP, CAN_TT_TX_TRIGGER_EXCLUSIVE, CAN_TT_TX_TRIGGER_MERGED, CAN_TT_TX_TRIGGER_SINGLE}, set at post-build in variant post-build / pre-compile in variant pre-compile, default-value=CAN_TT_RX_TRIGGER  # Defines the type of the trigger associated with the hardware object. This parameter depends on plain CAN parameter CAN_OBJECT_TYPE.
      container CanIcom [0..1]: multiplicity set at pre-compile  # This container contains the parameters for configuring pretended networking
        container CanIcomConfig [1..256]: multiplicity set at pre-compile  # This container contains the general configuration parameters of the ICOM Configuration
          integer CanIcomConfigId: 1..255, set at pre-compile, default-value=1  # This parameter identifies the ID of the ICOM configuration. In order prevent the issue when have multiple confioguration for ICom, Please configure the ConfigID follow the order.
          boolean CanIcomWakeOnBusOff: scope=ECU, set at pre-compile, default-value=false  # This parameter defines that the MCU shall wake if the bus off is detected or not.
          container CanIcomWakeupCauses  # This container contains the configuration parameters of the wakeup causes to leave the power saving mode.
            container CanIcomRxMessage [1..*]: multiplicity set at pre-compile  # This container contains the configuration parameters for the wakeup causes for matching received messages. It has to be configured as often as received messages are defined as wakeup cause. constraint: For all CanIcomRxMessage instances the Message IDs which are defined in CanIcomMessageId and in CanIcomRxMessageIdMask shall not overlap.
              integer CanIcomCounterValue [0..1]: 1..255, scope=ECU, multiplicity set at pre-compile, set at pre-compile, default-value=1  # This parameter defines that the MCU shall wake if the message with the ID is received n times on the communication channel. NOTE: The ASR421 require 16 bit for this field, but hardware only support 8 bit for this feild. So the limitation value of this feild is 256.
              integer CanIcomMessageId: 0..536870912, scope=ECU, set at pre-compile, default-value=0  # This parameter defines the message ID the wakeup causes of this CanIcomRxMessage are configured for. In addition a mask (CanIcomMessageIdMask) can be defined, in that case it is possible to define a range of rx messages, which can create a wakeup condition.
              enumeration CanIcomIdOperation: {EXACTLY, GREATER_MINNUM, SMALLER_MAXNUM, INSIDE_RANGE}, origin=NXP, set at pre-compile, default-value=EXACTLY  # This is a non-autosar parameter. It is generated in order support for selection the ID filter type. The Platlorm support 4 option in order ID filter wake-up message: EXACTLY SMALLER GREATER INSIDE_RANGE
              integer CanIcomMessageIdMask [0..1]: 0..536870912, scope=ECU, multiplicity set at pre-compile, set at pre-compile, default-value=0  # Describes a mask for filtering of CAN identifiers. The CAN identifiers of incoming messages are masked with this CanIcomMessageIdMask. If the masked identifier matches the masked value of CanIcomMessageId, it can create a wakeup condition for this CanIcomRxMessage. Bits holding a 0 mean don't care, i.e. do not compare the message's identifier in the respective bit position. The mask shall be build by filling with leading 0.
              float CanIcomMissingMessageTimerValue [0..1]: 0.0..65535.0, scope=ECU, multiplicity set at pre-compile, set at pre-compile, default-value=0  # This parameter defines that the MCU shall wake if the message with the ID is not received for a specific time in s on the communication channel. NOTE: The '0' value have the meaning that the wake-up by timer disable, When you want to disable the wake-up by timer, you should disable this object. The ASR421 don't require about the limitation value for this field, but the hardware only support 16 bit for this field, so this field has the 0-65535 range as the limitation range. The internal timer is incremented based on periodic time ticks, which period is 64 times the CAN Bit Time unit.
              boolean CanIcomPayloadLengthError: scope=ECU, set at pre-compile, default-value=false  # This parameter defines that the MCU shall wake if a payload error occurs
              boolean CanPayloadFilter: scope=ECU, origin=NXP, set at pre-compile, default-value=false  # This parameter defines enable filter payload of messages in Pretended Networking or not
              container CanIcomRxMessageSignalConfig [0..*]: multiplicity set at pre-compile  # This container contains the configuration parameters for the wakeup causes for matching signals. It has to be configured as often as a signal is defined as wakeup cause. If at least one Signal conditions defined in a CanIcomRxMessageSignalConfig evaluates to true or if no CanIcomRxMessageSignalConfig are defined, the whole wakeup condition is considered to be true. All instances of this container refer to the same frame/pdu (see CanIcomMessageId).
                integer CanIcomSignalMask: 0..18446744073709551615, set at pre-compile, default-value=0  # This parameter shall be used to mask a signal in the payload of a CAN message. The mask is binary AND with the signal payload. The result will be used in combination of the operations defined in CanIcomSignalOperation with the CanIcomSignalValue. the ASR request for full 64 bit with Integers type. but in the Tresos tool, the Integers only has 63 bit, So in the fact, the greatest value is 0x7fffffffffffffff.
                enumeration CanIcomSignalOperation: {AND, EQUAL, GREATER, SMALLER, XOR}, scope=ECU, set at pre-compile, default-value=EQUAL  # This parameter defines the operation, which shall be used to verify the signal value creates a wakeup condition. The Calypso platform don't support the "AND" filter type.
                integer CanIcomSignalValue: 0..18446744073709551615, set at pre-compile, default-value=0  # This parameter shall be used to define a signal value which shall be compared (CanIcomSignalOperation) with the masked CanIcomSignalMask value of the received signal (CanIcomSignalRef).
                integer DLCLowValue: 0..8, origin=NXP, set at pre-compile in variant pre-compile / post-build in variant post-build, default-value=0  # This is a non-autosar object. It is used to confgure the lowest value for the "CAN_FLT_DLC" register. That value is number data byte lowest of messages wake-up.
                integer DLCHighValue: 0..8, origin=NXP, set at pre-compile in variant pre-compile / post-build in variant post-build, default-value=0  # This is a non-autosar object. It is used to confgure the highest value for the "CAN_FLT_DLC" register. That value is number data byte highest of messages wake-up.
                reference CanIcomSignalRef [0..1]: scope=ECU, multiplicity set at pre-compile, set at pre-compile, destination=ComSignal  # This parameter defines a reference to the signal which shall be checked additional to the message id (CanIcomMessageId). This reference is used for documentation to define which ComSignal originates this filter setting. All signals being referred by this reference shall point to the same PDU.
    container CanGeneral  # This container holds the parameters related each CAN Driver Unit.
      boolean CanChangeBaudrateApi: origin=NXP, set at pre-compile, default-value=true  # CAN436_Conf. The support of the Can_ChangeBaudrate API is optional. If this parameter is set to true the Can_ChangeBaudrate and Can_CheckBaudrate API shall be supported. Otherwise the API is not supported.
      boolean CanDevErrorDetection: set at pre-compile, default-value=true  # CAN064_Conf: Switches the Development Error Detection and Notification: ON or OFF. When this option is OFF code size is reduced, but no error detection is available.
      boolean CanEnableUserModeSupport: origin=NXP, set at pre-compile, default-value=false  # When this parameter is enabled, the CAN module will adapt to run from User Mode, with the following measures: (if applicable) a) configuring REG_PROT for the Can Controllers so that the registers under protection can be accessed from user mode by setting UAA bit in REG_PROT_GCR to 1 (if applicable) b) using 'call trusted function' stubs for all internal function calls that access registers requiring supervisor mode. (if applicable) c) other module specific measures for more information, please see chapter 5.7 User Mode Support in IM
      boolean CanVersionInfoApi: set at pre-compile, default-value=true  # CAN106_Conf. Switches the Can_GetVersionInfo() API: ON or OFF. When this option is ON driver supports API for getting Version information for the Driver.
      integer CanIndex: 0..255, set at pre-compile, default-value=0  # CAN320_Conf. Specifies the InstanceId of this module instance. If only one instance is present it shall have the Id 0.
      float CanMainFunctionBusoffPeriod [0..1]: 0.001..65.535, multiplicity set at pre-compile, set at pre-compile, default-value=0.001  # CAN355_Conf. This parameter describes the period for cyclic call to Can_MainFunction_Busoff. Unit is seconds.
      float CanMainFunctionWakeupPeriod [0..1]: 0.001..65.535, multiplicity set at pre-compile, set at pre-compile, default-value=0.0010  # CAN357_Conf. This parameter describes the period for cyclic call to Can_MainFunction_Wakeup. Unit is seconds. This field is editable if CanConfigSet/CanController/CanWakeupSupport is 'true'.
      float CanMainFunctionModePeriod: 0.001..65.535, set at pre-compile, default-value=0.001  # CAN376_Conf. This parameter describes the period for cyclic call to Can_MainFunction_Mode. Unit in seconds.
      boolean CanMultiplexedTransmission: scope=ECU, set at pre-compile, default-value=true  # CAN095_Conf. Specifies if Multiplexed Transmission shall be supported: ON or OFF. Multiplex transmission means to search for a free MB, that has the same ObjectId with the one transmitted to Can_Write, if current Hth MB is busy.
      integer CanMaxMessageBuffers: -9223372036854775808..9223372036854775807, origin=NXP, set at pre-compile, default-value=32  # This parameter describes the maximum Message Buffer of CAN Hardware in the whole configured variants. It equals the sum of the MBs for RxFifo (if RxFifo enabled), HRHs (decrease 1 if RxFifo enabled) , HTHs and the additional HTHs that are used for the multi transmission feature.
      float CanTimeoutDuration: 0.001..65.535, set at pre-compile, default-value=0.1  # CAN113_Conf. Specifies the maximum time for blocking function until a timeout is detected. Unit in loops. This Timeout is used to detect the Hardware Errors/ Production Errors. When Hardware registers like Controller Register (CTRL) or Module Control Register(MCR) are configured, the Hardware take some time to take effect of these new settings CANuested. Once timeout has been occured and if hardware could not take effect of the CANu settings, then Error is reported. So this timeout is used to allow hardware to take effect of the Hardware settings.
      function name CanLPduReceiveCalloutFunction [0..1]: multiplicity set at pre-compile, set at pre-compile, default-value=NULL_PTR  # CAN434_Conf:This parameter defines the existence and the name of a callout function that is called after a successful reception of a received CAN Rx L-PDU. If this parameter is omitted no callout shall take place.
      boolean CanAllowLoopAsCycle: origin=NXP, set at pre-compile, default-value=false  # TBC
      integer CanNumberOfTimeOutLoop: 1..65535, origin=NXP, set at pre-compile, default-value=1  # TBD
      boolean CanCodeSizeOptimization: origin=NXP, set at pre-compile, default-value=false  # Enables optimization of INTERRUPT Service Routines for code size. NoteImplementation specific Parameter. Not AutoSar Required.
      boolean CanExtendedIDSupport: origin=NXP, set at pre-compile, default-value=true  # Enables support of Extended/Mixed mode (permit to use IDs of 29 bits length). NoteImplementation specific Parameter. Not AutoSar Required.
      boolean CanMBCountExtensionSupport: origin=NXP, set at pre-compile, default-value=true  # Enables support of more than 255 Can Hardware Objects. Some platforms have a bigger number of Can controllers and the sum of total MBS for all controllers is bigger than uint8 size (as HTH/HRH is specified in Autosar). This option should not be enabled for platforms that have a number of MBs smaller than 256 (summing all Can controllers from the platform). NoteImplementation Specific parameter.
      boolean CanApiEnableMbAbort: origin=NXP, set at pre-compile, default-value=false  # Enables an additional API, to write an ABORT code (b1001) to the MBCB filed of the MB to abort a message transmission. Based on this value a define will be generated with STD_ON or STD_OFF value: CAN_API_ENABLE_ABORT_MB. It is editable only if "CanHardwareCancellation" = true.
      boolean CanSetBaudrateApi [0..1]: scope=ECU, multiplicity set at pre-compile, set at pre-compile, default-value=false  # If the parameter is set to true the Can_SetBaudrate Api shall be supported.
      boolean CanAbortOnlyOneMB: origin=NXP, set at pre-compile, default-value=true  # When this parameter is true only one MB will be aborted by Can_AbortMb() When this parameter is false all the associated mailboxes will be aborted when multiplex transmission is enabled Note: This parameter is enabled only if CanMultiplexedTransmission=STD_ON
      boolean CanEnableDualClockMode: origin=NXP, set at pre-compile, default-value=false  # Enables support for dual clock API. When this parameter is true will generate CAN_DUAL_CLOCK_MODE = STD_ON. Note: This parameter is visible only if Can.CanConfig.DualClockMode=STD_ON from Resource files.
      boolean CanSpecifiedRAMBlockSize: origin=NXP, set at pre-compile, default-value=false  # This parameter is used to enable the feature which separately configure Message Buffer Data Size for each RAM block.
      enumeration MBDSR: {CAN_8_BYTES_PAYLOAD, CAN_16_BYTES_PAYLOAD, CAN_32_BYTES_PAYLOAD, CAN_64_BYTES_PAYLOAD}, origin=NXP, set at pre-compile, default-value=CAN_8_BYTES_PAYLOAD  # Selects maximum payload of MB's.
      boolean CanPublicIcomSupport: scope=ECU, set at pre-compile, default-value=false  # Selects support of Pretended Network features in Can driver. True: Enabled False: Disabled
      reference CanOsCounterRef [0..1]: multiplicity set at pre-compile, set at pre-compile, destination=OsCounter  # CAN431_Conf. This parameter contains a reference to the counter, which is used by the CAN driver.
      reference CanSupportTTCANRef: scope=ECU, set at pre-compile, destination=CanIfPrivateCfg  # CAN430_Conf. Reference to CAN Hardware Object which shall be polled with the configured CanMainFunctionWritePeriod. This reference shall only be configurable if more than one period is configured via CanMainFunctionWritePeriod.
      container CanMainFunctionRWPeriods [0..*]: multiplicity set at pre-compile  # ECUC_Can_00437. This container contains the parameter for configuring the period for cyclic call to Can_MainFunction_Read or Can_MainFunction_Write depending on the referring item.
        float CanMainFunctionPeriod: 0.001..65.535, set at pre-compile, default-value=0.001  # ECUC_Can_00484. This parameter describes the period for cyclic call to Can_MainFunction_Read or Can_MainFunction_Write depending on the referring item. Unit is seconds. Different poll-cycles will be configurable if more than one CanMainFunctionPeriod is configured. In this case multiple Can_MainFunction_Read() or Can_MainFunction_Write() will be provided by the CAN Driver module.
      container CanIcomGeneral [0..1]: multiplicity set at pre-compile  # This container contains the general configuration parameters of the ICOM Configuration
        enumeration CanIcomLevel [0..1]: {CAN_ICOM_LEVEL_ONE, CAN_ICOM_LEVEL_TWO}, scope=ECU, multiplicity set at pre-compile, set at pre-compile, default-value=CAN_ICOM_LEVEL_ONE  # Defines the level of Pretended Networking.This parameter is reserved for future implementations (Pretended Networking level 2).
        enumeration CanIcomVariant: {CAN_ICOM_VARIANT_HW, CAN_ICOM_VARIANT_NONE, CAN_ICOM_VARIANT_SW}, scope=ECU, set at pre-compile, default-value=CAN_ICOM_VARIANT_NONE  # Defines the variant, which is supported by this CanController
    container CommonPublishedInformation  # Common container, aggregated by all modules. It contains published information about vendor and versions.
      integer ArReleaseMajorVersion: 4..4, origin=NXP, set at published-information, default-value=4  # Major version number of AUTOSAR specification on which the appropriate implementation is based on.
      integer ArReleaseMinorVersion: 2..2, origin=NXP, set at published-information, default-value=2  # Minor version number of AUTOSAR specification on which the appropriate implementation is based on.
      integer ArReleaseRevisionVersion: 2..2, origin=NXP, set at published-information, default-value=2  # Revision version number of AUTOSAR specification on which the appropriate implementation is based on.
      integer ModuleId: 80..80, origin=NXP, set at published-information, default-value=80  # Module ID of this module from Module List. Note: Implementation Specific Parameter
      integer SwMajorVersion: 1..1, origin=NXP, set at published-information, default-value=1  # Major version number of the vendor specific implementation of the module. The numbering is vendor specific. Note: Implementation Specific Parameter
      integer SwMinorVersion: 0..0, origin=NXP, set at published-information, default-value=0  # Minor version number of the vendor specific implementation of the module. The numbering is vendor specific. Note: Implementation Specific Parameter
      integer SwPatchVersion: 2..2, origin=NXP, set at published-information, default-value=2  # Patch level version number of the vendor specific implementation of the module. The numbering is vendor specific. Note: Implementation Specific Parameter
      string VendorApiInfix: origin=NXP, set at published-information  # In driver modules which can be instantiated several times on a single ECU, BSW00347 requires that the name of APIs is extended by the VendorId and a vendor specific name. This parameter is used to specify the vendor specific name. In total, the Implementation specific name is generated as follows: <ModuleName>_>VendorId>_<VendorApiInfix>. E.g. assuming that the VendorId of the implementor is 123 and the implementer chose a VendorApiInfix of "v11r456" a api name Can_Write defined in the SWS will translate to Can_123_v11r456Write. This parameter is mandatory for all modules with upper multiplicity > 1. It shall not be used for modules with upper multiplicity =1. Note: Implementation Specific Parameter
      integer VendorId: 43..43, origin=NXP, set at published-information, default-value=43  # Vendor ID of the dedicated implementation of this module according to the AUTOSAR vendor list. Note: Implementation Specific Parameter
