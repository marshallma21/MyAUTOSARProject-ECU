AUTOSAR XML (schema 4-3-0)
package /TS_T40D2M10I2R0
  ecuc definition collection Ocu_EcuParameterDefinition: module=Ocu
  module definition Ocu: post-build-variant-support=true, refined-module-def=Ocu, variants post-build/pre-compile  # Configuration of Ocu (Output Compare Unit) module.
    container OcuConfigurationOfOptionalApis  # Configuration of optional APIs.
      boolean OcuDeInitApi: set at pre-compile, default-value=true  # Adds / removes the service Ocu_DeInit() from the code.
      boolean OcuGetCounterApi: set at pre-compile, default-value=true  # Adds / removes the service Ocu_GetCounter() from the code.
      boolean OcuNotificationSupported: set at pre-compile, default-value=true  # Adds / removes the services Ocu_EnableNotification() and Ocu_DisableNotification() from the code.
      boolean OcuSetAbsoluteThresholdApi: set at pre-compile, default-value=true  # Adds / removes the service Ocu_SetAbsoluteThreshold() from the code.
      boolean OcuSetPinActionApi: set at pre-compile, default-value=true  # Adds / removes the service Ocu_SetPinAction() from the code.
      boolean OcuSetPinStateApi: set at pre-compile, default-value=true  # Adds / removes the service Ocu_SetPinState() from the code.
      boolean OcuSetRelativeThresholdApi: set at pre-compile, default-value=true  # Adds / removes the service Ocu_SetRelativeThreshold() from the code.
      boolean OcuVersionInfoApi: set at pre-compile, default-value=true  # Switch to indicate that the Ocu_GetVersionInfo() is supported.
    container OcuConfigSet  # This container is the base of a Configuration Set, which contains the configured OCU channels. This way, different configuration sets can be defined for post-build process.
      enumeration OcuCountdirection [0..1]: {OCU_DOWNCOUNTING, OCU_UPCOUNTING}, multiplicity set at post-build in variant post-build / pre-compile in variant pre-compile, post-build-variant-multiplicity=true, post-build-variant-value=true, set at post-build in variant post-build / pre-compile in variant pre-compile, default-value=OCU_UPCOUNTING  # This parameter indicates the count direction for the whole OCU driver.
      container OcuChannel [1..32]: multiplicity set at pre-compile  # Configuration of an individual OCU channel.
        integer OcuChannelId: 0..65535, set at pre-compile, symbolic-name-value=true, default-value=1  # Channel Id of the OCU channel. This value will be assigned to the symbolic name derived from the OcuChannel container short name. It defines the assignment of the channel to the physical OCU hardware channel.
        integer OcuAssignedHardwareChannel: 0..255, post-build-variant-value=true, set at post-build in variant post-build / pre-compile in variant pre-compile, default-value=1  # The physical hardware channel that is assigned to this logical channel.
        enumeration FtmHwChannel: {FTM_0_CH_0, FTM_0_CH_1, FTM_0_CH_2, FTM_0_CH_3, FTM_0_CH_4, FTM_0_CH_5, FTM_0_CH_6, FTM_0_CH_7, FTM_1_CH_0, FTM_1_CH_1, FTM_1_CH_2, FTM_1_CH_3, FTM_1_CH_4, FTM_1_CH_5, FTM_1_CH_6, FTM_1_CH_7, FTM_2_CH_0, FTM_2_CH_1, FTM_2_CH_2, FTM_2_CH_3, FTM_2_CH_4, FTM_2_CH_5, FTM_2_CH_6, FTM_2_CH_7, FTM_3_CH_0, FTM_3_CH_1, FTM_3_CH_2, FTM_3_CH_3, FTM_3_CH_4, FTM_3_CH_5, FTM_3_CH_6, FTM_3_CH_7}, origin=NXP, post-build-variant-value=true, set at post-build in variant post-build / pre-compile in variant pre-compile, default-value=FTM_0_CH_0  # The Ftm hardware channel that is assigned to this logical channel.
        integer OcuDefaultThreshold: 0..65535, post-build-variant-value=true, set at post-build in variant post-build / pre-compile in variant pre-compile, default-value=10000  # Value of comparison threshold used for Initialization.
        integer OcuHardwareTriggeredAdc [0..1]: 0..255, multiplicity set at post-build in variant post-build / pre-compile in variant pre-compile, post-build-variant-multiplicity=true, post-build-variant-value=true, set at post-build in variant post-build / pre-compile in variant pre-compile, default-value=0  # This parameter is used to allow the OCU channel to trigger an ADC channel upon compare match, if this is supported by hardware. The value of the parameter represents the ADC physical channel to trigger..
        integer OcuHardwareTriggeredDMA [0..1]: 0..255, multiplicity set at post-build in variant post-build / pre-compile in variant pre-compile, post-build-variant-multiplicity=true, post-build-variant-value=true, set at post-build in variant post-build / pre-compile in variant pre-compile, default-value=0  # This parameter is used to allow the OCU channel to trigger a DMA channel upon compare match, if this is supported by hardware. The value of the parameter represents the DMA physical channel to trigger.
        integer OcuMaxCounterValue: 1..65535, post-build-variant-value=true, set at post-build in variant post-build / pre-compile in variant pre-compile, default-value=65535  # Maximum value in ticks, the counter of the OCU channel is able to count.
        function name OcuNotification [0..1]: multiplicity set at post-build in variant post-build / pre-compile in variant pre-compile, post-build-variant-multiplicity=true, post-build-variant-value=true, set at post-build in variant post-build / pre-compile in variant pre-compile, default-value=NULL  # User callback function NOTE: please use NULL or NULL_PTR w/o any quotes. If the used string is different from NULL or NULL_PTR it will be used as the configured function name.
        boolean OcuOuptutPinUsed: set at pre-compile, default-value=false  # Information about the usage of an output pin on this channel.
        enumeration OcuOutputPinDefaultState [0..1]: {OCU_HIGH, OCU_LOW}, multiplicity set at post-build in variant post-build / pre-compile in variant pre-compile, post-build-variant-multiplicity=true, post-build-variant-value=true, set at post-build in variant post-build / pre-compile in variant pre-compile, default-value=OCU_LOW  # The parameter OcuOutputPinDefaultState represents the state that a pin associated with a channel shall be set to after initialisation.
        enumeration OcuOutputPinAction [0..1]: {OCU_SET_LOW, OCU_SET_HIGH, OCU_TOGGLE, OCU_DISABLE}, multiplicity set at post-build in variant post-build / pre-compile in variant pre-compile, origin=NXP, post-build-variant-multiplicity=true, post-build-variant-value=true, set at post-build in variant post-build / pre-compile in variant pre-compile, default-value=OCU_DISABLE  # The parameter OcuOutputPinAction represents the action that a pin associated with a channel shall be set imediatly after a compare match event.
        boolean OcuUseMcuReferencePoint: origin=NXP, post-build-variant-value=true, set at pre-compile, default-value=false  # This parameter allows for automatic calculation of the Channel Tick duration based on the configured MCU Referenced Clock. If OcuUseMcuReferencePoint is set to true than selectig a Clock source from MCU is possible and based on that source clock OcuChannelTickDuration can be auto-calculated.
        integer OcuChannelTickDuration: 1..32768, post-build-variant-value=true, set at post-build in variant post-build / pre-compile in variant pre-compile, default-value=32768  # Specifies the tick duration of the counter of the channel. This parameter is the number of the input clock edges (rising edges or falling edges exclusively) counted each time to increase the counter by one unit. Note. The default value is calculated using a default prescaler of 1. For a different prescaler value the calculated value should be devided by the said prescaler value.
        reference OcuMcuClockReferencePoint [0..1]: scope=ECU, multiplicity set at pre-compile in variant pre-compile / post-build in variant post-build, origin=NXP, post-build-variant-multiplicity=true, post-build-variant-value=true, set at pre-compile in variant pre-compile / post-build in variant post-build, destination=McuClockReferencePoint  # Reference to the Ftm clock source configuration, which is set in the MCU driver configuration.
      container OcuGroup [0..*]: multiplicity set at pre-compile  # This container contains the parameters for configuring an OCU group.
        integer OcuGroupId: 0..65535, set at pre-compile, symbolic-name-value=true, default-value=1  # Numeric ID of the group. This parameter is the symbolic name of the group.
        reference OcuGroupDefinition [1..*]: multiplicity set at post-build in variant post-build / pre-compile in variant pre-compile, set at post-build in variant post-build / pre-compile in variant pre-compile, destination=OcuChannel  # Assignment of OcuChannels to an OcuGroup..
      container OcuHWSpecificSettings [0..4]: multiplicity set at post-build in variant post-build / pre-compile in variant pre-compile, post-build-variant-multiplicity=true  # This container contains Ocu-specific parameters for selecting the clock source and setting optional prescalers if supported by hardware.
        enumeration OcuFtmModule: {FTM_0, FTM_1, FTM_2, FTM_3}, origin=NXP, post-build-variant-value=true, set at pre-compile in variant pre-compile / post-build in variant post-build, default-value=FTM_0  # Selects one Ftm modules available on the platform.
        enumeration OcuClockSource [0..1]: {OCU_SYSTEM_CLOCK, OCU_EXTERNAL_CLOCK}, multiplicity set at post-build in variant post-build / pre-compile in variant pre-compile, post-build-variant-multiplicity=true, post-build-variant-value=true, set at post-build in variant post-build / pre-compile in variant pre-compile, default-value=OCU_SYSTEM_CLOCK  # The OCU driver specific clock input for the unit can statically be configured to select different clock sources if provided by hardware. Enumeration literals are defined vendor specific.
        enumeration OcuPrescale [0..1]: {DIV1, DIV2, DIV4, DIV8, DIV16, DIV32, DIV64, DIV128}, multiplicity set at post-build in variant post-build / pre-compile in variant pre-compile, post-build-variant-multiplicity=true, post-build-variant-value=true, set at post-build in variant post-build / pre-compile in variant pre-compile, default-value=DIV1  # Optional OCU driver specific clock prescale factor, if supported by hardware. Implementation is defined vendor specific.
        enumeration OcuPrescale_Alternate: {DIV1, DIV2, DIV4, DIV8, DIV16, DIV32, DIV64, DIV128}, origin=NXP, post-build-variant-value=true, set at pre-compile in variant pre-compile / post-build in variant post-build, default-value=DIV1  # Select input count source (clock) used for this FTM module. This parameter will be used by the Ocu_SetClockMode function.
        enumeration OcuDebugMode: {CNT_ON_OUTPUTS_ON, CNT_STOPED_OUTPUTS_FROZEN, CNT_STOPED_OUTPUTS_SAFE, CNT_STOPED_FLAG_SET}, origin=NXP, post-build-variant-value=true, set at pre-compile in variant pre-compile / post-build in variant post-build, default-value=CNT_ON_OUTPUTS_ON  # OcuDebugMode These bits allow select the behavior of the FTM counter, the CH(n)F bit, the channels output, and the writing to the MOD, CNTIN, and C(n)V registers (wave form register) CNT_ON_OUTPUTS_ON - Continue with normal operation during debug mode. CNT_STOPED_OUTPUTS_FROZEN - Counter is stopped, channels outputs are frozen, writes to wave form registers bypass the registers buffers CNT_STOPED_OUTPUTS_SAFE - Counter is stopped, channels outputs are forced to their safe value according to POLn bit, writes to wave form registers bypass the registers buffers CNT_STOPED_FLAG_SET - Counter is stopped, channels outputs operate with its functionality, writes to wave form registers bypass the registers buffers
    container OcuGeneral  # This container contains the module-wide configuration parameters of the OCU Driver.
      boolean OcuDevErrorDetect: set at pre-compile, default-value=false  # Switch for enabling the development error detection.
      boolean OcuEnableDualClockMode: origin=NXP, set at pre-compile in variant pre-compile / post-build in variant post-build, default-value=false  # Adds / removes the services Ocu_SetClockMode() from the code.This function is called when the prescaler value needs to be change to maintain same period at different frequency. Note: NoteThis is an Implementation Specific Parameter.
      boolean OcuEnableUserModeSupport: origin=NXP, set at pre-compile, default-value=false  # When this parameter is enabled, the OCU module will adapt to run from User Mode, with the following measures: Configuring REG_PROT for Ftm IP so that the registers under protection can be accessed from user mode by setting UAA bit in REG_PROT_GCR to 1 For more information, please see chapter 5.7 User Mode Support in IM Note: Implementation Specific Parameter.
      container OcuHwResourceConfig [32..32]  # List of HW interrupts available for the entire platform.
        enumeration OcuHwResourceId: {FTM_0_CH_0, FTM_0_CH_1, FTM_0_CH_2, FTM_0_CH_3, FTM_0_CH_4, FTM_0_CH_5, FTM_0_CH_6, FTM_0_CH_7, FTM_1_CH_0, FTM_1_CH_1, FTM_1_CH_2, FTM_1_CH_3, FTM_1_CH_4, FTM_1_CH_5, FTM_1_CH_6, FTM_1_CH_7, FTM_2_CH_0, FTM_2_CH_1, FTM_2_CH_2, FTM_2_CH_3, FTM_2_CH_4, FTM_2_CH_5, FTM_2_CH_6, FTM_2_CH_7, FTM_3_CH_0, FTM_3_CH_1, FTM_3_CH_2, FTM_3_CH_3, FTM_3_CH_4, FTM_3_CH_5, FTM_3_CH_6, FTM_3_CH_7}, origin=NXP, set at pre-compile, symbolic-name-value=true, default-value=FTM_0_CH_1  # Id of the HW interrupt service routine available platform wide and usable by the Ocu module.
        boolean OcuIsrEnable: origin=NXP, set at pre-compile, default-value=false  # Status of the HW Interrupt (true - Interrupt shall be enable platform wide; false - Interrupt shall be disabled platform wide.
        boolean OcuChannelIsUsed: origin=NXP, set at pre-compile, default-value=false  # This column configures HW channels which are going to be used.
    container CommonPublishedInformation  # Common container, aggregated by all modules. It contains published information about vendor and versions.
      integer ArReleaseMajorVersion: 4..4, origin=NXP, set at published-information, default-value=4  # Major version number of AUTOSAR specification on which the appropriate implementation is based on.
      integer ArReleaseMinorVersion: 2..2, origin=NXP, set at published-information, default-value=2  # Minor version number of AUTOSAR specification on which the appropriate implementation is based on.
      integer ArReleaseRevisionVersion: 2..2, origin=NXP, set at published-information, default-value=2  # Revision version number of AUTOSAR specification on which the appropriate implementation is based on.
      integer ModuleId: 125..125, origin=NXP, set at published-information, default-value=125  # Module ID of this module from Module List.
      integer SwMajorVersion: 1..1, origin=NXP, set at published-information, default-value=1  # Major version number of the vendor specific implementation of the module. The numbering is vendor specific.
      integer SwMinorVersion: 0..0, origin=NXP, set at published-information, default-value=0  # Minor version number of the vendor specific implementation of the module. The numbering is vendor pecific.
      integer SwPatchVersion: 2..2, origin=NXP, set at published-information, default-value=2  # Patch level version number of the vendor specific implementation of the module. The numbering is endor specific.
      string VendorApiInfix [0..1]: multiplicity set at published-information, origin=NXP, set at published-information  # In driver modules which can be instantiated several times on a single ECU, BSW00347 requires that he name of APIs is extended by the VendorId and a vendor specific name. This parameter is used to specify the vendor specific name. In total, the implementation specific name is generated as follows: <ModuleName>_>VendorId>_<VendorApiInfix>. E.g. assuming that the VendorId of the implementor is 123 and the implementer chose a VendorApiInfix of "v11r456" a api name Can_Write defined in the SWS will translate to Can_123_v11r456Write. This parameter is mandatory for all modules with upper multiplicity > 1. It shall not be used for modules with upper multiplicity =1.
      integer VendorId: 43..43, origin=NXP, set at published-information, default-value=43  # Vendor ID of the dedicated implementation of this module according to the AUTOSAR vendor list.
