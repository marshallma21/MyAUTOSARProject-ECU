AUTOSAR XML (schema 4-2-2)
package /TS_T40D2M10I2R0
  ecuc definition collection Base_EcuParameterDefinition: module=Base
  module definition Base: variants pre-compile  # Configuration of Base module.
    container CommonPublishedInformation  # Common container, aggregated by all modules. It contains published information about vendor and versions.
      integer ArReleaseMajorVersion: 4..4, origin=NXP, set at pre-compile, default-value=4  # Major version number of AUTOSAR specification on which the appropriate implementation is based on.
      integer ArReleaseMinorVersion: 2..2, origin=NXP, set at pre-compile, default-value=2  # Minor version number of AUTOSAR specification on which the appropriate implementation is based on.
      integer ArReleaseRevisionVersion: 2..2, origin=NXP, set at pre-compile, default-value=2  # Revision version number of AUTOSAR specification on which the appropriate implementation is based on.
      integer ModuleId: 0..0, origin=NXP, set at pre-compile, default-value=0  # Module ID of this module from Module List.
      integer SwMajorVersion: 1..1, origin=NXP, set at pre-compile, default-value=1  # Major version number of the vendor specific implementation of the module. The numbering is vendor specific.
      integer SwMinorVersion: 0..0, origin=NXP, set at pre-compile, default-value=0  # Minor version number of the vendor specific implementation of the module. The numbering is vendor specific.
      integer SwPatchVersion: 2..2, origin=NXP, set at pre-compile, default-value=2  # Patch level version number of the vendor specific implementation of the module. The numbering is vendor specific.
      string VendorApiInfix [0..1]: multiplicity set at pre-compile, origin=NXP, set at pre-compile  # In driver modules which can be instantiated several times on a single ECU, BSW00347 requires that the name of APIs is extended by the VendorId and a vendor specific name. This parameter is used to specify the vendor specific name. In total, the implementation specific name is generated as follows: <ModuleName>_>VendorId>_<VendorApiInfix>. E.g. assuming that the VendorId of the implementor is 123 and the implementer chose a VendorApiInfix of "v11r456" a api name Can_Write defined in the SWS will translate to Can_123_v11r456Write. This parameter is mandatory for all modules with upper multiplicity > 1. It shall not be used for modules with upper multiplicity =1.
      integer VendorId: 43..43, origin=NXP, set at pre-compile, default-value=43  # Vendor ID of the dedicated implementation of this module according to the AUTOSAR vendor list.
