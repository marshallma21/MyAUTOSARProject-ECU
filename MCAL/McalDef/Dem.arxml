AUTOSAR XML (schema 4-3-0)
package /TS_T40D2M10I2R0
  ecuc definition collection Dem_EcuParameterDefinition: module=Dem
  module definition Dem: refined-module-def=Dem, variants post-build/pre-compile/post-build-selectable  # Configuration of the Dem (Diagnostic Event Manager) module.
    container DemConfigSet  # This container contains the configuration parameters and sub containers of the Dem module supporting multiple configuration sets.
      container DemComponent [0..*]  # This container configures the monitored components and system dependencies.
        function name DemComponentFailedCallbackFnc [0..1]: multiplicity set at pre-compile, set at pre-compile  # Specifies the function to be called on component failed status changes.
        boolean DemComponentIgnoresPriority [0..1]: multiplicity set at pre-compile, set at pre-compile, default-value=false  # This configuration switch defines, whether the priority of events at this component shall be ignored.
        reference DemImmediateChildComponentRef [0..*]: multiplicity set at pre-compile, set at pre-compile, destination=DemComponent  # Reference to all immediate children of the current component.
      container DemDTC [0..65535]  # This container contains the configuration (parameters) for DemUdsDTC.
        integer DemDTCFunctionalUnit [0..1]: 0..255, scope=ECU, multiplicity set at pre-compile, set at pre-compile  # DTCFuncitonalUnit is a 1-byte value which identifies the corresponding basic vehicle / system function which reports the DTC. This parameter is necessary for the report of severity information.
        enumeration DemDTCSeverity [0..1]: {DEM_SEVERITY_CHECK_AT_NEXT_HALT, DEM_SEVERITY_CHECK_IMMEDIATELY, DEM_SEVERITY_MAINTENANCE_ONLY, DEM_SEVERITY_NO_SEVERITY}, scope=ECU, multiplicity set at pre-compile, set at pre-compile, default-value=DEM_DTC_SEV_NO_SEVERITY  # DTC severity according to ISO 14229-1. This parameter depends on the automotive manufacturer.
        integer DemDtcValue [0..1]: 1..16777214, scope=ECU, multiplicity set at post-build in variant post-build / pre-compile in variant pre-compile, set at post-build in variant post-build / pre-compile in variant pre-compile  # Unique Diagnostic Trouble Code value for UDS
        enumeration DemWWHOBDDTCClass [0..1]: {DEM_DTC_WWHOBD_CLASS_A, DEM_DTC_WWHOBD_CLASS_B1, DEM_DTC_WWHOBD_CLASS_B2, DEM_DTC_WWHOBD_CLASS_C, DEM_DTC_WWHOBD_CLASS_NOCLASS}, scope=ECU, multiplicity set at pre-compile, set at pre-compile  # DTC Class according to ISO 14229-1 [2013 version]. This parameter depends on the automotive manufacturer.
        reference DemDTCAttributesRef: set at pre-compile, destination=DemDTCAttributes  # This parameter defines the DTC Attributes associated with the DemDTC.
        reference DemObdDTCRef [0..1]: multiplicity set at pre-compile, set at pre-compile, destination=DemObdDTC  # This parameter defines the OBD DTC configuration associated with the DemDTC.
      container DemDTCAttributes [0..65535]  # This container contains the configuration (parameters) for DemDTCAttributes.
        boolean DemAgingAllowed: scope=ECU, set at pre-compile  # Switch to allow aging/unlearning of the event or not.
        integer DemAgingCycleCounterThreshold [0..1]: 1..256, scope=ECU, multiplicity set at pre-compile, set at pre-compile  # Number of aging cycles needed to unlearn/delete the event.
        integer DemAgingCycleCounterThresholdForTFSLC [0..1]: 1..256, scope=ECU, multiplicity set at pre-compile, set at pre-compile  # Number of aging cycles needed to reset the testFailedSinceLastClear Bit.
        integer DemDTCPriority: 1..256, scope=ECU, set at pre-compile  # Priority of the event, in view of full event buffer.
        enumeration DemDTCSignificance [0..1]: {DEM_EVENT_SIGNIFICANCE_FAULT, DEM_EVENT_SIGNIFICANCE_OCCURRENCE}, scope=ECU, multiplicity set at pre-compile, set at pre-compile  # Significance of the event, which indicates additional information concerning fault classification and resolution.
        integer DemEventMemoryEntryFdcThresholdStorageValue [0..1]: 1..126, multiplicity set at pre-compile, set at pre-compile  # Threshold to allocate an event memory entry and to capture the Freeze Frame.
        boolean DemImmediateNvStorage: scope=ECU, set at pre-compile  # Switch to enable immediate storage triggering of an according event memory entriy persistently to NVRAM.
        integer DemMaxNumberFreezeFrameRecords [0..1]: 0..255, scope=ECU, multiplicity set at pre-compile, set at pre-compile  # This parameter defines the number of according freeze frame records, which can maximal be stored for this event. Therefore all these freeze frame records have the same freeze frame class.
        choice reference DemMemoryDestinationRef [0..2]: scope=ECU, multiplicity set at pre-compile, set at pre-compile, destination=[DemMirrorMemory, DemPrimaryMemory, DemUserDefinedMemory]  # The event destination assigns events to none, one or two origins. If no event destination is assigned to a specific event, the event is handled internally and is not visible externally to the Dcm. If more than one event destination is assigned to a specific event, the event can be present in the corresponding origins.
        reference DemAgingCycleRef [0..1]: scope=ECU, multiplicity set at pre-compile, origin=AUTOSAR_ECUC V1.0.0, set at pre-compile, destination=DemOperationCycle  # Reference to the cycle which is triggering the aging of the event. This can either be the same as the operation cycle of the event, or a separate aging cycle reported via API Dem_SetAgingCycleState. If external aging is configured (refer to DemAgingCycleCounterProcessing), this parameter is not used.
        reference DemExtendedDataClassRef [0..1]: multiplicity set at pre-compile, set at pre-compile, destination=DemExtendedDataClass  # This reference defines the link to an extended data class sampler.
        reference DemFreezeFrameClassRef [0..1]: multiplicity set at pre-compile, set at pre-compile, destination=DemFreezeFrameClass  # These references define the links to a freeze frame class sampler.
        reference DemFreezeFrameRecNumClassRef [0..1]: scope=ECU, multiplicity set at pre-compile, set at pre-compile, destination=DemFreezeFrameRecNumClass  # This parameter defines the list of dedicated freeze frame record numbers associated with the diagnostic event. These record numbers are assigned to the freeze frame records (instead of calculated record numbers).
        reference DemJ1939DTC_NodeAddressRef [0..1]: multiplicity set at post-build in variant post-build / pre-compile in variant pre-compile, set at post-build in variant post-build / pre-compile in variant pre-compile, destination=DemJ1939NodeAddress  # Reference to a J1939 NodeAddress
        reference DemJ1939ExpandedFreezeFrameClassRef [0..1]: multiplicity set at pre-compile, set at pre-compile, destination=DemJ1939FreezeFrameClass  # These references define the links to a J1939 freeze frame class sampler.
        reference DemJ1939FreezeFrameClassRef [0..1]: multiplicity set at pre-compile, set at pre-compile, destination=DemJ1939FreezeFrameClass  # These references define the links to a J1939 freeze frame class sampler.
        reference DemWWHOBDFreezeFrameClassRef [0..1]: multiplicity set at pre-compile, set at pre-compile, destination=DemFreezeFrameClass  # This reference defines the link to a WWH-OBD freeze frame class sampler.
      container DemDebounceCounterBasedClass [0..65535]  # This container contains the configuration of Debounce Counter Based Class
        enumeration DemDebounceBehavior: {DEM_DEBOUNCE_FREEZE, DEM_DEBOUNCE_RESET}, set at pre-compile  # This parameter defines how the event debounce algorithm will behave, if a related enable condition is not fulfilled or ControlDTCSetting of the related event is disabled.
        integer DemDebounceCounterDecrementStepSize: 1..32768, scope=ECU, set at pre-compile  # Defines the step size for decrementation of the internal debounce counter (PREPASSED).
        integer DemDebounceCounterFailedThreshold: 1..32767, scope=ECU, set at pre-compile  # Defines the value of the internal debounce counter, which indicates the failed status.
        integer DemDebounceCounterIncrementStepSize: 1..32767, scope=ECU, set at pre-compile  # Defines the step size for incrementation of the internal debounce counter (PREFAILED).
        boolean DemDebounceCounterJumpDown: scope=ECU, set at pre-compile  # Switch for the activation of Jump-Down.
        integer DemDebounceCounterJumpDownValue: -32768..32767, scope=ECU, set at pre-compile, default-value=0  # Jump-Down value of the internal debounce counter which is taken as initialization value for the counter when the respective step-down occurs.
        boolean DemDebounceCounterJumpUp: scope=ECU, set at pre-compile  # Switch for the activation of Jump-Up.
        integer DemDebounceCounterJumpUpValue: -32768..32767, scope=ECU, set at pre-compile, default-value=0  # Jump-Up value of the internal debounce counter which is taken as initialization value for the counter when the respective step-up occurs.
        integer DemDebounceCounterPassedThreshold: -32768..-1, scope=ECU, set at pre-compile  # Defines the value of the internal debounce counter, which indicates the passed status.
        boolean DemDebounceCounterStorage: set at pre-compile, default-value=false  # Switch to store the debounce counter value non-volatile or not.
      container DemDebounceTimeBaseClass [0..65535]  # This container contains the configuration of Debounce Counter Based Class
        enumeration DemDebounceBehavior: {DEM_DEBOUNCE_FREEZE, DEM_DEBOUNCE_RESET}, set at pre-compile  # This parameter defines how the event debounce algorithm will
        float DemDebounceTimeFailedThreshold: 0.001..3600.0, scope=ECU, set at pre-compile  # Defines the time out duration for "Event Failed" qualification.
        float DemDebounceTimePassedThreshold: 0.001..3600.0, scope=ECU, set at pre-compile  # Defines the time out duration for "Event Passed" qualification.
      container DemDtr [0..1]  # This container holds the configuration of one individual DTR.
        float DemDtrCompuDenominator0: scope=ECU, set at pre-compile  # Part of the conversion between the binary representation and the physical meaning analogous to the SW-C Template conversion CompuRationalCoeffs with 2 numerator coefficients and 1 denominator coefficient in the direction compuInternalToPhys.
        float DemDtrCompuNumerator0: scope=ECU, set at pre-compile  # Part of the conversion between the binary representation and the physical meaning analogous to the SW-C Template conversion CompuRationalCoeffs with 2 numerator coefficients and 1 denominator coefficient in the direction compuInternalToPhys.
        float DemDtrCompuNumerator1: scope=ECU, set at pre-compile  # Part of the conversion between the binary representation and the physical meaning analogous to the SW-C Template conversion CompuRationalCoeffs with 2 numerator coefficients and 1 denominator coefficient in the direction compuInternalToPhys.
        integer DemDtrId: 0..65535, scope=ECU, set at pre-compile, symbolic-name-value=true  # The index identifier value assigned to this DTR. The value is generated during the Dem configuration process.
        integer DemDtrMid: 0..255, scope=ECU, set at post-build in variant post-build / pre-compile in variant pre-compile  # The OBDMID of the DTR.
        integer DemDtrTid: 0..255, scope=ECU, set at post-build in variant post-build / pre-compile in variant pre-compile  # The OBDTID of the DTR.
        integer DemDtrUasid: 0..255, scope=ECU, set at post-build in variant post-build / pre-compile in variant pre-compile  # The UaSId the DTR data shall be scaled to, and reported together with the rescaled DTR data.
        enumeration DemDtrUpdateKind [0..1]: {DEM_DTR_UPDATE_ALWAYS, DEM_DTR_UPDATE_STEADY}, multiplicity set at pre-compile, set at pre-compile  # Update conditions applied by the Dem to reports of DTR values. Only supported if a related Event is configured. If no related Event is configured, the Dem behaves as if DemDtrUpdateKind is configured to "DEM_DTR_UPDATE_ALWAYS".
        reference DemDtrEventRef [0..1]: scope=ECU, multiplicity set at pre-compile, set at pre-compile, destination=DemEventParameter  # Reference to the DemEventParameter this DTR is related to. If the related event is not configured, the Dem cannot ensure consistency between the DTR and the event.
      container DemEventParameter [1..65535]  # This container contains the configuration (parameters) for events.
        integer DemComponentPriority [0..1]: 0..255, multiplicity set at pre-compile, set at pre-compile  # Specifies the priority within the component. A lower value means higher priority.
        boolean DemEventAvailable: scope=ECU, set at post-build in variant post-build / pre-compile in variant pre-compile  # This parameter configures an Event as unavailable.
        integer DemEventFailureCycleCounterThreshold: 0..255, scope=ECU, set at post-build in variant post-build / pre-compile in variant pre-compile, default-value=0  # Defines the number of failure cycles for the event based fault confirmation.
        integer DemEventId: 1..65535, scope=ECU, set at pre-compile, symbolic-name-value=true  # Unique identifier of a diagnostic event.
        enumeration DemEventKind: {DEM_EVENT_KIND_BSW, DEM_EVENT_KIND_SWC}, set at pre-compile  # This parameter is used to distinguish between SW-C and BSW events. SW-C events are reported by Dem_SetEventStatus API and BSW events are reported by Dem_ReportErrorStatus API.
        boolean DemFFPrestorageSupported: scope=ECU, set at pre-compile  # If this parameter is set to true, then the Prestorage of FreezeFrames is supported by the assigned event. This parameter is useful to calculate the buffer size.
        enumeration DemReportBehavior [0..1]: {REPORT_AFTER_INIT, REPORT_BEFORE_INIT}, multiplicity set at pre-compile, set at pre-compile, default-value=REPORT_BEFORE_INIT  # Indicates the reporting behavior of the BSW Module (DemEventKind == DEM_EVENT_KIND_BSW) in order to determine the size of the reporting queue.
        reference DemComponentClassRef [0..1]: multiplicity set at pre-compile, set at pre-compile, destination=DemComponent  # Reference to the monitored component.
        reference DemDTCRef [0..1]: multiplicity set at pre-compile, set at pre-compile, destination=DemDTC  # This parameter defines the DTC configuration (typically Uds) associated with the diagnostic event.
        reference DemEnableConditionGroupRef [0..1]: scope=ECU, multiplicity set at pre-compile, origin=AUTOSAR_ECUC V1.0.0, set at pre-compile, destination=DemEnableConditionGroup  # References an enable condition group.
        reference DemOBDGroupingAssociativeEventsRef [0..1]: scope=ECU, multiplicity set at pre-compile, set at pre-compile, destination=DemEventParameter  # This parameter defines a reference which points to a representative event of one group of associate events.
        reference DemOperationCycleRef: scope=ECU, origin=AUTOSAR_ECUC V1.0.0, set at pre-compile, destination=DemOperationCycle  # Kind of operation cycle for the event (e.g. power cycle, driving cycle, ...)
        reference DemStorageConditionGroupRef [0..1]: scope=ECU, multiplicity set at pre-compile, origin=AUTOSAR_ECUC V1.0.0, set at pre-compile, destination=DemStorageConditionGroup  # References a storage condition group.
        container DemCallbackClearEventAllowed [0..1]  # The presence of this container indicates that the Dem has access to a "ClearEventAllowed" callback.
          function name DemCallbackClearEventAllowedFnc [0..1]: scope=ECU, multiplicity set at pre-compile, set at pre-compile  # Function name of prototype "ClearEventAllowed".
          enumeration DemClearEventAllowedBehavior: {DEM_NO_STATUS_BYTE_CHANGE, DEM_ONLY_THIS_CYCLE_AND_READINESS}, set at pre-compile, default-value=DEM_NO_STATUS_BYTE_CHANGE  # Defines the resulting UDS status byte for the related event, which must not be cleared according to the ClearEventAllowed callback.
        container DemCallbackEventDataChanged [0..1]  # The presence of this container indicates that the Dem has access to an "EventDataChanged" callback.
          function name DemCallbackEventDataChangedFnc [0..1]: scope=ECU, multiplicity set at pre-compile, set at pre-compile  # Function name of prototype "EventDataChanged"
        container DemCallbackEventStatusChanged [0..*]  # The presence of this container indicates, that the Dem has access to an "EventStatusChanged" callback, which the Dem will call to notify other components about the change in the status of an event.
          function name DemCallbackEventStatusChangedFnc [0..1]: scope=ECU, multiplicity set at pre-compile, set at pre-compile  # Function name of prototype "EventStatusChanged"
        container DemCallbackInitMForE [0..1]  # The presence of this container indicates, that the Dem has access to an "InitMonitorForEvent" callback, which the Dem will call to initialize a monitor.
          function name DemCallbackInitMForEFnc [0..1]: multiplicity set at pre-compile, set at pre-compile  # Function name of prototype "InitMonitorForEvent".
        choice container DemDebounceAlgorithmClass  # Debounce algorithm class: counter based, time based, or monitor internal.
          container DemDebounceCounterBased [0..1]  # This container contains the configuration (parameters) for counter based debouncing.
            reference DemDebounceCounterBasedClassRef: set at pre-compile, destination=DemDebounceCounterBasedClass  # This reference selects the DemDebounceCounterBasedClass applied for the debouncing of the DemEventParameter.
          container DemDebounceMonitorInternal [0..1]  # This container contains the configuration (parameters) for monitor internal debouncing.
            container DemCallbackGetFDC [0..1]  # DemCallbackGetFDC specifies the callback (parameter DemCallbackGetFDCFnc is present) or R-Port (no parameter DemCallbackGetFDCFnc is present) to retrieve the fault detection counter value.
              function name DemCallbackGetFDCFnc [0..1]: scope=ECU, multiplicity set at pre-compile, set at pre-compile  # This parameter defines the name of the function that the Dem will call to retrieve the fault-detection counter value from a complex driver.
          container DemDebounceTimeBase [0..1]  # This container contains the configuration (parameters) for time based debouncing.
            reference DemDebounceTimeBaseRef: set at pre-compile, destination=DemDebounceTimeBaseClass  # This reference selects the DemDebounceTimeBaseClass applied for the debouncing of the DemEventParameter.
        container DemIndicatorAttribute [0..255]  # This container contains the event specific configuration of Indicators.
          enumeration DemIndicatorBehaviour: {DEM_INDICATOR_BLINKING, DEM_INDICATOR_BLINK_CONT, DEM_INDICATOR_CONTINUOUS, DEM_INDICATOR_FAST_FLASH, DEM_INDICATOR_SLOW_FLASH}, scope=ECU, set at post-build in variant post-build / pre-compile in variant pre-compile  # Behaviour of the linked indicator
          integer DemIndicatorFailureCycleCounterThreshold [0..1]: 0..255, scope=ECU, multiplicity set at pre-compile, set at pre-compile  # Defines the number of failure cycles for the WarningIndicatorOnCriteria.
          integer DemIndicatorHealingCycleCounterThreshold: 0..255, scope=ECU, set at pre-compile  # Defines the number of healing cycles for the WarningIndicatorOffCriteria.
          reference DemIndicatorRef: scope=ECU, set at pre-compile, destination=DemIndicator  # Reference to the used indicator.
      container DemJ1939NodeAddress [0..255]  # Contains the parameters for the support of a logical J1939 node (identified by an ECU address).
        symbolic name reference DemJ1939NmNodeRef [1..255]: scope=ECU, multiplicity set at post-build in variant post-build / pre-compile in variant pre-compile, set at post-build in variant post-build / pre-compile in variant pre-compile, destination=J1939NmNode  # Reference to the corresponding J1939Nm node.
      container DemObdDTC [0..65535]  # This container contains the configuration (parameters) for DemObdDTC.
        boolean DemConsiderPtoStatus: scope=ECU, set at pre-compile  # This parameter is TRUE, when the event is affected by the Dem PTO handling.
        integer DemDtcValue [0..1]: 1..65535, scope=ECU, multiplicity set at post-build in variant post-build / pre-compile in variant pre-compile, set at post-build in variant post-build / pre-compile in variant pre-compile  # Unique Diagnostic Trouble Code value for OBD
        enumeration DemEventOBDReadinessGroup [0..1]: {DEM_OBD_RDY_AC, DEM_OBD_RDY_BOOSTPR, DEM_OBD_RDY_CAT, DEM_OBD_RDY_CMPRCMPT, DEM_OBD_RDY_EGSENS, DEM_OBD_RDY_ERG, DEM_OBD_RDY_EVAP, DEM_OBD_RDY_FLSYS, DEM_OBD_RDY_FLSYS_NONCONT, DEM_OBD_RDY_HCCAT, DEM_OBD_RDY_HTCAT, DEM_OBD_RDY_MISF, DEM_OBD_RDY_NONE, DEM_OBD_RDY_NOXCAT, DEM_OBD_RDY_O2SENS, DEM_OBD_RDY_O2SENSHT, DEM_OBD_RDY_PMFLT, DEM_OBD_RDY_SECAIR}, scope=ECU, multiplicity set at pre-compile, set at pre-compile  # This parameter specifies the Event OBD Readiness group for PID $01 and PID $41 computation.
        integer DemJ1939DTCValue [0..1]: 1..16777214, scope=ECU, multiplicity set at post-build in variant post-build / pre-compile in variant pre-compile, set at post-build in variant post-build / pre-compile in variant pre-compile  # Unique Diagnostic Trouble Code value for J1939 (consiting of SPN and FMI)
      container DemPidClass [0..255]  # This container contains the different PIDs for the single global OBD relevant freeze frame class. It is assembled out of one or several data elements.
        integer DemPidIdentifier: 0..255, scope=ECU, set at post-build in variant post-build / pre-compile in variant pre-compile  # identifier of the PID
        container DemPidDataElement [1..255]  # This container contains the different data elements contained in the specific PID.
          reference DemPidDataElementClassRef: scope=ECU, set at post-build in variant post-build / pre-compile in variant pre-compile, destination=DemDataElementClass  # This reference contains the link to a data element class.
    container DemGeneral  # This container contains the configuration (parameters) of the BSW Dem
      enumeration DemAgingCycleCounterProcessing: {DEM_PROCESS_AGINGCTR_EXTERN, DEM_PROCESS_AGINGCTR_INTERN}, scope=ECU, set at pre-compile  # This configuration switch defines, whether the aging counter is calculated Dem-internally or provided via Dem_SetAgingCycleCounterValue.
      boolean DemAgingRequieresTestedCycle: scope=ECU, set at pre-compile  # Defines if the aging cycle counter is processed every aging cycles or if only tested aging cycle are considered.
      enumeration DemAvailabilitySupport: {DEM_EVENT_AVAILABILITY, DEM_NO_AVAILABILITY}, set at pre-compile  # This configuration switch defines, whether support for availability is enabled or not.
      integer DemBswErrorBufferSize [0..1]: 0..255, scope=ECU, multiplicity set at pre-compile, set at pre-compile  # Maximum number of elements in buffer for handling of BSW errors (ref. to Dem107).
      enumeration DemClearDTCBehavior: {DEM_CLRRESP_NONVOLATILE_FINISH, DEM_CLRRESP_NONVOLATILE_TRIGGER, DEM_CLRRESP_VOLATILE}, scope=ECU, set at pre-compile  # Defines the clearing process of diagnostic information for volatile and non-volatile memory and the positive response handling for the Dcm module.
      enumeration DemClearDTCLimitation: {DEM_ALL_SUPPORTED_DTCS, DEM_ONLY_CLEAR_ALL_DTCS}, scope=ECU, set at pre-compile, default-value=DEM_ALL_SUPPORTED_DTCS  # Defines the supported Dem_<...>ClearDTC API scope.
      enumeration DemDataElementDefaultEndianness: {BIG_ENDIAN, LITTLE_ENDIAN, OPAQUE}, set at pre-compile  # Defines the default endianness of the data belonging to a data element which is applicable if the DemExternalSRDataElementClass does not define a endianness.
      boolean DemDebounceCounterBasedSupport: scope=ECU, set at pre-compile  # This configuration switch defines, whether support for counter based debouncing is enabled or not.
      boolean DemDebounceTimeBasedSupport: scope=ECU, set at pre-compile  # This configuration switch defines, whether support for time based debouncing is enabled or not.
      boolean DemDevErrorDetect: set at pre-compile  # Activate/Deactivate the Development Error Detection and Notification.
      integer DemDtcStatusAvailabilityMask: 0..255, scope=ECU, set at pre-compile  # Mask for the supported DTC status bits by the Dem. This mask is used by UDS service 0x19.
      enumeration DemEnvironmentDataCapture [0..1]: {DEM_CAPTURE_ASYNCHRONOUS_TO_REPORTING, DEM_CAPTURE_SYNCHRONOUS_TO_REPORTING}, multiplicity set at pre-compile, set at pre-compile  # DemEnvironmentDataCapture defines the point in time, when the data actually is captured.
      enumeration DemEventCombinationSupport: {DEM_EVCOMB_DISABLED, DEM_EVCOMB_ONRETRIEVAL, DEM_EVCOMB_ONSTORAGE}, scope=ECU, set at pre-compile  # This parameter defines the type of event combination supported by the Dem.
      enumeration DemEventDisplacementStrategy: {DEM_DISPLACEMENT_FULL, DEM_DISPLACEMENT_NONE, DEM_DISPLACEMENT_PRIO_OCC}, scope=ECU, set at pre-compile  # This configuration switch defines, whether support for event displacement is enabled or not, and which displacement strategy is followed.
      enumeration DemEventMemoryEntryStorageTrigger: {DEM_TRIGGER_ON_CONFIRMED, DEM_TRIGGER_ON_FDC_THRESHOLD, DEM_TRIGGER_ON_PENDING, DEM_TRIGGER_ON_TEST_FAILED}, set at pre-compile, default-value=DEM_STORAGE_ON_TEST_FAILED  # Configures the primary trigger to allocate an event memory entry.
      boolean DemGeneralInterfaceSupport: scope=ECU, set at pre-compile  # The interfaces GeneralEvtInfo, GeneralCallbackEventDataChanged and GeneralCallbackEventStatusChange are provided if DemGeneralInterfaceSupport is equal to true.
      string DemHeaderFileInclusion [0..*]: scope=ECU, multiplicity set at pre-compile, set at pre-compile, regular-expression=[a-zA-Z0-9_]([a-zA-Z0-9\._])*  # Name of the header file(s) to be included by the Dem module containing the used C-callback declarations.
      integer DemImmediateNvStorageLimit [0..1]: 1..255, scope=ECU, multiplicity set at pre-compile, set at pre-compile  # This parameter defines the maximum number of occurrences, a specific event memory entry is allowed, to be stored in NVRAM immediately (refer to DemImmediateNvStorage).
      integer DemMaxNumberEventEntryEventBuffer [0..1]: 1..250, scope=ECU, multiplicity set at pre-compile, set at pre-compile  # Specifies the size of the buffer for storing environmental data (freezeframes and extended data) until they are processed and stored to the event memory.
      integer DemMaxNumberEventEntryPermanent: 0..255, scope=ECU, set at pre-compile  # Maximum number of events which can be stored in the permanent memory.
      integer DemMaxNumberPrestoredFF: 0..255, scope=ECU, set at pre-compile  # Defines the maximum number for prestored freeze frames.
      enumeration DemOBDSupport: {DEM_OBD_DEP_SEC_ECU, DEM_OBD_MASTER_ECU, DEM_OBD_NO_OBD_SUPPORT, DEM_OBD_PRIMARY_ECU}, scope=ECU, set at pre-compile  # This configuration switch defines OBD support and kind of OBD ECU.
      enumeration DemOccurrenceCounterProcessing: {DEM_PROCESS_OCCCTR_CDTC, DEM_PROCESS_OCCCTR_TF}, scope=ECU, set at pre-compile  # This configuration switch defines the consideration of the fault confirmation process for the occurrence counter. For OBD and mixed systems (OBD/non OBD, refer to DemOBDSupport) configuration switch shall always set to DEM_PROCESS_OCCCTR_TF.
      boolean DemOperationCycleStatusStorage: scope=ECU, set at pre-compile  # Defines if the operation cycle state is available over the power cycle (stored non-volatile) or not.
      boolean DemPTOSupport: scope=ECU, set at pre-compile  # This configuration switch defines, whether PTO support (and therefore PID $1E support) is enabled or not.
      boolean DemResetConfirmedBitOnOverflow: set at pre-compile, default-value=true  # This configuration switch defines, whether the confirmed bit is reset or not while an event memory entry will be displaced.
      enumeration DemStatusBitHandlingTestFailedSinceLastClear: {DEM_STATUS_BIT_AGING_AND_DISPLACEMENT, DEM_STATUS_BIT_NORMAL}, scope=ECU, set at pre-compile, default-value=DEM_STATUS_BIT_NORMAL  # This configuration switch defines, whether the aging and displacement mechanism shall be applied to the "TestFailedSinceLastClear" status bits.
      boolean DemStatusBitStorageTestFailed: scope=ECU, set at pre-compile  # Activate/Deactivate the permanent storage of the "TestFailed" status bits.
      enumeration DemSuppressionSupport: {DEM_DTC_SUPPRESSION, DEM_NO_SUPPRESSION}, scope=ECU, set at pre-compile  # This configuration switch defines, whether support for suppression is enabled or not.
      float DemTaskTime: 0.001..0.1, scope=ECU, origin=AUTOSAR_ECUC V1.0.0, set at pre-compile  # Allow to configure the time for the periodic cyclic task. Please note: This configuration value shall be equal to the value in the Basic Software Scheduler configuration of the RTE module.
      boolean DemTriggerDcmReports: scope=ECU, set at pre-compile  # Activate/Deactivate the notification to the Diagnostic Communication Manager for ROE processing.
      boolean DemTriggerDltReports: scope=ECU, set at pre-compile  # Activate/Deactivate the notification to the Diagnostic Log and Trace.
      boolean DemTriggerFiMReports: scope=ECU, set at pre-compile  # Activate/Deactivate the notification to the Function Inhibition Manager.
      boolean DemTriggerMonitorInitBeforeClearOk: scope=ECU, set at pre-compile  # Defines if the monitor re-initialization has to be triggered before or after the Dem module returns DEM_CLEAR_OK.
      enumeration DemTypeOfDTCSupported: {DEM_DTC_TRANSLATION_ISO11992_4, DEM_DTC_TRANSLATION_ISO14229_1, DEM_DTC_TRANSLATION_ISO15031_6, DEM_DTC_TRANSLATION_SAEJ1939_73, DEM_DTC_TRANSLATION_SAE_J2012_DA_DTCFORMAT_04}, scope=ECU, set at pre-compile  # This parameter defines the format returned by Dem_DcmGetTranslationType and does not relate to/influence the supported Dem functionality.
      enumeration DemTypeOfFreezeFrameRecordNumeration: {DEM_FF_RECNUM_CALCULATED, DEM_FF_RECNUM_CONFIGURED}, scope=ECU, set at pre-compile  # This parameter defines the type of assigning freeze frame record numbers for event-specific freeze frame records.
      boolean DemVersionInfoApi: set at pre-compile  # Activate/Deactivate the version information API.
      reference DemMILIndicatorRef [0..1]: scope=ECU, multiplicity set at pre-compile, set at pre-compile, destination=DemIndicator  # This parameter defines the indicator representing the MIL.
      container DemCallbackDTCStatusChanged [0..*]  # The presence of this container indicates, that the Dem has access to a "DTCStatusChanged" callback, which the Dem will call to notify other components about the change in the status of a DTC.
        function name DemCallbackDTCStatusChangedFnc [0..1]: scope=ECU, multiplicity set at pre-compile, set at pre-compile  # Function name of prototype "DTCStatusChanged".
      choice container DemDataElementClass [0..65535]  # This container contains the configuration (parameters) for an internal/external data element class.
        container DemExternalCSDataElementClass [0..1]  # This container contains the configuration (parameters) for an external client/server based data element class.
          integer DemDataElementDataSize: 1..255, scope=ECU, set at pre-compile  # Defines the size of the data element in bytes.
          function name DemDataElementReadFnc [0..1]: scope=ECU, multiplicity set at pre-compile, set at pre-compile  # In case of DemDataElementUsePort is false, this parameter defines the prototype of the C function "ReadDataElement" used to get the according value.
          boolean DemDataElementUsePort: scope=ECU, set at pre-compile  # If the parameter is set to True, a R-Port is generated, to obtain the data element (interface DataServices_).
        container DemExternalSRDataElementClass [0..1]  # This container contains the configuration (parameters) for an external sender/receiver based data element class. It defines, how the Dem can obtain the value of the data element from a SW-C, by using a sender/receiver port.
          integer DemDataElementDataSize: 1..255, scope=ECU, set at pre-compile  # Defines the size of the data element in bits.
          enumeration DemDataElementDataType [0..1]: {BOOLEAN, SINT16, SINT32, SINT8, UINT16, UINT32, UINT8}, scope=ECU, multiplicity set at pre-compile, set at pre-compile  # Provide the implementation data type of data belonging to a external data.
          enumeration DemDataElementEndianness [0..1]: {BIG_ENDIAN, LITTLE_ENDIAN, OPAQUE}, multiplicity set at pre-compile, set at pre-compile  # Defines the endianness of the data belonging to an external data.
          choice container DemDiagnosisScaling [0..1]  # This container contains the configuration (parameters) of an alternative Diagnosis Representation. Out if this the scaling between Diagnosis and ECU internal representation and vice versa can be calculated.
            container DemAlternativeDataInterface [0..1]  # This container contains the configuration (parameters) of an alternative Diagnosis Representation by the means of a VariableDataPrototoype in a DataInterface.
              foreign reference DemDataElement: set at pre-compile, destination-type=VARIABLE-DATA-PROTOTYPE  # Alternative Diagnosis Representation for the data defined by the means of a VariableDataPrototoype in a DataInterface.
              foreign reference DemPortInterfaceMapping [0..1]: multiplicity set at pre-compile, set at pre-compile, destination-type=PORT-INTERFACE-MAPPING  # Optional reference to PortInterfaceMapping which defines the mapping rules.
            container DemAlternativeDataProps [0..1]  # This container contains the configuration (parameters) of an alternative Diagnosis Representation by the means of ECU configuration parameters.
              enumeration DemDataTypeCategory: {SCALE_LINEAR_AND_TEXTTABLE, TEXTTABLE}, scope=ECU, set at pre-compile  # Data category of the alternative Diagnosis Representation.
              container DemLinearScale [0..1]  # This container contains the configuration (parameters) of an linear scale of the alternative Diagnosis Representation.
                float DemDiagnosisRepresentationDataLowerRange: scope=ECU, set at pre-compile  # Lower Range for this scale of the data in the alternative Diagnosis Representation.
                float DemDiagnosisRepresentationDataOffset: 0.0..INF, scope=ECU, set at pre-compile, default-value=0.0  # Data offset of the alternative Diagnosis Representation for this scale.
                float DemDiagnosisRepresentationDataResolution: 0.0..INF, scope=ECU, set at pre-compile  # Data resolution of the alternative Diagnosis Representation for this scale.
                float DemDiagnosisRepresentationDataUpperRange: scope=ECU, set at pre-compile  # Upper Range for this scale of the data in the alternative Diagnosis Representation.
              container DemTextTableMapping [0..*]  # This container contains the configuration (parameters) of the mapping a DataPrototype typed by AutosarDataType that refer to a CompuMethods of category TEXTTABLE or SCALE_LINEAR_AND_TEXTTABLE.
                integer DemDiagnosisRepresentationDataValue: 0..9223372036854775807, scope=ECU, set at pre-compile  # The data value in the diagnosis representation.
                integer DemInternalDataValue: 0..9223372036854775807, scope=ECU, set at pre-compile  # The ECU internal data value.
            container DemAlternativeDataType [0..1]  # This container contains the configuration (parameters) of an alternative Diagnosis Representation by the means of an ApplicationDataType.
              foreign reference DemApplicationDataType: set at pre-compile, destination-type=APPLICATION-PRIMITIVE-DATA-TYPE  # Alternative Diagnosis Representation for the data defined by the means of a ApplicationPrimitiveDataType of category VALUE or BOOLEAN.
              container DemTextTableMapping [0..*]  # This container contains the configuration (parameters) of the mapping a DataPrototype typed by AutosarDataType that refer to a CompuMethods of category TEXTTABLE or SCALE_LINEAR_AND_TEXTTABLE.
                integer DemDiagnosisRepresentationDataValue: 0..9223372036854775807, scope=ECU, set at pre-compile  # The data value in the diagnosis representation.
                integer DemInternalDataValue: 0..9223372036854775807, scope=ECU, set at pre-compile  # The ECU internal data value.
          choice container DemSRDataElementClass  # This container defines the source of data in a provided port which shall be read for a external data element
            container DemDataElementInstance [0..1]  # Instance Reference to the primitive data in a port where the data element is typed with an ApplicationPrimitveDataType or an ImplementationDataType.
              instance reference DemDataElementInstanceRef: set at pre-compile, destination-context=ROOT-SW-COMPOSITION-PROTOTYPE SW-COMPONENT-PROTOTYPE PORT-PROTOTYPE, destination-type=AUTOSAR-DATA-PROTOTYPE  # Instance Reference to the primitive data which shall be read or written.
            container DemSubElementInDataElementInstance [0..1]  # Instance Reference to the primitve sub-element (at any level) of composite data in a port where the data element is typed with an ApplicationCompositeDataType.
              instance reference DemSubElementInDataElementInstanceRef: set at pre-compile, destination-context=ROOT-SW-COMPOSITION-PROTOTYPE SW-COMPONENT-PROTOTYPE PORT-PROTOTYPE AUTOSAR-DATA-PROTOTYPE APPLICATION-COMPOSITE-ELEMENT-DATA-PROTOTYPE*, destination-type=AUTOSAR-DATA-PROTOTYPE  # Instance Reference to the primitve sub-element (at any level) of composite data in a port which shall be read or written.
            container DemSubElementInImplDataElementInstance [0..1]  # Instance Reference to the primitve sub-element (at any level) of composite data in a port where the data element is typed with an ImplementationDataType of category STRUCTURE or ARRAY.
              instance reference DemSubElementInImplDataElementInstanceRef: set at pre-compile, destination-context=ROOT-SW-COMPOSITION-PROTOTYPE SW-COMPONENT-PROTOTYPE PORT-PROTOTYPE AUTOSAR-DATA-PROTOTYPE IMPLEMENTATION-DATA-TYPE-ELEMENT*, destination-type=IMPLEMENTATION-DATA-TYPE-ELEMENT  # Instance Reference to the primitve sub-element (at any level) of composite data in a port which shall be read or written.
        container DemInternalDataElementClass [0..1]  # This container contains the configuration (parameters) for an internal data element class.
          integer DemDataElementDataSize: 1..255, scope=ECU, set at pre-compile  # Defines the size of the data element in bytes.
          enumeration DemInternalDataElement: {DEM_AGINGCTR_DOWNCNT, DEM_AGINGCTR_UPCNT, DEM_CURRENT_FDC, DEM_CYCLES_SINCE_FIRST_FAILED, DEM_CYCLES_SINCE_LAST_FAILED, DEM_FAILED_CYCLES, DEM_MAX_FDC_DURING_CURRENT_CYCLE, DEM_MAX_FDC_SINCE_LAST_CLEAR, DEM_OCCCTR, DEM_OVFLIND, DEM_SIGNIFICANCE}, scope=ECU, set at pre-compile  # This parameter defines the Dem-internal data value, which is mapped to the data element.
      container DemDidClass [0..65535]  # This container contains the configuration (parameters) for a data Id class. It is assembled out of one or several data elements.
        integer DemDidIdentifier: 0..65535, set at pre-compile  # Identifier of the Data ID.
        reference DemDidDataElementClassRef [1..255]: scope=ECU, multiplicity set at pre-compile, set at pre-compile, destination=DemDataElementClass  # This reference contains the link to a data element class.
      container DemEnableCondition [0..255]  # This container contains the configuration (parameters) for enable conditions.
        integer DemEnableConditionId: 0..255, scope=ECU, set at pre-compile, symbolic-name-value=true  # Defines a unique enable condition Id.
        boolean DemEnableConditionStatus: scope=ECU, set at pre-compile  # Defines the initial status for enable or disable of acceptance of event reports of a diagnostic event.
      container DemEnableConditionGroup [0..255]  # This container contains the configuration (parameters) for enable condition groups.
        reference DemEnableConditionRef [1..255]: scope=ECU, multiplicity set at pre-compile, origin=AUTOSAR_ECUC V1.0.0, set at pre-compile, destination=DemEnableCondition  # References an enable condition.
      container DemExtendedDataClass [0..*]  # This class contains the combinations of extended data records for an extended data class.
        reference DemExtendedDataRecordClassRef [1..253]: multiplicity set at pre-compile, set at pre-compile, destination=DemExtendedDataRecordClass  # This reference contains the link to an extended data class record.
      container DemExtendedDataRecordClass [0..253]  # This container contains the configuration (parameters) for an extended data record class.
        integer DemExtendedDataRecordNumber: 1..239, scope=ECU, set at pre-compile  # This configuration parameter specifies an unique identifier for an extended data record.
        enumeration DemExtendedDataRecordTrigger: {DEM_TRIGGER_ON_CONFIRMED, DEM_TRIGGER_ON_FDC_THRESHOLD, DEM_TRIGGER_ON_MIRROR, DEM_TRIGGER_ON_PASSED, DEM_TRIGGER_ON_PENDING, DEM_TRIGGER_ON_TEST_FAILED}, set at pre-compile  # Defines the trigger to store the ExtendedDataRecord.
        enumeration DemExtendedDataRecordUpdate: {DEM_UPDATE_RECORD_NO, DEM_UPDATE_RECORD_YES}, scope=ECU, set at pre-compile  # This extended data record is captured if the configured trigger condition in "DemExtendedDataRecordTrigger" is fulfilled.
        reference DemDataElementClassRef [1..255]: multiplicity set at pre-compile, set at pre-compile, destination=DemDataElementClass  # This reference contains the link to a data element class.
      container DemFreezeFrameClass [0..65535]  # This container contains the combinations of DIDs for a non OBD2 and WWH-OBD relevant freeze frame class.
        reference DemDidClassRef [1..255]: scope=ECU, multiplicity set at pre-compile, set at pre-compile, destination=DemDidClass  # Reference to the DID elements which shall be contained in the freeze frame.
      container DemFreezeFrameRecNumClass [0..255]  # This container contains a list of dedicated, different freeze frame record numbers assigned to an event. The order of record numbers in this list is assigned to the chronological order of the according freeze frame records.
        reference DemFreezeFrameRecordClassRef [1..254]: scope=ECU, multiplicity set at pre-compile, requires-index=true, set at pre-compile, destination=DemFreezeFrameRecordClass  # This parameter references record number(s) for a freeze frame record.
      container DemFreezeFrameRecordClass [0..255]  # This container contains a list of dedicated, different freeze frame record numbers.
        integer DemFreezeFrameRecordNumber: 0..254, scope=ECU, set at pre-compile  # This parameter defines a record number for a freeze frame record. This record number is unique per freeze frame record number class.
        enumeration DemFreezeFrameRecordTrigger: {DEM_TRIGGER_ON_CONFIRMED, DEM_TRIGGER_ON_FDC_THRESHOLD, DEM_TRIGGER_ON_PENDING, DEM_TRIGGER_ON_TEST_FAILED}, set at pre-compile  # Defines the trigger to store the FreezeFrameRecordTrigger.
        enumeration DemFreezeFrameRecordUpdate: {DEM_UPDATE_RECORD_NO, DEM_UPDATE_RECORD_YES}, scope=ECU, set at pre-compile  # This parameter defines the case, when the freeze frame record is stored/updated.
      container DemGeneralJ1939 [0..1]  # This container contains the general J1939-specific configuration (parameters) of the Dem module.
        boolean DemJ1939ClearDtcSupport: set at pre-compile  # This configuration switch defines whether clearing J1939 DTCs (DM3 und DM11) is supported or not.
        boolean DemJ1939Dm31Support: set at pre-compile  # This configuration switch defines whether J1939 DM31 is supported or not.
        boolean DemJ1939ExpandedFreezeFrameSupport: set at pre-compile  # This configuration switch defines whether J1939 expanded freeze frames are supported or not.
        boolean DemJ1939FreezeFrameSupport: set at pre-compile  # This configuration switch defines whether J1939 freeze frames are supported or not.
        boolean DemJ1939RatioSupport: set at pre-compile  # This configuration switch defines whether J1939 performance ratios are supported or not.
        boolean DemJ1939Readiness{1..3}Support: set at pre-compile  # This configuration switch defines whether J1939 diagnostic readiness {1..3} is supported or not.
        boolean DemJ1939ReadingDtcSupport: set at pre-compile  # This configuration switch defines whether J1939 DTC readout is supported or not.
        reference DemAmberWarningLampIndicatorRef [0..1]: multiplicity set at pre-compile, set at pre-compile, destination=DemIndicator  # This parameter defines the indicator representing the AmberWarningLamp . This parameter may be used for ECUs supporting J1939.
        reference DemProtectLampIndicatorRef [0..1]: multiplicity set at pre-compile, set at pre-compile, destination=DemIndicator  # This parameter defines the indicator representing the ProtectLamp. This parameter may be used for ECUs supporting J1939.
        reference DemRedStopLampIndicatorRef [0..1]: multiplicity set at pre-compile, set at pre-compile, destination=DemIndicator  # This parameter defines the indicator representing the RedStopLamp. This parameter may be used for ECUs supporting J1939.
        container DemCallbackJ1939DTCStatusChanged [0..*]  # The presence of this container indicates, that the Dem has access to a "DTCStatusChanged" callback, which the Dem will call to notify other components about the change in the status of a DTC.
          function name DemCallbackDTCStatusChangedFnc [0..1]: scope=ECU, multiplicity set at pre-compile, set at pre-compile  # Function name of prototype "DTCStatusChanged".
        container DemJ1939FreezeFrameClass [0..255]  # This container contains the combinations of SPNs s for a J1939 relevant freeze frame.
          reference DemSPNClassRef [1..255]: scope=ECU, multiplicity set at pre-compile, requires-index=true, set at pre-compile, destination=DemSPNClass  # Reference to an SPN. This reference defines requiresIndex = true since it represents a ordered list of references where the order describes the order of single SPNs in the J1939 Freeze Frame.
        container DemSPNClass [0..*]  # This container contains the configuration (parameters) for a SPN.
          integer DemSPNId: 0..524287, set at pre-compile  # Suspect parameter number
          reference DemSPNDataElementClassRef: scope=ECU, set at pre-compile, destination=DemDataElementClass  # This reference contains the link to a data element class.
      container DemGeneralOBD [0..1]  # This container contains the general OBD-specific configuration (parameters) of the Dem module.
        boolean DemOBDCentralizedPID21Handling: scope=ECU, set at pre-compile  # Switch to enable the centralized handling of PID $21.
        boolean DemOBDCentralizedPID31Handling: scope=ECU, set at pre-compile  # Switch to enable the centralized handling of PID $31.
        integer DemOBDCompliancy: 0..255, scope=ECU, set at post-build in variant post-build / pre-compile in variant pre-compile  # Configuration value to define the appropriate value to PID$1C "OBD requirements to which vehicle or engine is certified." according to the respective standards, e.g. OBD, OBDII, JOBD etc.
        enumeration DemOBDEngineType [0..1]: {DEM_IGNITION_COMPRESSION, DEM_IGNITION_SPARK}, scope=ECU, multiplicity set at pre-compile, set at pre-compile  # Switch to provide either Gasoline or Diesel parameters.
        boolean DemOBDEventDisplacement: set at pre-compile  # Activate/Deactivate a different displacement behavior for OBD events.
        choice reference DemOBDDestinationOfEventsRef: scope=ECU, set at pre-compile, destination=[DemPrimaryMemory, DemUserDefinedMemory]  # The destination of events assigns where the OBD events shall be stored.
        choice reference DemOBDInputAcceleratorPedalInformation [0..1]: scope=ECU, multiplicity set at pre-compile, set at pre-compile, destination=[DemExternalCSDataElementClass, DemExternalSRDataElementClass]  # Input variable for the accelerator padal information, which is assigned to a specific data element used as interface for the Dem-internal PID calculations.
        choice reference DemOBDInputAmbientPressure [0..1]: scope=ECU, multiplicity set at pre-compile, set at pre-compile, destination=[DemExternalCSDataElementClass, DemExternalSRDataElementClass]  # Input variable for the ambient pressure, which is assigned to a specific data element used as interface for the Dem-internal PID calculations.
        choice reference DemOBDInputAmbientTemperature [0..1]: scope=ECU, multiplicity set at pre-compile, set at pre-compile, destination=[DemExternalCSDataElementClass, DemExternalSRDataElementClass]  # Input variable for the ambient temperature, which is assigned to a specific data element used as interface for the Dem-internal PID calculations.
        choice reference DemOBDInputDistanceInformation [0..1]: scope=ECU, multiplicity set at pre-compile, set at pre-compile, destination=[DemExternalCSDataElementClass, DemExternalSRDataElementClass]  # Input variable for the distance information, which is assigned to a specific data element used as interface for the Dem-internal PID calculations.
        choice reference DemOBDInputEngineSpeed [0..1]: scope=ECU, multiplicity set at pre-compile, set at pre-compile, destination=[DemExternalCSDataElementClass, DemExternalSRDataElementClass]  # Input variable for the engine speed, which is assigned to a specific data element used as interface for the Dem-internal PID calculations.
        choice reference DemOBDInputEngineTemperature [0..1]: scope=ECU, multiplicity set at pre-compile, set at pre-compile, destination=[DemExternalCSDataElementClass, DemExternalSRDataElementClass]  # Input variable for the engine temperature, which is assigned to a specific data element used as interface for the Dem-internal PID calculations.
        choice reference DemOBDInputProgrammingEvent [0..1]: scope=ECU, multiplicity set at pre-compile, set at pre-compile, destination=[DemExternalCSDataElementClass, DemExternalSRDataElementClass]  # Input variable for the programming event, which is assigned to a specific data element used as interface for the Dem-internal PID calculations.
        choice reference DemOBDInputVehicleSpeed [0..1]: scope=ECU, multiplicity set at pre-compile, set at pre-compile, destination=[DemExternalCSDataElementClass, DemExternalSRDataElementClass]  # Input variable for the vehicle speed, which is assigned to a specific data element used as interface for the Dem-internal PID calculations.
        choice reference DemOBDTimeSinceEngineStart [0..1]: multiplicity set at pre-compile, set at pre-compile, destination=[DemExternalCSDataElementClass, DemExternalSRDataElementClass, DemInternalDataElementClass]  # Input variable for the Time Since Engine Start information, which is assigned to a specific data element.
        container DemCallbackOBDDTCStatusChanged [0..*]  # The presence of this container indicates, that the Dem has access to a "DTCStatusChanged" callback, which the Dem will call to notify other components about the change in the status of a DTC.
          function name DemCallbackDTCStatusChangedFnc [0..1]: scope=ECU, multiplicity set at pre-compile, set at pre-compile  # Function name of prototype "DTCStatusChanged".
      container DemGroupOfDTC [0..255]  # This container contains the configuration (parameters) for DTC groups.
        integer DemGroupDTCs: 256..16776959, scope=ECU, set at pre-compile, symbolic-name-value=true  # DTC values of the selected group of DTC
      container DemIndicator [0..255]  # This container contains the configuration (parameters) for Indicators.
        integer DemIndicatorID: 0..255, scope=ECU, set at pre-compile, symbolic-name-value=true  # Unique identifier of an indicator.
      container DemMirrorMemory [0..1]  # This container contains the mirror event memory specific parameters of the Dem module.
        integer DemMaxNumberEventEntryMirror: 0..255, scope=ECU, set at pre-compile  # Maximum number of events which can be stored in the mirror memory
      container DemNvRamBlockId [0..*]  # This container contains the configuration (parameters) for a non-volatile memory block, which is used from the Dem. If no permanent storage of event memory entries is required, no block needs to be configured.
        symbolic name reference DemNvRamBlockIdRef: origin=AUTOSAR_ECUC V1.0.0, set at pre-compile, destination=NvMBlockDescriptor  # This reference contains the link to a non-volatile memory block. For post build time configurations worst case scenario shall be used.
      container DemOperationCycle [1..256]  # This container holds all parameters that are relevant to configure an operation cycle.
        boolean DemOperationCycleAutomaticEnd: scope=ECU, set at pre-compile, default-value=false  # If DemOperationCycleAutomaticEnd is configured to TRUE, Dem shall automatically end the driving cycle at either Dem_Shutdown() or Dem_Init().
        boolean DemOperationCycleAutostart: scope=ECU, set at pre-compile, default-value=false  # The autostart property defines if the operation cycles is automatically (re-)started during Dem_PreInit.
        integer DemOperationCycleId [0..1]: 0..9223372036854775807, multiplicity set at pre-compile, set at pre-compile, symbolic-name-value=true  # This parameter?s value is used, together with the aggregating container, to define a symbolic name of the operation cycle.
        enumeration DemOperationCycleType: {DEM_OPCYC_IGNITION, DEM_OPCYC_OBD_DCY, DEM_OPCYC_OTHER, DEM_OPCYC_POWER, DEM_OPCYC_TIME, DEM_OPCYC_WARMUP}, scope=ECU, set at pre-compile  # Operation cycles types for the Dem to be supported by cycle-state APIs.
      container DemPrimaryMemory  # This container contains the primary event memory specific parameters of the Dem module.
        integer DemMaxNumberEventEntryPrimary: 1..255, scope=ECU, set at pre-compile  # Maximum number of events which can be stored in the primary memory
      container DemRatio [0..65535]  # This container contains the OBD-specific in-use-monitor performance ratio configuration.
        enumeration DemIUMPRDenGroup: {DEM_IUMPR_DEN_500MILL, DEM_IUMPR_DEN_COLDSTART, DEM_IUMPR_DEN_EVAP, DEM_IUMPR_DEN_NONE, DEM_IUMPR_DEN_PHYS_API}, scope=ECU, set at pre-compile  # This parameter specifies the assigned denominator type which is applied in addition to the General Denominator conditions.
        enumeration DemIUMPRGroup: {DEM_IUMPR_BOOSTPRS, DEM_IUMPR_CAT1, DEM_IUMPR_CAT2, DEM_IUMPR_EGR, DEM_IUMPR_EGSENSOR, DEM_IUMPR_EVAP, DEM_IUMPR_FLSYS, DEM_IUMPR_NMHCCAT, DEM_IUMPR_NOXADSORB, DEM_IUMPR_NOXCAT, DEM_IUMPR_OXS1, DEM_IUMPR_OXS2, DEM_IUMPR_PMFILTER, DEM_IUMPR_PRIVATE, DEM_IUMPR_SAIR, DEM_IUMPR_SECOXS1, DEM_IUMPR_SECOXS2}, scope=ECU, set at pre-compile  # This parameter specifies the assigned IUMPR group of the ratio Id.
        integer DemRatioId: 0..65535, scope=ECU, set at pre-compile, symbolic-name-value=true  # Defines a unique ratio Id.
        enumeration DemRatioKind: {DEM_RATIO_API, DEM_RATIO_OBSERVER}, scope=ECU, set at pre-compile  # This parameter defines whether the ratio will be calculated API or observer based.
        reference DemDiagnosticEventRef: scope=ECU, set at pre-compile, destination=DemEventParameter  # This reference contains the link to a diagnostic event.
        symbolic name reference DemFunctionIdRef: scope=ECU, set at pre-compile, destination=FiMFID  # This reference contains the link to a function identifier within the FiM which is used as a primary FID.
        symbolic name reference DemSecondaryFunctionIdRef [0..*]: scope=ECU, multiplicity set at pre-compile, set at pre-compile, destination=FiMFID  # This reference contains the link to a function identifier within the FiM which is used as a secondary FID.
      container DemStorageCondition [0..255]  # This container contains the configuration (parameters) for storage conditions.
        integer DemStorageConditionId: 0..255, scope=ECU, set at pre-compile, symbolic-name-value=true  # Defines a unique storage condition Id. This parameter should not be changeable by user, because the Id should be generated by Dem itself to prevent gaps and multiple use of an Id. The storage conditions should be sequentially ordered beginning with 0 and no gaps in between.
        boolean DemStorageConditionStatus: set at pre-compile  # Defines the initial status for enable or disable of storage of a diagnostic event.
        reference DemStorageConditionReplacementEventRef [0..1]: scope=ECU, multiplicity set at pre-compile, origin=AUTOSAR_ECUC V1.0.0, set at pre-compile, destination=DemEventParameter  # Specifies the reference to an event which is stored to event memory and supports failure analysis.
      container DemStorageConditionGroup [0..255]  # This container contains the configuration (parameters) for storage condition groups.
        reference DemStorageConditionRef [1..255]: scope=ECU, multiplicity set at pre-compile, origin=AUTOSAR_ECUC V1.0.0, set at pre-compile, destination=DemStorageCondition  # References an enable condition.
      container DemUserDefinedMemory [0..30]  # This container contains the user defined event memory specific parameters of the Dem module.
        integer DemMaxNumberEventEntryUserDefined: 0..255, scope=ECU, set at pre-compile  # Maximum number of events which can be stored in the user defined memory.
        integer DemUserDefinedMemoryIdentifier: 16..255, scope=ECU, set at pre-compile  # Identifier used by external tester to identify the User defined event memory.
    container CommonPublishedInformation  # Common container, aggregated by all modules. It contains published information about vendor and versions.
      integer ArReleaseMajorVersion: 4..4, multiplicity set at published-information, origin=NXP, set at published-information, default-value=4  # Major version number of AUTOSAR specification on which the appropriate implementation is based on.
      integer ArReleaseMinorVersion: 2..2, multiplicity set at published-information, origin=NXP, set at published-information, default-value=2  # Minor version number of AUTOSAR specification on which the appropriate implementation is based on.
      integer ArReleaseRevisionVersion: 2..2, multiplicity set at published-information, origin=NXP, set at published-information, default-value=2  # Revision version number of AUTOSAR specification on which the appropriate implementation is based on.
      integer ModuleId: 54..54, multiplicity set at published-information, origin=NXP, set at published-information, default-value=54  # Module ID of this module from Module List.
      integer SwMajorVersion: 1..1, multiplicity set at published-information, origin=NXP, set at published-information, default-value=1  # Major version number of the vendor specific implementation of the module. The numbering is vendor specific.
      integer SwMinorVersion: 0..0, multiplicity set at published-information, origin=NXP, set at published-information, default-value=0  # Minor version number of the vendor specific implementation of the module. The numbering is vendor specific.
      integer SwPatchVersion: 2..2, multiplicity set at published-information, origin=NXP, set at published-information, default-value=2  # Patch level version number of the vendor specific implementation of the module. The numbering is vendor specific.
      string VendorApiInfix [0..1]: multiplicity set at published-information, origin=NXP, set at published-information  # In driver modules which can be instantiated several times on a single ECU, BSW00347 requires that the name of APIs is extended by the VendorId and a vendor specific name. This parameter is used to specify the vendor specific name. In total, the implementation specific name is generated as follows: <ModuleName>_>VendorId>_<VendorApiInfix>. E.g. assuming that the VendorId of the implementor is 123 and the implementer chose a VendorApiInfix of "v11r456" a api name Can_Write defined in the SWS will translate to Can_123_v11r456Write. This parameter is mandatory for all modules with upper multiplicity > 1. It shall not be used for modules with upper multiplicity =1.
      integer VendorId: 43..43, multiplicity set at published-information, origin=NXP, set at published-information, default-value=43  # Vendor ID of the dedicated implementation of this module according to the AUTOSAR vendor list.
