AUTOSAR XML (schema 4-3-0)
package /TS_T40D2M10I2R0
  ecuc definition collection Mcu_EcuParameterDefinition: module=Mcu
  module definition Mcu: post-build-variant-support=true, refined-module-def=Mcu, variants post-build/pre-compile  # Configuration of the MicroController Unit (MCU) module.
    container McuGeneralConfiguration  # This container contains the general configuration for the MCU driver.
      boolean McuDevErrorDetect: set at pre-compile, default-value=false  # Pre-processor switch for enabling the default error detection and reporting to the DET. The switch McuDevErrorDetect shall switch the Default Error Tracer (Det) detection and notification ON or OFF. The detection of default errors is configurable (ON/OFF) at precompile time. #define MCU_DEV_ERROR_DETECT (STD_ON)/(STD_OFF) will be generated in Mcu_Cfg.h file.
      boolean McuVersionInfoApi: set at pre-compile, default-value=false  # Pre-processor switch to enable/disable the API to read out the modules version information. #define MCU_VERSION_INFO_API (STD_ON)/(STD_OFF) will be generated in Mcu_Cfg.h file.
      boolean McuGetRamStateApi: set at pre-compile, default-value=false  # Pre-processor switch to enable/disable the API Mcu_GetRamState. #define MCU_GET_RAM_STATE_API (STD_ON)/(STD_OFF) will be generated in Mcu_Cfg.h file.
      boolean McuInitClock: set at pre-compile, default-value=true  # If this parameter is set to FALSE, the clock initialization has to be disabled from the MCU driver. This concept applies when there are some write once clock registers and a bootloader is present. If this parameter is set to TRUE, the MCU driver is responsible of the clock initialization #define MCU_INIT_CLOCK (STD_ON)/(STD_OFF) will be generated in Mcu_Cfg.h file.
      boolean McuNoPll: set at pre-compile, default-value=true  # This parameter shall be set True, if the H/W does not have a PLL or the PLL circuitry is enabled after the power on without S/W intervention. In this case MCU_DistributePllClock has to be disabled and MCU_GetPllStatus has to return MCU_PLL_STATUS_UNDEFINED. Otherwise this parameters has to be set False. #define MCU_NO_PLL (STD_ON)/(STD_OFF) will be generated in Mcu_Cfg.h file.
      boolean McuEnterLowPowerMode: origin=NXP, set at pre-compile, default-value=true  # If this parameter has been configured to 'TRUE', the function 'Mcu_SetMode()' shall not be impacted and behave as specified. If this parameter has been configured to 'FALSE', the function 'Mcu_SetMode()' shall not perform the transition to any low power modes as are 'STOP' or 'HALT' or any other mode, where the core stops execution. #define MCU_ENTER_LOW_POWER_MODE (STD_ON)/(STD_OFF) will be generated in Mcu_Cfg.h file.
      integer McuTimeout: 0..4294967295, origin=NXP, set at pre-compile, default-value=50000  # This parameter represents the maximum number of loops for blocking functionality. The maximum time needed for a MC_ME transition from DRUN to DRUN with keeping PLL running is 3 ms. Please take this into consideration when choosing the value for this parameter. Note: Implementation Specific Parameter.
      boolean McuEnableUserModeSupport: origin=NXP, set at pre-compile, default-value=false  # When this parameter is enabled, the MDL module will adapt to run from User Mode, with the following measures: a) using 'call trusted function' stubs for all internal function calls that access registers requiring supervisor mode. b) other module specific measures for more information, please see chapter 5.7 User Mode Support in IM Note: Implementation Specific Parameter.
      boolean McuPerformResetApi: set at pre-compile, default-value=false  # Pre-processor switch to enable/disable the use the Mcu_PerformReset() API. OFF - Mcu_PerformReset() API is not used. ON - Mcu_PerformReset() API is used. #define MCU_PERFORM_RESET_API (STD_ON)/(STD_OFF) will be generated in Mcu_Cfg.h file.
      boolean McuCalloutBeforePerformReset: origin=NXP, set at pre-compile, default-value=false  # Check this if you want a callout function, called by MCU right before Mcu_PerformReset(). This parameter is available for configuration only if "McuPerformResetApi" is ON. #define MCU_RESET_CALLOUT_USED (STD_ON)/(STD_OFF) will be generated in Mcu_Cfg.h file. Note: Implementation Specific Parameter.
      function name McuPerformResetCallout: origin=NXP, set at pre-compile, default-value=NULL_PTR  # Function name of callout. The field is editable only if "McuCalloutBeforePerformReset" is ON. Note: Implementation Specific Parameter.
      function name McuCmuNotification [0..1]: multiplicity set at pre-compile, origin=NXP, set at pre-compile, default-value=NULL_PTR  # Function pointer to callback function. Note: Implementation Specific Parameter.
      function name McuErrorIsrNotification [0..1]: multiplicity set at pre-compile, origin=NXP, set at pre-compile, default-value=NULL_PTR  # Function name of callout. This function will be called by the error ISR. Note: Implementation Specific Parameter.
      boolean McuDisableSimInit: origin=NXP, set at pre-compile, default-value=false  # If this parameter is set to TRUE, the System Integration Module (SIM) initialization has to be disabled in the MCU driver. If this parameter is set to FALSE, the MCU driver is responsible for the System Integration Module (SIM) initialization. #define MCU_DISABLE_SIM_INIT (STD_ON)/(STD_OFF) will be generated in Mcu_Cfg.h file.
      boolean McuDisableRcmInit: origin=NXP, set at pre-compile, default-value=false  # If this parameter is set to TRUE, the Reset Control Module (RMC) initialization has to be disabled in the MCU driver. If this parameter is set to FALSE, the MCU driver is responsible for the Reset Control Module (RMC) initialization. #define MCU_DISABLE_RMC_INIT (STD_ON)/(STD_OFF) will be generated in Mcu_Cfg.h file.
      boolean McuDisablePmcInit: origin=NXP, set at pre-compile, default-value=false  # If this parameter is set to TRUE, the Power Management Controller (PMC) initialization has to be disabled in the MCU driver. If this parameter is set to FALSE, the MCU driver is responsible for the Power Management Controller (PMC) initialization. #define MCU_DISABLE_PMC_INIT (STD_ON)/(STD_OFF) will be generated in Mcu_Cfg.h file.
      boolean McuDisableSmcInit: origin=NXP, set at pre-compile, default-value=false  # If this parameter is set to TRUE, the System Mode Controller (SMC) initialization has to be disabled in the MCU driver. If this parameter is set to FALSE, the MCU driver is responsible for the System Mode Controller (SMC) initialization. #define MCU_DISABLE_SMC_INIT (STD_ON)/(STD_OFF) will be generated in Mcu_Cfg.h file.
    container McuDebugConfiguration  # This container contains option for non-ASR APIs used for debug or extra-implementation. Note: Implementation Specific Parameter.
      boolean McuDisableDemReportErrorStatus: origin=NXP, set at pre-compile, default-value=false  # Enable/Disable the API for reporting the Dem Error. Note: Implementation Specific Parameter.
      boolean McuGetPeriphStateApi: origin=NXP, set at pre-compile, default-value=false  # Enable/Disable the API for checking peripheral states in the current mode from PCC configuration: Mcu_GetPeripheral_State(). E_OK means Peripheral with ID as parameter is clocked. E_NOT_OK means Peripheral with ID as parameter is not clocked. Note: Implementation Specific Parameter.
      boolean McuGetMidrStructureApi: origin=NXP, set at pre-compile, default-value=false  # Enable/Disable the API for Mcu_GetMidrStructure(). Get information from SIUL2 MIDRn registers. Note: Implementation Specific Parameter.
      boolean McuDisableCmuApi: origin=NXP, set at pre-compile, default-value=false  # Enable/Disable the API for disabling the clock monitoring unit. Note: Implementation Specific Parameter.
      boolean McuEnablePeripheralCMU: origin=NXP, set at pre-compile, default-value=false  # Enable/Disable Peripheral CMU for S32K11X Note: Implementation Specific Parameter.
      boolean McuSRAMRetentionConfigApi: origin=NXP, set at pre-compile, default-value=false  # Enable/Disable the API for SRAM retention configuration. Note: Implementation Specific Parameter.
    container McuPublishedInformation  # Container holding all MCU specific published information parameters.
      container McuResetReasonConf [1..*]: multiplicity set at pre-compile  # This container contains the configuration for the different type of reset reason that can be retrieved from Mcu_GetResetReason Api.
        integer McuResetReason: 0..255, scope=ECU, set at published-information, symbolic-name-value=true, default-value=5  # The parameter represents the different type of reset that a Micro supports. This parameter is referenced by the parameter EcuMResetReason in the ECU State manager module.
    container CommonPublishedInformation  # Common container, aggregated by all modules. It contains published information about vendor and versions.
      integer ArReleaseMajorVersion: 4..4, origin=NXP, set at published-information, default-value=4  # Major version number of AUTOSAR specification on which the appropriate implementation is based on.
      integer ArReleaseMinorVersion: 2..2, origin=NXP, set at published-information, default-value=2  # Minor version number of AUTOSAR specification on which the appropriate implementation is based on.
      integer ArReleaseRevisionVersion: 2..2, origin=NXP, set at published-information, default-value=2  # Revision version number of AUTOSAR specification on which the appropriate implementation is based on.
      integer ModuleId: 101..101, origin=NXP, set at published-information, default-value=101  # Module ID of this module from Module List. Note: Implementation Specific Parameter
      integer SwMajorVersion: 1..1, origin=NXP, set at published-information, default-value=1  # Major version number of the vendor specific implementation of the module. The numbering is vendor specific. Note: Implementation Specific Parameter
      integer SwMinorVersion: 0..0, origin=NXP, set at published-information, default-value=0  # Minor version number of the vendor specific implementation of the module. The numbering is vendor specific. Note: Implementation Specific Parameter
      integer SwPatchVersion: 2..2, origin=NXP, set at published-information, default-value=2  # Patch level version number of the vendor specific implementation of the module. The numbering is vendor specific. Note: Implementation Specific Parameter
      string VendorApiInfix: origin=NXP, set at published-information  # In driver modules which can be instantiated several times on a single ECU, BSW00347 requires that the name of APIs is extended by the VendorId and a vendor specific name. This parameter is used to specify the vendor specific name. In total, the Implementation specific name is generated as follows: <ModuleName>_>VendorId>_<VendorApiInfix>. E.g. assuming that the VendorId of the implementor is 123 and the implementer chose a VendorApiInfix of "v11r456" a api name Can_Write defined in the SWS will translate to Can_123_v11r456Write. This parameter is mandatory for all modules with upper multiplicity > 1. It shall not be used for modules with upper multiplicity =1. Note: Implementation Specific Parameter
      integer VendorId: 43..43, origin=NXP, set at published-information, default-value=43  # Vendor ID of the dedicated implementation of this module according to the AUTOSAR vendor list. Note: Implementation Specific Parameter
    container McuModuleConfiguration  # This container contains the configuration for the MCU driver.
      integer McuNumberOfMcuModes: 1..255, post-build-variant-value=true, set at post-build in variant post-build / pre-compile in variant pre-compile, default-value=1  # This parameter shall represent the number of Modes available for the MCU (from "McuModeSettingConf" list). CalculationFormula = Number of configured "McuModeSettingConf". This parameter is not used.
      integer McuRamSectors: 0..4294967295, post-build-variant-value=true, set at post-build in variant post-build / pre-compile in variant pre-compile, default-value=1  # This parameter shall represent the number of RAM sectors available for the MCU (from "McuRamSectorSettingConf" list). CalculationFormula = Number of configured "McuRamSectorSettingConf". This parameter is not used.
      integer McuResetSetting [0..1]: 1..255, multiplicity set at pre-compile, set at pre-compile, default-value=1  # This parameters applies to the function Mcu_PerformReset(), which performs a microcontroller reset using the hardware feature of the microcontroller. Note: This parameter is not used by the current Implementation. Software Reset occurs when Mcu_PerformReset() function is called. This parameter is not used.
      float McuRTCCLKINFrequencyHz: 0.0..1000000.0, origin=NXP, post-build-variant-value=true, set at pre-compile in variant pre-compile / post-build in variant post-build, default-value=32000  # SIRC Frequency [Hz]. Note: Implementation Specific Parameter.
      enumeration McuRtcClkSelect: {SOSCDIV1_CLK, LPO_CLK_32K, RTC_CLKIN_CLK, FIRCDIV1_CLK}, origin=NXP, post-build-variant-value=true, set at pre-compile in variant pre-compile / post-build in variant post-build, default-value=SOSCDIV1_CLK  # This is a write-once parameter SIM_LPOCLKS[RTCCLKSEL] - 32 kHz clock source select. Selects 32 kHz clock source for peripherals. 0 - SOSCDIV1_CLK 1 - 32 kHz LPO clock 2 - 32 kHz RTC_CLKIN clock 3 - FIRCDIV1_CLK Note: Implementation Specific Parameter.
      enumeration McuLPOClockSelect: {LPO_CLK_128K, NO_CLOCK, LPO_CLK_32K, LPO_CLK_1K}, origin=NXP, post-build-variant-value=true, set at pre-compile in variant pre-compile / post-build in variant post-build, default-value=LPO_CLK_128K  # This is a write-once parameter SIM_LPOCLKS[LPOCLKSEL] - LPO clock source select Selects LPO clock source for peripherals 0 - 128 kHz LPO clock 1 - No clock 2 - 32 kHz LPO clock which is divided by the 128 kHz LPO clock 3 - 1 kHz LPO clock which is divided by the 128 kHz LPO clock Note: Implementation Specific Parameter.
      boolean McuLPO32KClockEnable: origin=NXP, post-build-variant-value=true, set at pre-compile in variant pre-compile / post-build in variant post-build, default-value=true  # This is a write-once parameter SIM_LPOCLKS[LPO32KCLKEN] - 32 kHz LPO clock enable 0 - Disable 32 kHz LPO clock output 1 - Enable 32 kHz LPO clock output Note: Implementation Specific Parameter.
      boolean McuLPO1KClockEnable: origin=NXP, post-build-variant-value=true, set at pre-compile in variant pre-compile / post-build in variant post-build, default-value=true  # This is a write-once parameter SIM_LPOCLKS[LPO1KCLKEN] - 1 kHz LPO clock enable 0 - Disable 1 kHz LPO clock output 1 - Enable 1 kHz LPO clock output Note: Implementation Specific Parameter.
      enumeration McuClockSrcFailureNotification: {ENABLED, DISABLED}, post-build-variant-value=true, set at pre-compile in variant pre-compile / post-build in variant post-build, default-value=DISABLED  # Enables/Disables clock failure notification. In case this feature is not supported by HW the setting should be disabled. Note: Implementation Specific Parameter.
      container McuAllowedModes  # Configures SMC_PMPROT register. The PMPROT register can be written only once after any system reset. If the MCU is configured for a disallowed or reserved power mode, the MCU remains in its current power mode. For example, if the MCU is in normal RUN mode and AVLP is 0, an attempt to enter VLPR mode using PMCTRL[RUNM] is blocked and PMCTRL[RUNM] remains 00b, indicating the MCU is still in Normal Run mode. Note: Implementation specific Container.
        boolean McuAllowHighSpeedRunMode: origin=NXP, post-build-variant-value=true, set at pre-compile in variant pre-compile / post-build in variant post-build, default-value=false  # This is a write-once parameter SMC_PMPROT[AHSRUN] - Allow High Speed Run mode Provided the appropriate control bits are set up in PMCTRL, this write-once field allows the MCU to enter High Speed Run mode (HSRUN). 0 - HSRUN is not allowed 1 - HSRUN is allowed Note: Implementation Specific Parameter.
        boolean McuAllowVeryLowPowerModes: origin=NXP, post-build-variant-value=true, set at pre-compile in variant pre-compile / post-build in variant post-build, default-value=false  # This is a write-once parameter Provided the appropriate control bits are set up in PMCTRL, this write-once field allows the MCU to enter any very-low-power mode (VLPR, and VLPS). 0 - VLPR and VLPS are not allowed. 1 - VLPR and VLPS are allowed. Note: Implementation Specific Parameter.
      container McuSIMConfig  # Configures SIM_CHIPCTL, SIM_FCFG1, SIM_FTMOPT0, SIM_FTMOPT1, SIM_ADCOPT and SIM_MISCTRL registers. Note: Implementation specific Container.
        container McuChipControlConfiguration  # This container contains the configuration for the SIM_CHIPCTL register.
          boolean McuEnableAdcSupplyMonitoring: origin=NXP, post-build-variant-value=true, set at pre-compile in variant pre-compile / post-build in variant post-build, default-value=false  # SIM_CHIPCTL[ADC_SUPPLYEN] - Enable for internal supply monitoring on ADC0 channel AD21. unchecked - Disable internal supply monitoring. checked - Enable internal supply monitoring. Note: Implementation Specific Parameter.
          enumeration McuAdcSupply: {VDD, VDDA, VREFH, VDD_3V, VDD_FLASH_3V, VDD_LV}, origin=NXP, post-build-variant-value=true, set at pre-compile in variant pre-compile / post-build in variant post-build, default-value=VDD  # SIM_CHIPCTL[ADC_SUPPLY] - Internal supplies monitored on ADC0 channel AD21. 0 - 5 V input VDD supply (VDD) 1 - 5 V input analog supply (VDDA) 2 - ADC Reference Supply (VREFH) 3 - 3.3 V Oscillator Regulator Output (VDD_3V) 4 - 3.3 V flash regulator output (VDD_flash_3V) 5 - 1.2 V core regulator output (VDD_LV) Note: Implementation Specific Parameter.
          boolean McuPDBBackToBackSelect: origin=NXP, post-build-variant-value=true, set at pre-compile in variant pre-compile / post-build in variant post-build, default-value=false  # SIM_CHIPCTL[PDB_BB_SEL] - PDB back-to-back select Selects ADC COCO source as pdb back-to-back mode. unchecked - PDB0 channel 0 back-to-back operation with ADC0 COCO[7:0]; PDB1 channel 0 back-to-back operation with ADC1 COCO[7:0]; PDB2 channel 0 back-to-back operation with ADC2 COCO[7:0]. checked - Channel 0 of PDB0,PDB1 back-to-back operation with COCO[7:0] of ADC0, ADC1 Note: Implementation Specific Parameter.
          boolean McuPTB14InterleaveChannelSelect: origin=NXP, post-build-variant-value=true, set at pre-compile in variant pre-compile / post-build in variant post-build, default-value=false  # SIM_CHIPCTL[INTERLEAVE_SEL] - ADC interleave channel select Select ADC interleave pins. 1 - PTB14 to ADC1_SE9 and ADC0_SE9 Note: Implementation Specific Parameter.
          boolean McuPTB13InterleaveChannelSelect: origin=NXP, post-build-variant-value=true, set at pre-compile in variant pre-compile / post-build in variant post-build, default-value=false  # SIM_CHIPCTL[INTERLEAVE_SEL] - ADC interleave channel select Select ADC interleave pins. 1 - PTB13 to ADC1_SE8 and ADC0_SE8 Note: Implementation Specific Parameter.
          boolean McuPTB1InterleaveChannelSelect: origin=NXP, post-build-variant-value=true, set at pre-compile in variant pre-compile / post-build in variant post-build, default-value=false  # SIM_CHIPCTL[INTERLEAVE_SEL] - ADC interleave channel select Select ADC interleave pins. 1 - PTB1 to ADC0_SE4 and ADC1_SE15 Note: Implementation Specific Parameter.
          boolean McuPTB0InterleaveChannelSelect: origin=NXP, post-build-variant-value=true, set at pre-compile in variant pre-compile / post-build in variant post-build, default-value=false  # SIM_CHIPCTL[INTERLEAVE_SEL] - ADC interleave channel select Select ADC interleave pins. 1 - PTB0 to ADC0_SE4 and ADC1_SE14 Note: Implementation Specific Parameter.
        container McuFlexTimerConfiguration  # This container contains the configuration for the SIM_FTMOPT0 and FTMOPT1 registers.
          enumeration McuFTM3ExternalClockPinSelect: {TCLK0_PIN, TCLK1_PIN, TCLK2_PIN, NO_CLOCK}, origin=NXP, post-build-variant-value=true, set at pre-compile in variant pre-compile / post-build in variant post-build, default-value=TCLK0_PIN  # SIM_FTMOPT0[FTM3CLKSEL] - FTM3 External Clock Pin Select Selects the external pin used to drive the clock to the FTM3 module. The selected pin must also be configured for the FTM external clock function through the appropriate Pin Control Register in the Port Control module. 0 - FTM3 external clock driven by TCLK0 pin. 1 - FTM3 external clock driven by TCLK1 pin. 2 - FTM3 external clock driven by TCLK2 pin. 3 - No clock input. Note: Implementation Specific Parameter.
          enumeration McuFTM2ExternalClockPinSelect: {TCLK0_PIN, TCLK1_PIN, TCLK2_PIN, NO_CLOCK}, origin=NXP, post-build-variant-value=true, set at pre-compile in variant pre-compile / post-build in variant post-build, default-value=TCLK0_PIN  # SIM_FTMOPT0[FTM2CLKSEL] - FTM2 External Clock Pin Select Selects the external pin used to drive the clock to the FTM2 module. The selected pin must also be configured for the FTM external clock function through the appropriate Pin Control Register in the Port Control module. 0 - FTM2 external clock driven by TCLK0 pin. 1 - FTM2 external clock driven by TCLK1 pin. 2 - FTM2 external clock driven by TCLK2 pin. 3 - No clock input. Note: Implementation Specific Parameter.
          enumeration McuFTM1ExternalClockPinSelect: {TCLK0_PIN, TCLK1_PIN, TCLK2_PIN, NO_CLOCK}, origin=NXP, post-build-variant-value=true, set at pre-compile in variant pre-compile / post-build in variant post-build, default-value=TCLK0_PIN  # SIM_FTMOPT0[FTM1CLKSEL] - FTM1 External Clock Pin Select Selects the external pin used to drive the clock to the FTM1 module. The selected pin must also be configured for the FTM external clock function through the appropriate Pin Control Register in the Port Control module. 0 - FTM1 external clock driven by TCLK0 pin. 1 - FTM1 external clock driven by TCLK1 pin. 2 - FTM1 external clock driven by TCLK2 pin. 3 - No clock input. Note: Implementation Specific Parameter.
          enumeration McuFTM0ExternalClockPinSelect: {TCLK0_PIN, TCLK1_PIN, TCLK2_PIN, NO_CLOCK}, origin=NXP, post-build-variant-value=true, set at pre-compile in variant pre-compile / post-build in variant post-build, default-value=TCLK0_PIN  # SIM_FTMOPT0[FTM0CLKSEL] - FTM0 External Clock Pin Select Selects the external pin used to drive the clock to the FTM0 module. The selected pin must also be configured for the FTM external clock function through the appropriate Pin Control Register in the Port Control module. 0 - FTM0 external clock driven by TCLK0 pin. 1 - FTM0 external clock driven by TCLK1 pin. 2 - FTM0 external clock driven by TCLK2 pin. 3 - No clock input. Note: Implementation Specific Parameter.
          enumeration McuFTM7ExternalClockPinSelect: {TCLK0_PIN, TCLK1_PIN, TCLK2_PIN, NO_CLOCK}, origin=NXP, post-build-variant-value=true, set at pre-compile in variant pre-compile / post-build in variant post-build, default-value=TCLK0_PIN  # SIM_FTMOPT0[FTM7CLKSEL] - FTM7 External Clock Pin Select Selects the external pin used to drive the clock to the FTM7 module. The selected pin must also be configured for the FTM external clock function through the appropriate Pin Control Register in the Port Control module. 0 - FTM7 external clock driven by TCLK0 pin. 1 - FTM7 external clock driven by TCLK1 pin. 2 - FTM7 external clock driven by TCLK2 pin. 3 - No clock input. Note: Implementation Specific Parameter.
          enumeration McuFTM6ExternalClockPinSelect: {TCLK0_PIN, TCLK1_PIN, TCLK2_PIN, NO_CLOCK}, origin=NXP, post-build-variant-value=true, set at pre-compile in variant pre-compile / post-build in variant post-build, default-value=TCLK0_PIN  # SIM_FTMOPT0[FTM6CLKSEL] - FTM6 External Clock Pin Select Selects the external pin used to drive the clock to the FTM6 module. The selected pin must also be configured for the FTM external clock function through the appropriate Pin Control Register in the Port Control module. 0 - FTM6 external clock driven by TCLK0 pin. 1 - FTM6 external clock driven by TCLK1 pin. 2 - FTM6 external clock driven by TCLK2 pin. 3 - No clock input. Note: Implementation Specific Parameter.
          enumeration McuFTM5ExternalClockPinSelect: {TCLK0_PIN, TCLK1_PIN, TCLK2_PIN, NO_CLOCK}, origin=NXP, post-build-variant-value=true, set at pre-compile in variant pre-compile / post-build in variant post-build, default-value=TCLK0_PIN  # SIM_FTMOPT0[FTM5CLKSEL] - FTM5 External Clock Pin Select Selects the external pin used to drive the clock to the FTM5 module. The selected pin must also be configured for the FTM external clock function through the appropriate Pin Control Register in the Port Control module. 0 - FTM5 external clock driven by TCLK0 pin. 1 - FTM5 external clock driven by TCLK1 pin. 2 - FTM5 external clock driven by TCLK2 pin. 3 - No clock input. Note: Implementation Specific Parameter.
          enumeration McuFTM4ExternalClockPinSelect: {TCLK0_PIN, TCLK1_PIN, TCLK2_PIN, NO_CLOCK}, origin=NXP, post-build-variant-value=true, set at pre-compile in variant pre-compile / post-build in variant post-build, default-value=TCLK0_PIN  # SIM_FTMOPT0[FTM7CLKSEL] - FTM4 External Clock Pin Select Selects the external pin used to drive the clock to the FTM4 module. The selected pin must also be configured for the FTM external clock function through the appropriate Pin Control Register in the Port Control module. 0 - FTM4 external clock driven by TCLK0 pin. 1 - FTM4 external clock driven by TCLK1 pin. 2 - FTM4 external clock driven by TCLK2 pin. 3 - No clock input. Note: Implementation Specific Parameter.
          enumeration McuFTM3Fault0Select: {FTM3_FLT0_PIN, TRGMUX_FTM3_OUT}, origin=NXP, post-build-variant-value=true, set at pre-compile in variant pre-compile / post-build in variant post-build, default-value=FTM3_FLT0_PIN  # SIM_FTMOPT0[FTM3FLTxSEL] - FTM3 Fault 0 Select Selects the source of FTM3 fault. Every bit means one fault input respectively. The pin source for fault must be configured for the FTM module fault function through the appropriate pin control register in the port control module when it comes from external fault pin. 0 - FTM3_FLT0 pin 1 - TRGMUX_FTM3 out Note: Implementation Specific Parameter.
          enumeration McuFTM3Fault1Select: {FTM3_FLT1_PIN, TRGMUX_FTM3_OUT}, origin=NXP, post-build-variant-value=true, set at pre-compile in variant pre-compile / post-build in variant post-build, default-value=FTM3_FLT1_PIN  # SIM_FTMOPT0[FTM3FLTxSEL] - FTM3 Fault 1 Select Selects the source of FTM3 fault. Every bit means one fault input respectively. The pin source for fault must be configured for the FTM module fault function through the appropriate pin control register in the port control module when it comes from external fault pin. 0 - FTM3_FLT1 pin 1 - TRGMUX_FTM3 out Note: Implementation Specific Parameter.
          enumeration McuFTM3Fault2Select: {FTM3_FLT2_PIN, TRGMUX_FTM3_OUT}, origin=NXP, post-build-variant-value=true, set at pre-compile in variant pre-compile / post-build in variant post-build, default-value=FTM3_FLT2_PIN  # SIM_FTMOPT0[FTM3FLTxSEL] - FTM3 Fault 2 Select Selects the source of FTM3 fault. Every bit means one fault input respectively. The pin source for fault must be configured for the FTM module fault function through the appropriate pin control register in the port control module when it comes from external fault pin. 0 - FTM3_FLT0 pin 1 - TRGMUX_FTM3 out Note: Implementation Specific Parameter.
          enumeration McuFTM2Fault0Select: {FTM2_FLT0_PIN, TRGMUX_FTM2_OUT}, origin=NXP, post-build-variant-value=true, set at pre-compile in variant pre-compile / post-build in variant post-build, default-value=FTM2_FLT0_PIN  # SIM_FTMOPT0[FTM2FLTxSEL] - FTM2 Fault 0 Select Selects the source of FTM2 fault. Every bit means one fault input respectively. The pin source for fault must be configured for the FTM module fault function through the appropriate pin control register in the port control module when it comes from external fault pin. 0 - FTM2_FLT0 pin 1 - TRGMUX_FTM2 out Note: Implementation Specific Parameter.
          enumeration McuFTM2Fault1Select: {FTM2_FLT1_PIN, TRGMUX_FTM2_OUT}, origin=NXP, post-build-variant-value=true, set at pre-compile in variant pre-compile / post-build in variant post-build, default-value=FTM2_FLT1_PIN  # SIM_FTMOPT0[FTM2FLTxSEL] - FTM2 Fault 1 Select Selects the source of FTM2 fault. Every bit means one fault input respectively. The pin source for fault must be configured for the FTM module fault function through the appropriate pin control register in the port control module when it comes from external fault pin. 0 - FTM2_FLT1 pin 1 - TRGMUX_FTM2 out Note: Implementation Specific Parameter.
          enumeration McuFTM2Fault2Select: {FTM2_FLT2_PIN, TRGMUX_FTM2_OUT}, origin=NXP, post-build-variant-value=true, set at pre-compile in variant pre-compile / post-build in variant post-build, default-value=FTM2_FLT2_PIN  # SIM_FTMOPT0[FTM2FLTxSEL] - FTM2 Fault 2 Select Selects the source of FTM2 fault. Every bit means one fault input respectively. The pin source for fault must be configured for the FTM module fault function through the appropriate pin control register in the port control module when it comes from external fault pin. 0 - FTM2_FLT0 pin 1 - TRGMUX_FTM2 out Note: Implementation Specific Parameter.
          enumeration McuFTM1Fault0Select: {FTM1_FLT0_PIN, TRGMUX_FTM1_OUT}, origin=NXP, post-build-variant-value=true, set at pre-compile in variant pre-compile / post-build in variant post-build, default-value=FTM1_FLT0_PIN  # SIM_FTMOPT0[FTM1FLTxSEL] - FTM1 Fault 0 Select Selects the source of FTM1 fault. Every bit means one fault input respectively. The pin source for fault must be configured for the FTM module fault function through the appropriate pin control register in the port control module when it comes from external fault pin. 0 - FTM1_FLT0 pin 1 - TRGMUX_FTM1 out Note: Implementation Specific Parameter.
          enumeration McuFTM1Fault1Select: {FTM1_FLT1_PIN, TRGMUX_FTM1_OUT}, origin=NXP, post-build-variant-value=true, set at pre-compile in variant pre-compile / post-build in variant post-build, default-value=FTM1_FLT1_PIN  # SIM_FTMOPT0[FTM1FLTxSEL] - FTM1 Fault 1 Select Selects the source of FTM1 fault. Every bit means one fault input respectively. The pin source for fault must be configured for the FTM module fault function through the appropriate pin control register in the port control module when it comes from external fault pin. 0 - FTM1_FLT1 pin 1 - TRGMUX_FTM1 out Note: Implementation Specific Parameter.
          enumeration McuFTM1Fault2Select: {FTM1_FLT2_PIN, TRGMUX_FTM1_OUT}, origin=NXP, post-build-variant-value=true, set at pre-compile in variant pre-compile / post-build in variant post-build, default-value=FTM1_FLT2_PIN  # SIM_FTMOPT0[FTM1FLTxSEL] - FTM1 Fault 2 Select Selects the source of FTM1 fault. Every bit means one fault input respectively. The pin source for fault must be configured for the FTM module fault function through the appropriate pin control register in the port control module when it comes from external fault pin. 0 - FTM1_FLT0 pin 1 - TRGMUX_FTM1 out Note: Implementation Specific Parameter.
          enumeration McuFTM0Fault0Select: {FTM0_FLT0_PIN, TRGMUX_FTM0_OUT}, origin=NXP, post-build-variant-value=true, set at pre-compile in variant pre-compile / post-build in variant post-build, default-value=FTM0_FLT0_PIN  # SIM_FTMOPT0[FTM0FLTxSEL] - FTM0 Fault 0 Select Selects the source of FTM0 fault. Every bit means one fault input respectively. The pin source for fault must be configured for the FTM module fault function through the appropriate pin control register in the port control module when it comes from external fault pin. 0 - FTM0_FLT0 pin 1 - TRGMUX_FTM0 out Note: Implementation Specific Parameter.
          enumeration McuFTM0Fault1Select: {FTM0_FLT1_PIN, TRGMUX_FTM0_OUT}, origin=NXP, post-build-variant-value=true, set at pre-compile in variant pre-compile / post-build in variant post-build, default-value=FTM0_FLT1_PIN  # SIM_FTMOPT0[FTM0FLTxSEL] - FTM0 Fault 1 Select Selects the source of FTM0 fault. Every bit means one fault input respectively. The pin source for fault must be configured for the FTM module fault function through the appropriate pin control register in the port control module when it comes from external fault pin. 0 - FTM0_FLT1 pin 1 - TRGMUX_FTM0 out Note: Implementation Specific Parameter.
          enumeration McuFTM0Fault2Select: {FTM0_FLT2_PIN, TRGMUX_FTM0_OUT}, origin=NXP, post-build-variant-value=true, set at pre-compile in variant pre-compile / post-build in variant post-build, default-value=FTM0_FLT2_PIN  # SIM_FTMOPT0[FTM0FLTxSEL] - FTM0 Fault 2 Select Selects the source of FTM0 fault. Every bit means one fault input respectively. The pin source for fault must be configured for the FTM module fault function through the appropriate pin control register in the port control module when it comes from external fault pin. 0 - FTM0_FLT0 pin 1 - TRGMUX_FTM0 out Note: Implementation Specific Parameter.
          boolean McuFTM3Ch{0..7}ModulationSelect: origin=NXP, post-build-variant-value=true, set at pre-compile in variant pre-compile / post-build in variant post-build, default-value=false  # SIM_FTMOPT1[FTM3_OUTSEL] - FTM3 channel modulation select with FTM2_CH1 0 - No modulation with FTM2_CH1 1 - Modulation with FTM2_CH1 Note: Implementation Specific Parameter.
          boolean McuFTM0Ch{0..7}ModulationSelect: origin=NXP, post-build-variant-value=true, set at pre-compile in variant pre-compile / post-build in variant post-build, default-value=false  # SIM_FTMOPT1[FTM0_OUTSEL] - FTM0 channel modulation select with FTM1_CH1 0 - No modulation with FTM1_CH1 1 - Modulation with FTM1_CH1 Note: Implementation Specific Parameter.
          enumeration McuFTM2Ch1InputSelect: {FTM2_CHI1_INPUT, FTM2_CH0_XOR_FTM2_CH1_XOR_FTM1_CH1}, origin=NXP, post-build-variant-value=true, set at pre-compile in variant pre-compile / post-build in variant post-build, default-value=FTM2_CHI1_INPUT  # SIM_FTMOPT0[FTM2CH1SEL] - FTM2 CH1 Select Selects FTM2 CH1 input 0 - FTM2_CH1 input 1 - exclusive OR of FTM2_CH0,FTM2_CH1, and FTM1_CH1 Note: Implementation Specific Parameter.
          enumeration McuFTM2Ch0InputSelect: {FTM2_CH0_INPUT, CMP0_OUTPUT}, origin=NXP, post-build-variant-value=true, set at pre-compile in variant pre-compile / post-build in variant post-build, default-value=FTM2_CH0_INPUT  # SIM_FTMOPT0[FTM2CH0SEL] - FTM2 CH0 Select Selects FTM2 CH0 input 0 - FTM2_CH0 input 1 - CMP0 output 2 - Reserved 3 - Reserved Note: Implementation Specific Parameter.
          enumeration McuFTM1Ch0InputSelect: {FTM1_CH0_INPUT, CMP0_OUTPUT}, origin=NXP, post-build-variant-value=true, set at pre-compile in variant pre-compile / post-build in variant post-build, default-value=FTM1_CH0_INPUT  # SIM_FTMOPT0[FTM1CH0SEL] - FTM1 CH0 Select Selects FTM1 CH0 input 0 - FTM1_CH0 input 1 - CMP0 output 2 - Reserved 3 - Reserved Note: Implementation Specific Parameter.
          boolean McuFTMGlobalLoadEnable: origin=NXP, post-build-variant-value=true, set at pre-compile in variant pre-compile / post-build in variant post-build, default-value=false  # SIM_FTMOPT1[FTMGLDOK] - FTM global load enable unchecked - FTM Global load mechanism disabled. checked - FTM Global load mechanism enabled Note: Implementation Specific Parameter.
          boolean McuFTM7SyncBit: origin=NXP, post-build-variant-value=true, set at pre-compile in variant pre-compile / post-build in variant post-build, default-value=false  # SIM_FTMOPT1[FTM7SYNCBIT] - FTM7 Sync Bit Note: Implementation Specific Parameter.
          boolean McuFTM6SyncBit: origin=NXP, post-build-variant-value=true, set at pre-compile in variant pre-compile / post-build in variant post-build, default-value=false  # SIM_FTMOPT1[FTM6SYNCBIT] - FTM6 Sync Bit Note: Implementation Specific Parameter.
          boolean McuFTM5SyncBit: origin=NXP, post-build-variant-value=true, set at pre-compile in variant pre-compile / post-build in variant post-build, default-value=false  # SIM_FTMOPT1[FTM5SYNCBIT] - FTM5 Sync Bit Note: Implementation Specific Parameter.
          boolean McuFTM4SyncBit: origin=NXP, post-build-variant-value=true, set at pre-compile in variant pre-compile / post-build in variant post-build, default-value=false  # SIM_FTMOPT1[FTM4SYNCBIT] - FTM4 Sync Bit Note: Implementation Specific Parameter.
          boolean McuFTM3SyncBit: origin=NXP, post-build-variant-value=true, set at pre-compile in variant pre-compile / post-build in variant post-build, default-value=false  # SIM_FTMOPT1[FTM3SYNCBIT] - FTM3 Sync Bit Note: Implementation Specific Parameter.
          boolean McuFTM2SyncBit: origin=NXP, post-build-variant-value=true, set at pre-compile in variant pre-compile / post-build in variant post-build, default-value=false  # SIM_FTMOPT1[FTM2SYNCBIT] - FTM2 Sync Bit Note: Implementation Specific Parameter.
          boolean McuFTM1SyncBit: origin=NXP, post-build-variant-value=true, set at pre-compile in variant pre-compile / post-build in variant post-build, default-value=false  # SIM_FTMOPT1[FTM1SYNCBIT] - FTM1 Sync Bit Note: Implementation Specific Parameter.
          boolean McuFTM0SyncBit: origin=NXP, post-build-variant-value=true, set at pre-compile in variant pre-compile / post-build in variant post-build, default-value=false  # SIM_FTMOPT1[FTM0SYNCBIT] - FTM0 Sync Bit Note: Implementation Specific Parameter.
          boolean McuQspiClkSelect: origin=NXP, post-build-variant-value=true, set at pre-compile in variant pre-compile / post-build in variant post-build, default-value=false  # SIM_MISCTRL0[QSPI_CLK_SEL] - QSPI asynchronous clock gating enable. unchecked - QuadSPI internal reference clock is gated. checked - QuadSPI internal reference clock is enabled. Note: Implementation Specific Parameter.
          boolean McuRMII_ClkSelect: origin=NXP, post-build-variant-value=true, set at pre-compile in variant pre-compile / post-build in variant post-build, default-value=false  # SIM_MISCTRL0[RMII_CLK_SEL] - Set this bit to enable SOSCDIV1_CLK as ENET RMII clock in Internal loopback mode. 0 - Disable SOSCDIV1_CLK as ENET RMII clock in Internal loopback mode. 1 - Enable SOSCDIV1_CLK as ENET RMII clock in Internal loopback mode. Note: Implementation Specific Parameter.
          boolean McuRMII_Clk_OBE: origin=NXP, post-build-variant-value=true, set at pre-compile in variant pre-compile / post-build in variant post-build, default-value=false  # SIM_MISCTRL0[RMII_CLK_OBE] - Output Buffer Enable for ENET RMII clock in internal loopback mode. 0 - Disable Output Buffer 1 - Enable Output Buffer Note: Implementation Specific Parameter.
          boolean McuFTM7OBEControl: origin=NXP, post-build-variant-value=true, set at pre-compile in variant pre-compile / post-build in variant post-build, default-value=false  # SIM_MISCTRL0[FTM7_OBE_CTRL] - FTM7 OBE Control bit unchecked - The FTM channel output is put to safe state when the FTM counter is enabled and the FTM channel output is enabled by Fault Control (FTM_MODE[FAULTM] != 0 and FTM_FLTCTRL[FSTATE] = 0) and PWM is enabled (FTM_SC[PWMENn] = 1). Otherwise the channel output is tristated. checked - The FTM channel output state is retained when the channel is in output mode. The output is tristated when the channel is in input capture [DECAPEN = 0, COMBINE = 0, MSnB:MSnA = 0] or dual edge capture mode [DECAPEN = 1] Note: Implementation Specific Parameter.
          boolean McuFTM6OBEControl: origin=NXP, post-build-variant-value=true, set at pre-compile in variant pre-compile / post-build in variant post-build, default-value=false  # SIM_MISCTRL0[FTM6_OBE_CTRL] - FTM6 OBE Control bit unchecked - The FTM channel output is put to safe state when the FTM counter is enabled and the FTM channel output is enabled by Fault Control (FTM_MODE[FAULTM] != 0 and FTM_FLTCTRL[FSTATE] = 0) and PWM is enabled (FTM_SC[PWMENn] = 1). Otherwise the channel output is tristated. checked - The FTM channel output state is retained when the channel is in output mode. The output is tristated when the channel is in input capture [DECAPEN = 0, COMBINE = 0, MSnB:MSnA = 0] or dual edge capture mode [DECAPEN = 1] Note: Implementation Specific Parameter.
          boolean McuFTM5OBEControl: origin=NXP, post-build-variant-value=true, set at pre-compile in variant pre-compile / post-build in variant post-build, default-value=false  # SIM_MISCTRL0[FTM5_OBE_CTRL] - FTM5 OBE Control bit unchecked - The FTM channel output is put to safe state when the FTM counter is enabled and the FTM channel output is enabled by Fault Control (FTM_MODE[FAULTM] != 0 and FTM_FLTCTRL[FSTATE] = 0) and PWM is enabled (FTM_SC[PWMENn] = 1). Otherwise the channel output is tristated. checked - The FTM channel output state is retained when the channel is in output mode. The output is tristated when the channel is in input capture [DECAPEN = 0, COMBINE = 0, MSnB:MSnA = 0] or dual edge capture mode [DECAPEN = 1] Note: Implementation Specific Parameter.
          boolean McuFTM4OBEControl: origin=NXP, post-build-variant-value=true, set at pre-compile in variant pre-compile / post-build in variant post-build, default-value=false  # SIM_MISCTRL0[FTM4_OBE_CTRL] - FTM4 OBE Control bit unchecked - The FTM channel output is put to safe state when the FTM counter is enabled and the FTM channel output is enabled by Fault Control (FTM_MODE[FAULTM] != 0 and FTM_FLTCTRL[FSTATE] = 0) and PWM is enabled (FTM_SC[PWMENn] = 1). Otherwise the channel output is tristated. checked - The FTM channel output state is retained when the channel is in output mode. The output is tristated when the channel is in input capture [DECAPEN = 0, COMBINE = 0, MSnB:MSnA = 0] or dual edge capture mode [DECAPEN = 1] Note: Implementation Specific Parameter.
          boolean McuFTM3OBEControl: origin=NXP, post-build-variant-value=true, set at pre-compile in variant pre-compile / post-build in variant post-build, default-value=false  # SIM_MISCTRL0[FTM3_OBE_CTRL] - FTM3 OBE Control bit unchecked - The FTM channel output is put to safe state when the FTM counter is enabled and the FTM channel output is enabled by Fault Control (FTM_MODE[FAULTM] != 0 and FTM_FLTCTRL[FSTATE] = 0) and PWM is enabled (FTM_SC[PWMENn] = 1). Otherwise the channel output is tristated. checked - The FTM channel output state is retained when the channel is in output mode. The output is tristated when the channel is in input capture [DECAPEN = 0, COMBINE = 0, MSnB:MSnA = 0] or dual edge capture mode [DECAPEN = 1] Note: Implementation Specific Parameter.
          boolean McuFTM2OBEControl: origin=NXP, post-build-variant-value=true, set at pre-compile in variant pre-compile / post-build in variant post-build, default-value=false  # SIM_MISCTRL0[FTM2_OBE_CTRL] - FTM2 OBE Control bit unchecked - The FTM channel output is put to safe state when the FTM counter is enabled and the FTM channel output is enabled by Fault Control (FTM_MODE[FAULTM] != 0 and FTM_FLTCTRL[FSTATE] = 0) and PWM is enabled (FTM_SC[PWMENn] = 1). Otherwise the channel output is tristated. checked - The FTM channel output state is retained when the channel is in output mode. The output is tristated when the channel is in input capture [DECAPEN = 0, COMBINE = 0, MSnB:MSnA = 0] or dual edge capture mode [DECAPEN = 1] Note: Implementation Specific Parameter.
          boolean McuFTM1OBEControl: origin=NXP, post-build-variant-value=true, set at pre-compile in variant pre-compile / post-build in variant post-build, default-value=false  # SIM_MISCTRL0[FTM1_OBE_CTRL] - FTM1 OBE Control bit unchecked - The FTM channel output is put to safe state when the FTM counter is enabled and the FTM channel output is enabled by Fault Control (FTM_MODE[FAULTM] != 0 and FTM_FLTCTRL[FSTATE] = 0) and PWM is enabled (FTM_SC[PWMENn] = 1). Otherwise the channel output is tristated. checked - The FTM channel output state is retained when the channel is in output mode. The output is tristated when the channel is in input capture [DECAPEN = 0, COMBINE = 0, MSnB:MSnA = 0] or dual edge capture mode [DECAPEN = 1] Note: Implementation Specific Parameter.
          boolean McuFTM0OBEControl: origin=NXP, post-build-variant-value=true, set at pre-compile in variant pre-compile / post-build in variant post-build, default-value=false  # SIM_MISCTRL0[FTM0_OBE_CTRL] - FTM0 OBE Control bit unchecked - The FTM channel output is put to safe state when the FTM counter is enabled and the FTM channel output is enabled by Fault Control (FTM_MODE[FAULTM] != 0 and FTM_FLTCTRL[FSTATE] = 0) and PWM is enabled (FTM_SC[PWMENn] = 1). Otherwise the channel output is tristated. checked - The FTM channel output state is retained when the channel is in output mode. The output is tristated when the channel is in input capture [DECAPEN = 0, COMBINE = 0, MSnB:MSnA = 0] or dual edge capture mode [DECAPEN = 1] Note: Implementation Specific Parameter.
          boolean McuFTM_GTBControl: origin=NXP, post-build-variant-value=true, set at pre-compile in variant pre-compile / post-build in variant post-build, default-value=false  # SIM_MISCTRL0[FTM_GTB_SPLIT_EN] - FTM GTB split enable/disable bit unchecked - All the FTMs have a single global time-base. checked - FTM0-3 have a common time-base and others have a different common time-base. Please refer 'FTM global time base' in FTM chapter in RM for implementation details. Note: Implementation Specific Parameter.
        container McuAdcOptionsConfiguration  # This container contains the configuration for the SIM_ADCOPT and SIM_MISCTRL registers.
          enumeration McuADC1PreTrigeerSourceSelect: {PDB_PRE_TRIGGER, TRGMUX_PRE_TRIGGER, SOFTWARE_PRE_TRIGGER}, origin=NXP, post-build-variant-value=true, set at pre-compile in variant pre-compile / post-build in variant post-build, default-value=PDB_PRE_TRIGGER  # SIM_ADCOPT[ADC1PRETRGSE] - ADC1 pre-trigger source select Selects pre-trigger source for ADC1. 0 - PDB pre-trigger (default) 1 - TRGMUX pre-trigger 2 - Software pre-trigger Note: Implementation Specific Parameter.
          enumeration McuADC1SoftwarePreTrigeerSourceSelect: {SW_PRE_TRIGGER_DISABLE, SW_PRE_TRIGGER_0, SW_PRE_TRIGGER_1, SW_PRE_TRIGGER_2, SW_PRE_TRIGGER_3}, origin=NXP, post-build-variant-value=true, set at pre-compile in variant pre-compile / post-build in variant post-build, default-value=SW_PRE_TRIGGER_DISABLE  # SIM_ADCOPT[ADC1SWPRETRG] - ADC1 software pre-trigger sources 0 - software pre-trigger disabled 4 - software pre-trigger 0 5 - software pre-trigger 1 6 - software pre-trigger 2 7 - software pre-trigger 3 Note: Implementation Specific Parameter.
          enumeration McuADC1TrigeerSourceSelect: {PDB, TRGMUX}, origin=NXP, post-build-variant-value=true, set at pre-compile in variant pre-compile / post-build in variant post-build, default-value=PDB  # SIM_ADCOPT[ADC1TRGSEL] - ADC1 trigger source select Selects trigger source for ADC1. 0 - PDB output 1 - TRGMUX output Note: Implementation Specific Parameter.
          enumeration McuADC0PreTrigeerSourceSelect: {PDB_PRE_TRIGGER, TRGMUX_PRE_TRIGGER, SOFTWARE_PRE_TRIGGER}, origin=NXP, post-build-variant-value=true, set at pre-compile in variant pre-compile / post-build in variant post-build, default-value=PDB_PRE_TRIGGER  # SIM_ADCOPT[ADC0PRETRGSE] - ADC0 pre-trigger source select Selects pre-trigger source for ADC0. 0 - PDB pre-trigger (default) 1 - TRGMUX pre-trigger 2 - Software pre-trigger Note: Implementation Specific Parameter.
          enumeration McuADC0SoftwarePreTrigeerSourceSelect: {SW_PRE_TRIGGER_DISABLE, SW_PRE_TRIGGER_0, SW_PRE_TRIGGER_1, SW_PRE_TRIGGER_2, SW_PRE_TRIGGER_3}, origin=NXP, post-build-variant-value=true, set at pre-compile in variant pre-compile / post-build in variant post-build, default-value=SW_PRE_TRIGGER_DISABLE  # SIM_ADCOPT[ADC0SWPRETRG] - ADC0 software pre-trigger sources 0 - software pre-trigger disabled 4 - software pre-trigger 0 5 - software pre-trigger 1 6 - software pre-trigger 2 7 - software pre-trigger 3 Note: Implementation Specific Parameter.
          enumeration McuADC0TrigeerSourceSelect: {PDB, TRGMUX}, origin=NXP, post-build-variant-value=true, set at pre-compile in variant pre-compile / post-build in variant post-build, default-value=PDB  # SIM_ADCOPT[ADC2TRGSEL] - ADC0 trigger source select Selects trigger source for ADC0. 0 - PDB output 1 - TRGMUX output Note: Implementation Specific Parameter.
          boolean McuSoftwareTriggerToTRGMUX: origin=NXP, post-build-variant-value=true, set at pre-compile in variant pre-compile / post-build in variant post-build, default-value=false  # SIM_MISCTRL[SW_TRG] - Software Trigger bit to TRGMUX Note: Implementation Specific Parameter.
      container McuClockSettingConfig [1..*]: multiplicity set at pre-compile  # This container contains the configuration for the Clock settings of the MCU.
        integer McuClockSettingId: 0..255, set at pre-compile, symbolic-name-value=true, default-value=0  # The Id of this McuClockSettingConfig to be used as argument for the API call Mcu_InitClock().
        boolean McuSysClockUnderMcuControl: origin=NXP, post-build-variant-value=true, set at pre-compile in variant pre-compile / post-build in variant post-build, default-value=true  # 0 - System clock tree is NOT under mcu control. 1 - System clock is under mcu control. If this is set to false, the MCU code will not configure the SIU_SYSDIV register when Mcu_InitClock is called Note: Implementation Specific Parameter.
        enumeration McuScgClkOutSelect: {SCG_SLOW_CLK, SOSC, SIRC, FIRC, SPLL}, origin=NXP, post-build-variant-value=true, set at pre-compile in variant pre-compile / post-build in variant post-build, default-value=SCG_SLOW_CLK  # SCG_CLKOUTCNFG[CLKOUTSEL] - SCG Clkout Select. This register controls which SCG clock source is selected to be ported out to the CLKOUT pin. 0 - SCG SLOW Clock (FLASH_CLK Clock). 1 - System OSC 2 - Slow IRC 3 - Fast IRC 6 - System PLL Note: Implementation Specific Parameter.
        container McuRunClockConfig  # This container configures the system clock source and the system clock dividers for the core, platform, external and bus clock domains when in Run mode only. Note: Implementation specific Container.
          float McuPreDivSystemClockFrequency: 1000.0..1.6E8, origin=NXP, post-build-variant-value=true, set at pre-compile in variant pre-compile / post-build in variant post-build, default-value=48000000  # Run Core clock - Pre Divide System Clock Frequency. This is the frequency for the specific instance of the "McuClockReferencePoint" container. Value calculated for user info. It is given in Hz. Note: PREDIV_SYS_CLK is only available in S32K148. Note: Implementation Specific Parameter.
          float McuCoreClockFrequency: 1000.0..8.0E7, origin=NXP, post-build-variant-value=true, set at pre-compile in variant pre-compile / post-build in variant post-build, default-value=4.8E7  # Run Core clock - Clocks the ARM core, divided by DIVCORE bits inside SCG This is the frequency for the specific instance of the "McuClockReferencePoint" container. Value calculated for user info. It is given in Hz. Note: Implementation Specific Parameter.
          float McuSystemClockFrequency: 1000.0..8.0E7, origin=NXP, post-build-variant-value=true, set at pre-compile in variant pre-compile / post-build in variant post-build, default-value=80000000  # Run System clock - Clocks the Crossbar, NVIC, Flash controller, FTM and PDB,etc. RUN_SYS_CLK can run up to CORE_CLK. This is the frequency for the specific instance of the "McuClockReferencePoint" container. Value calculated for user info. It is given in Hz. Note: Implementation Specific Parameter.
          float McuBusClockFrequency: 1000.0..4.8E7, origin=NXP, post-build-variant-value=true, set at pre-compile in variant pre-compile / post-build in variant post-build, default-value=48000000  # Run Bus clock - BUS_CLK Clocks the Peripherals, divided by DIVBUS bits inside SCG This is the frequency for the specific instance of the "McuClockReferencePoint" container. Value calculated for user info. It is given in Hz. Note: Implementation Specific Parameter.
          float McuFlashClockFrequency: 1000.0..2.667E7, origin=NXP, post-build-variant-value=true, set at pre-compile in variant pre-compile / post-build in variant post-build, default-value=26670000  # Run Flash clock - Clocks the flash module, divided by DIVSLOW bits inside SCG This is the frequency for the specific instance of the "McuClockReferencePoint" container. Value calculated for user info. It is given in Hz. Note: Implementation Specific Parameter.
          enumeration McuSystemClockSwitch: {SOSC, SIRC, FIRC, SPLL}, origin=NXP, post-build-variant-value=true, set at pre-compile in variant pre-compile / post-build in variant post-build, default-value=FIRC  # Run System Clock Select. Configure the SCG_RCCR[SCS] register field. The system clock is either: - System OSC (SCG_RCCR[SCS]=1) - Slow IRC (SCG_RCCR[SCS]=2) - Fast IRC (SCG_RCCR[SCS]=3) - System PLL (SCG_RCCR[SCS]=6) Value extracted from Resource: MCU.RunSystemClkSource.List Note: Implementation Specific Parameter.
          integer McuCoreClockDivider: 1..16, origin=NXP, post-build-variant-value=true, set at pre-compile in variant pre-compile / post-build in variant post-build, default-value=1  # Configures the SCG_RCCR[DIVCORE] bitfield This parameter represents the core clock divider. Note: implementation specific parameter.
          integer McuBusClockDivider: 1..16, origin=NXP, post-build-variant-value=true, set at pre-compile in variant pre-compile / post-build in variant post-build, default-value=1  # Configures the SCG_RCCR[DIVBUS] bitfield This parameter represents the bus clock divider. Note: implementation specific parameter.
          integer McuSlowClockDivider: 1..8, origin=NXP, post-build-variant-value=true, set at pre-compile in variant pre-compile / post-build in variant post-build, default-value=2  # Configures the SCG_RCCR[DIVSLOW] bitfield. This parameter represents the flash clock divider. Note: Configuring DIVSLOW to lower frequencies than supported flash frequencies mentioned in datasheet (fFLASH) adds wait states and no power saving. It is recommended to configure DIVSLOW as close to fFLASH.
          float McuScgClkOutFrequency: 1000.0..1.8E8, origin=NXP, post-build-variant-value=true, set at pre-compile in variant pre-compile / post-build in variant post-build, default-value=1000000  # This is frequency of SCG clockout. It is given in Hz. Note: Implementation Specific Parameter.
        container McuVlprClockConfig  # Selects the clock source generating the system clock in VLPR mode. The clock dividers cannot be changed while in VLPR mode. They must be programmed prior to entering VLPR mode to guarantee - the core/system and bus clocks are less than or equal to 4 MHz - the flash memory clock is less than or equal to 1 MHz. Note: Implementation specific Container.
          float McuPreDivSystemClockFrequency: 1000.0..8000000.0, origin=NXP, post-build-variant-value=true, set at pre-compile in variant pre-compile / post-build in variant post-build, default-value=8000000  # VLPR Core clock - Pre Divide System Clock Frequency. This is the frequency for the specific instance of the "McuClockReferencePoint" container. Value calculated for user info. It is given in Hz. Note: PREDIV_SYS_CLK is only available in S32K148. Note: Implementation Specific Parameter.
          float McuCoreClockFrequency: 1000.0..4000000.0, origin=NXP, post-build-variant-value=true, set at pre-compile in variant pre-compile / post-build in variant post-build, default-value=4000000.0  # VLPR Core clock - Clocks the ARM core, divided by DIVCORE bits inside SCG This is the frequency for the specific instance of the "McuClockReferencePoint" container. Value calculated for user info. It is given in Hz. Note: Implementation Specific Parameter.
          float McuSystemClockFrequency: 1000.0..4000000.0, origin=NXP, post-build-variant-value=true, set at pre-compile in variant pre-compile / post-build in variant post-build, default-value=4000000  # VLPR System clock - Clocks the Crossbar, NVIC, Flash controller, FTM and PDB,etc. VLPR_SYS_CLK can run up to CORE_CLK. This is the frequency for the specific instance of the "McuClockReferencePoint" container. Value calculated for user info. It is given in Hz. Note: Implementation Specific Parameter.
          float McuBusClockFrequency: 1000.0..4000000.0, origin=NXP, post-build-variant-value=true, set at pre-compile in variant pre-compile / post-build in variant post-build, default-value=4000000  # VLPR Bus clock - BUS_CLK Clocks the Peripherals, divided by DIVBUS bits inside SCG This is the frequency for the specific instance of the "McuClockReferencePoint" container. Value calculated for user info. It is given in Hz. Note: Implementation Specific Parameter.
          float McuFlashClockFrequency: 1000.0..1000000.0, origin=NXP, post-build-variant-value=true, set at pre-compile in variant pre-compile / post-build in variant post-build, default-value=1000000  # VLPR Flash clock - Clocks the flash module, divided by DIVSLOW bits inside SCG This is the frequency for the specific instance of the "McuClockReferencePoint" container. Value calculated for user info. It is given in Hz. Note: Implementation Specific Parameter.
          enumeration McuSystemClockSwitch: {SIRC}, origin=NXP, post-build-variant-value=true, set at pre-compile in variant pre-compile / post-build in variant post-build, default-value=SIRC  # VLPR System Clock Select. Configure the SCG_VCCR[SCS] register field. The system clock is either: - Slow IRC (SCG_VCCR[SCS]=2) Value extracted from Resource: MCU.VlprSystemClkSource.List Note: Implementation Specific Parameter.
          integer McuCoreClockDivider: 1..16, origin=NXP, post-build-variant-value=true, set at pre-compile in variant pre-compile / post-build in variant post-build, default-value=2  # Configures the SCG_VCCR[DIVCORE] bitfield This parameter represents the core clock divider. Note: implementation specific parameter.
          integer McuBusClockDivider: 1..16, origin=NXP, post-build-variant-value=true, set at pre-compile in variant pre-compile / post-build in variant post-build, default-value=1  # Configures the SCG_VCCR[DIVBUS] bitfield This parameter represents the bus clock divider. Note: implementation specific parameter.
          integer McuSlowClockDivider: 1..8, origin=NXP, post-build-variant-value=true, set at pre-compile in variant pre-compile / post-build in variant post-build, default-value=4  # Configures the SCG_RCCR[DIVSLOW] bitfield. This parameter represents the flash clock divider. Note: Configuring DIVSLOW to lower frequencies than supported flash frequencies mentioned in datasheet (fFLASH) adds wait states and no power saving. It is recommended to configure DIVSLOW as close to fFLASH.
          float McuScgClkOutFrequency: 1000.0..1.8E8, origin=NXP, post-build-variant-value=true, set at pre-compile in variant pre-compile / post-build in variant post-build, default-value=1000000  # This is frequency of SCG clockout. It is given in Hz. Note: Implementation Specific Parameter.
        container McuHsrunClockConfig  # This container configures the system clock source and the system clock dividers for the core, platform, external and bus clock domains when in HSRUN mode only. Note: Implementation specific Container.
          float McuPreDivSystemClockFrequency: 1000.0..1.6E8, origin=NXP, post-build-variant-value=true, set at pre-compile in variant pre-compile / post-build in variant post-build, default-value=48000000  # HSRUN System clock - Pre Divide System Clock Frequency. This is the frequency for the specific instance of the "McuClockReferencePoint" container. Value calculated for user info. It is given in Hz. Note: PREDIV_SYS_CLK is only available in S32K148. Note: Implementation Specific Parameter.
          float McuCoreClockFrequency: 1000.0..1.12E8, origin=NXP, post-build-variant-value=true, set at pre-compile in variant pre-compile / post-build in variant post-build, default-value=4.8E7  # HSRUN Core clock - Clocks the ARM core, divided by DIVCORE bits inside SCG This is the frequency for the specific instance of the "McuClockReferencePoint" container. Value calculated for user info. It is given in Hz. Note: Implementation Specific Parameter.
          float McuSystemClockFrequency: 1000.0..1.12E8, origin=NXP, post-build-variant-value=true, set at pre-compile in variant pre-compile / post-build in variant post-build, default-value=112000000  # HSRUN System clock - Clocks the Crossbar, NVIC, Flash controller, FTM and PDB,etc. HSRUN_SYS_CLK can run up to CORE_CLK. This is the frequency for the specific instance of the "McuClockReferencePoint" container. Value calculated for user info. It is given in Hz. Note: Implementation Specific Parameter.
          float McuBusClockFrequency: 1000.0..5.6E7, origin=NXP, post-build-variant-value=true, set at pre-compile in variant pre-compile / post-build in variant post-build, default-value=56000000  # HSRUN Bus clock - BUS_CLK Clocks the Peripherals, divided by DIVBUS bits inside SCG This is the frequency for the specific instance of the "McuClockReferencePoint" container. Value calculated for user info. It is given in Hz. Note: Implementation Specific Parameter.
          float McuFlashClockFrequency: 1000.0..2.8E7, origin=NXP, post-build-variant-value=true, set at pre-compile in variant pre-compile / post-build in variant post-build, default-value=28000000  # HSRUN Flash clock - Clocks the flash module, divided by DIVSLOW bits inside SCG This is the frequency for the specific instance of the "McuClockReferencePoint" container. Value calculated for user info. It is given in Hz. Note: Implementation Specific Parameter.
          enumeration McuSystemClockSwitch: {SOSC, SIRC, FIRC, SPLL}, origin=NXP, post-build-variant-value=true, set at pre-compile in variant pre-compile / post-build in variant post-build, default-value=FIRC  # HSRUN System Clock Select. Configure the SCG_RCCR[SCS] register field. The system clock is either: - System OSC (SCG_RCCR[SCS]=1) - Slow IRC (SCG_RCCR[SCS]=2) - Fast IRC (SCG_RCCR[SCS]=3) - System PLL (SCG_RCCR[SCS]=6) Value extracted from Resource: MCU.HsrunSystemClkSource.List Note: Implementation Specific Parameter.
          integer McuCoreClockDivider: 1..16, origin=NXP, post-build-variant-value=true, set at pre-compile in variant pre-compile / post-build in variant post-build, default-value=1  # Configures the SCG_HCCR[DIVCORE] bitfield This parameter represents the core clock divider. Note: implementation specific parameter.
          integer McuBusClockDivider: 1..16, origin=NXP, post-build-variant-value=true, set at pre-compile in variant pre-compile / post-build in variant post-build, default-value=1  # Configures the SCG_HCCR[DIVBUS] bitfield This parameter represents the bus clock divider. Note: implementation specific parameter.
          integer McuSlowClockDivider: 1..8, origin=NXP, post-build-variant-value=true, set at pre-compile in variant pre-compile / post-build in variant post-build, default-value=2  # Configures the SCG_RCCR[DIVSLOW] bitfield. This parameter represents the flash clock divider. Note: Configuring DIVSLOW to lower frequencies than supported flash frequencies mentioned in datasheet (fFLASH) adds wait states and no power saving. It is recommended to configure DIVSLOW as close to fFLASH.
          float McuScgClkOutFrequency: 1000.0..1.8E8, origin=NXP, post-build-variant-value=true, set at pre-compile in variant pre-compile / post-build in variant post-build, default-value=1000000  # This is frequency of SCG clockout. It is given in Hz. Note: Implementation Specific Parameter.
        container McuSystemOSCClockConfig  # Configures System OSC registers. Note: Implementation specific Container.
          boolean McuSOSCUnderMcuControl: origin=NXP, set at pre-compile, default-value=true  # 0 - System OSC is NOT under mcu control. 1 - System OSC is under mcu control. If this is set to false, the MCU code will not configure the SOSC registers when Mcu_InitClock is called Note: Implementation Specific Parameter.
          float McuSOSCFrequency: 4000000.0..4.0E7, origin=NXP, post-build-variant-value=true, set at pre-compile in variant pre-compile / post-build in variant post-build, default-value=8000000  # This is the SOSC frequency for the specific instance of the McuClockReferencePoint container. It is expressed in Hz. If PLL is used, then oscillator needs to be in high range only, SCG_SOSCCFG[RANGE] on 11 as used in reference clock. Note: Implementation Specific Parameter.
          float McuSOSCDiv2Frequency: 1.0..4.0E7, origin=NXP, post-build-variant-value=true, set at pre-compile in variant pre-compile / post-build in variant post-build, default-value=8000000.0  # This is the SOSC Divider 2 frequency for the specific instance of the McuClockReferencePoint container. It is expressed in Hz. This should be configured to 40 MHz or less in RUN/HSRUN mode. Note: Implementation Specific Parameter.
          float McuSOSCDiv1Frequency: 1.0..4.0E7, origin=NXP, post-build-variant-value=true, set at pre-compile in variant pre-compile / post-build in variant post-build, default-value=8000000.0  # This is the SOSC Divider 1 frequency for the specific instance of the McuClockReferencePoint container. It is expressed in Hz. This should be configured to 40 MHz or less in RUN/HSRUN mode. Note: Implementation Specific Parameter.
          boolean McuSOSCEnable: origin=NXP, post-build-variant-value=true, set at pre-compile in variant pre-compile / post-build in variant post-build, default-value=true  # SCG_SOSCCSR[SOSCEN] - System OSC Enable 0 - System OSC is disabled. 1 - System OSC is enabled. Note: Implementation Specific Parameter.
          boolean McuSOSCClockMonitorResetEnable: origin=NXP, post-build-variant-value=true, set at pre-compile in variant pre-compile / post-build in variant post-build, default-value=false  # SCG_SOSCCSR[SOSCCMRE] - System OSC Clock Monitor Reset Enable 0 - Clock Monitor generates interrupt when error detected. 1 - Clock Monitor generates reset when error detected. Note: Implementation Specific Parameter.
          boolean McuSOSCClockMonitorEnable: origin=NXP, post-build-variant-value=true, set at pre-compile in variant pre-compile / post-build in variant post-build, default-value=false  # SCG_SOSCCSR[SOSCCM] - System OSC Clock Monitor Enables the clock monitor, if the clock source is disabled in a low power mode then the clock monitor is also disabled in the low power mode. When the clock monitor is disabled in a low power mode, it remains disabled until the clock valid flag is set following exit from the low power mode. 0 - System OSC Clock Monitor is disabled. 1 - System OSC Clock Monitor is enabled. Note: Implementation Specific Parameter.
          integer McuSOSCDiv2: 0..64, origin=NXP, post-build-variant-value=true, set at pre-compile in variant pre-compile / post-build in variant post-build, default-value=1  # Configures SCG_SOSCDIV[SOSCDIV2]. System OSC Clock Divide 2. Clock divider 2 for System OSC. Used by bus clock modules that need an asynchronous clock source. 0 - Output disabled. Note: Implementation specific Parameter.
          integer McuSOSCDiv1: 0..64, origin=NXP, post-build-variant-value=true, set at pre-compile in variant pre-compile / post-build in variant post-build, default-value=1  # Configures SCG_SOSCDIV[SOSCDIV1] System OSC Clock Divide 1. Clock divider 1 for System OSC. Used to generate the system clock source and by platform clock modules that need an asynchronous clock source. 0 - Output disabled. Note: Implementation specific Parameter.
          enumeration McuSOSCRangeSelect: {MEDIUM_FREQ_RANGE, HIGH_FREQ_RANGE}, origin=NXP, post-build-variant-value=true, set at pre-compile in variant pre-compile / post-build in variant post-build, default-value=HIGH_FREQ_RANGE  # SCG_SOSCCFG[RANGE] - System OSC Range Select Selects the frequency range for the system crystal oscillator (OSC) NOTE The following constraints are not checked by the xdm schema: If PLL is used, then oscillator needs to be in high range only, SCG_SOSCCFG[RANGE] on 11 as used in reference clock. - Medium frequency range selected for the crytstal oscillator of 4 MHz to 8 MHz. - High frequency range selected for the crystal oscillator of 8 MHz to 32 MHz. Note: Implementation Specific Parameter.
          boolean McuSOSCHighGainOscillatorSelect: origin=NXP, post-build-variant-value=true, set at pre-compile in variant pre-compile / post-build in variant post-build, default-value=false  # SCG_SOSCCFG[HGO] - High Gain Oscillator Select Controls the crystal oscillator power mode of operations. unchecked - Configure crystal oscillator for low-power operation checked - Configure crystal oscillator for high-gain operation Note: Implementation Specific Parameter.
          boolean McuSOSCExternalReferenceSelect: origin=NXP, post-build-variant-value=true, set at pre-compile in variant pre-compile / post-build in variant post-build, default-value=false  # SCG_SOSCCFG[EREFS] - External Reference Select Selects the source for the external reference clock. unchecked - Internal oscillator of OSC requested. checked - External reference clock from PAD pin selected Note: Implementation Specific Parameter.
        container McuSIRCClockConfig  # Configures Slow IRC (SIRC) registers. Note: Implementation specific Container.
          boolean McuSIRCUnderMcuControl: origin=NXP, set at pre-compile, default-value=true  # 0 - Slow IRC is NOT under mcu control. 1 - Slow IRC is under mcu control. If this is set to false, the MCU code will not configure the SIRC registers when Mcu_InitClock is called Note: Implementation Specific Parameter.
          float McuSIRCFrequency: 2000000.0..8000000.0, origin=NXP, post-build-variant-value=true, set at pre-compile in variant pre-compile / post-build in variant post-build, default-value=8000000  # This is the SIRC frequency for the specific instance of the McuClockReferencePoint container. It is expressed in Hz. Note: Implementation Specific Parameter.
          float McuSIRCDiv2Frequency: 1.0..8000000.0, origin=NXP, post-build-variant-value=true, set at pre-compile in variant pre-compile / post-build in variant post-build, default-value=4000000.0  # This is the SIRC Divider 2 frequency for the specific instance of the McuClockReferencePoint container. It is expressed in Hz. This should be configured to 8 MHz or less. Note: Implementation Specific Parameter.
          float McuSIRCDiv1Frequency: 1.0..8000000.0, origin=NXP, post-build-variant-value=true, set at pre-compile in variant pre-compile / post-build in variant post-build, default-value=8000000.0  # This is the SIRC Divider 1 frequency for the specific instance of the McuClockReferencePoint container. It is expressed in Hz. This should be configured to 8 MHz or less in RUN/HSRUN mode and to 4 MHz or less in VLPR mode.
          boolean McuSIRCEnable: origin=NXP, post-build-variant-value=true, set at pre-compile in variant pre-compile / post-build in variant post-build, default-value=true  # SCG_SIRCCSR[SIRCEN] - Slow IRC Enable 0 - Slow IRC is disabled. 1 - Slow IRC is enabled. Note: Implementation Specific Parameter. The Node is not editable. This is needed for switching system clock.
          boolean McuSIRCLowPowerEnable: origin=NXP, post-build-variant-value=true, set at pre-compile in variant pre-compile / post-build in variant post-build, default-value=false  # SCG_SIRCCSR[SIRCLPEN] - Slow IRC Low Power Enable 0 - Slow IRC is disabled in VLP modes. 1 - Slow IRC is enabled in VLP modes. Note: Implementation Specific Parameter.
          boolean McuSIRCStopEnable: origin=NXP, post-build-variant-value=true, set at pre-compile in variant pre-compile / post-build in variant post-build, default-value=false  # SCG_SIRCCSR[SIRCSTEN] - Slow IRC Enable 0 - Slow IRC is disabled. 1 - Slow IRC is enabled. Note: Implementation Specific Parameter.
          integer McuSIRCDiv2: 0..64, origin=NXP, post-build-variant-value=true, set at pre-compile in variant pre-compile / post-build in variant post-build, default-value=2  # Configures SCG_SIRCDIV[SIRCDIV2]. Slow IRC Clock Divider 2. Clock divider 2 for Slow IRC. Used by bus clock modules that need an asynchronous clock source. 0 - Output disabled. Note: Implementation specific Parameter.
          integer McuSIRCDiv1: 0..64, origin=NXP, post-build-variant-value=true, set at pre-compile in variant pre-compile / post-build in variant post-build, default-value=1  # Configures SCG_SIRCDIV[SIRCDIV1]. Slow IRC Clock Divider 1. Clock divider 1 for Slow IRC. Used to generate the system clock source and by platform clock modules that need an asynchronous clock source. 0 - Output disabled. Note: Implementation specific Parameter.
          enumeration McuSIRCRangeSelect: {LOW_RANGE_CLOCK, HIGH_RANGE_CLOCK}, origin=NXP, post-build-variant-value=true, set at pre-compile in variant pre-compile / post-build in variant post-build, default-value=HIGH_RANGE_CLOCK  # SCG_SIRCCFG[RANGE] - Selects the Frequency Range Slow IRC low range clock (2 MHz) Slow IRC high range clock (8 MHz) Note: The SIRC clock is chosen as source clock that must be sacrificed to be ON at all times. Add addition, Software should not configure the SCG_SIRCCFG[RANGE] to any value other than HIGH_RANGE_CLOCK. Note: Implementation Specific Parameter.
        container McuFIRCClockConfig  # Configures Fast IRC (FIRC) registers. Note: Implementation specific Container.
          boolean McuFIRCUnderMcuControl: origin=NXP, set at pre-compile, default-value=true  # 0 - Fast IRC is NOT under mcu control. 1 - Fast IRC is under mcu control. If this is set to false, the MCU code will not configure the FIRC registers when Mcu_InitClock is called Note: Implementation Specific Parameter.
          float McuFIRCFrequency: 4.8E7..6.0E7, origin=NXP, post-build-variant-value=true, set at pre-compile in variant pre-compile / post-build in variant post-build, default-value=48000000  # This is the FIRC frequency for the specific instance of the McuClockReferencePoint container. It is expressed in Hz. Note: Implementation specific Container.
          float McuFIRCDiv2Frequency: 1.0..4.8E7, origin=NXP, post-build-variant-value=true, set at pre-compile in variant pre-compile / post-build in variant post-build, default-value=2.4E7  # This is the FIRC Divider 2 frequency for the specific instance of the McuClockReferencePoint container. It is expressed in Hz. This should be configured to 48 MHz or less in RUN/HSRUN mode. Note: Implementation specific Container.
          float McuFIRCDiv1Frequency: 1.0..4.8E7, origin=NXP, post-build-variant-value=true, set at pre-compile in variant pre-compile / post-build in variant post-build, default-value=4.8E7  # This is the FIRC Divider 1 frequency for the specific instance of the McuClockReferencePoint container. It is expressed in Hz. This should be configured to 48 MHz or less in RUN/HSRUN mode. Note: Implementation specific Container.
          boolean McuFIRCEnable: origin=NXP, post-build-variant-value=true, set at pre-compile in variant pre-compile / post-build in variant post-build, default-value=true  # SCG_FIRCCSR[FIRCEN] - Fast IRC Enable 0 - Fast IRC is disabled. 1 - Fast IRC is enabled. Note: Implementation specific Container.
          boolean McuFIRCRegulatorEnable: origin=NXP, post-build-variant-value=true, set at pre-compile in variant pre-compile / post-build in variant post-build, default-value=true  # Fast IRC Regulator Enable 0 - Fast IRC Regulator is disabled.(SCG_FIRCCSR[FIRCREGOFF] = 1) 1 - Fast IRC Regulator is enabled.(SCG_FIRCCSR[FIRCREGOFF] = 0) Note: Implementation Specific Parameter.
          integer McuFIRCDiv2: 0..64, origin=NXP, post-build-variant-value=true, set at pre-compile in variant pre-compile / post-build in variant post-build, default-value=2  # Configures SCG_FIRCDIV[FIRCDIV2] Fast IRC Clock Divider 2. Clock divider 2 for the Fast IRC. Used by bus clock modules that need an asynchronous clock source. 0 - Output disabled. Note: Implementation specific Parameter.
          integer McuFIRCDiv1: 0..64, origin=NXP, post-build-variant-value=true, set at pre-compile in variant pre-compile / post-build in variant post-build, default-value=1  # Configures SCG_FIRCDIV[FIRCDIV1] Fast IRC Clock Divider 1. Clock divider 1 for Fast IRC. Used to generate the system clock source and by platform clock modules that need an asynchronous clock source. 0 - Output disabled. Note: Implementation specific Parameter.
          enumeration McuFIRCRangeSelect: {TRIMMED_TO_48MHZ}, origin=NXP, post-build-variant-value=true, set at pre-compile in variant pre-compile / post-build in variant post-build, default-value=TRIMMED_TO_48MHZ  # SCG_FIRCCFG[RANGE] - Selects the Frequency Range. 00b - Fast IRC is trimmed to 48 MHz. 01b - Reserved. 10b - Reserved. 11b - Reserved. Note: Software should not configure the SCG_FIRCCFG[RANGE] to any value other than Fast IRC is trimmed to 48 MHz. Note: Implementation Specific Parameter.
        container McuSystemPll  # This container provides the specific configuration for the System PLL. Note: Implementation Specific Container.
          boolean McuSystemPllUnderMcuControl: origin=NXP, set at pre-compile, default-value=false  # Set this to TRUE if System PLL is under mcu control If it is FALSE then the mcu driver will not write the corresponding registers. The user must still set the values - they are used by the clock refference points Note: Implementation Specific Parameter.
          float McuSPLLFrequency: 9.0E7..1.6E8, origin=NXP, post-build-variant-value=true, set at pre-compile in variant pre-compile / post-build in variant post-build, default-value=96000000  # This is the System PLL frequency for the specific instance of the McuClockReferencePoint container. It is expressed in Hz. Note: Pll_freq = (McuSPLLInputFrequency * McuSPLLMultiplier)/2 Note: Implementation Specific Parameter.
          float McuSPLLDiv2Frequency: 9000000.0..5.6E7, origin=NXP, post-build-variant-value=true, set at pre-compile in variant pre-compile / post-build in variant post-build, default-value=4.8E7  # This is the System PLL Divider 2 frequency for the specific instance of the McuClockReferencePoint container. It is expressed in Hz. This should be configured to 40 MHz or less in RUN mode and 56 MHz or less in HSRUN mode. Note: Implementation Specific Parameter.
          float McuSPLLDiv1Frequency: 9000000.0..1.12E8, origin=NXP, post-build-variant-value=true, set at pre-compile in variant pre-compile / post-build in variant post-build, default-value=9.6E7  # This is the System PLL Divider 1 frequency for the specific instance of the McuClockReferencePoint container. It is expressed in Hz. This should be configured to 80MHz or less in RUN mode and to 112 MHz or less in HSRUN mode. Note: Implementation Specific Parameter.
          boolean McuSPLLEnable: origin=NXP, post-build-variant-value=true, set at pre-compile in variant pre-compile / post-build in variant post-build, default-value=false  # SCG_SPLLCSR[SPLLEN] - System PLL Enable 0 - System PLL is disabled. 1 - System PLL is enabled. Note: Implementation Specific Parameter.
          boolean McuSPLLClockMonitorResetEnable: origin=NXP, set at pre-compile, default-value=false  # SCG_SPLLCSR[SPLLCMRE] - System PLL Clock Monitor Reset Enable 0 - Clock Monitor generates interrupt when error detected. 1 - Clock Monitor generates reset when error detected. Note: Implementation Specific Parameter.
          boolean McuSPLLClockMonitorEnable: origin=NXP, post-build-variant-value=true, set at pre-compile in variant pre-compile / post-build in variant post-build, default-value=false  # SCG_SPLLCSR[SPLLCM] - System PLL Clock Monitor Enables the clock monitor, if the clock source is disabled in a low power mode then the clock monitor is also disabled in the low power mode. When the clock monitor is disabled in a low power mode, it remains disabled until the clock valid flag is set following exit from the low power mode. 0 - RTC OSC Clock Monitor is disabled. 1 - RTC OSC Clock Monitor is enabled. Note: Implementation Specific Parameter.
          integer McuSPLLDiv2: 0..64, origin=NXP, post-build-variant-value=true, set at pre-compile in variant pre-compile / post-build in variant post-build, default-value=2  # Configures SCG_SPLLDIV[SPLLDIV2]. System PLL Clock Divider 2. Clock divider 2 for System PLL. Used by bus clock modules that need an asynchronous clock source. 0 - Output disabled. Note: Implementation specific Parameter.
          integer McuSPLLDiv1: 0..64, origin=NXP, post-build-variant-value=true, set at pre-compile in variant pre-compile / post-build in variant post-build, default-value=1  # Configures SCG_SPLLDIV[SPLLDIV1] System PLL Clock Divider 1. Clock divider 1 for System PLL. Used to generate the system clock source and by platform clock modules that need an asynchronous clock source. 0 - Output disabled. Note: Implementation specific Parameter.
          integer McuSPLLInputClkPreDivider: 1..8, origin=NXP, post-build-variant-value=true, set at pre-compile in variant pre-compile / post-build in variant post-build, default-value=1  # PLL Reference Clock Divider. Set the SPLL: SCG_SPLLCFG[PREDIV] field register. Selects the amount to divide down the reference clock for the System PLL. The resulting frequency must be in the range of 8 MHz to 50 MHz. Note: Implementation Specific Parameter.
          float McuSPLLInputFrequency: 8000000.0..4.0E7, origin=NXP, post-build-variant-value=true, set at pre-compile in variant pre-compile / post-build in variant post-build, default-value=8000000.0  # Resulted frequency after prediving. F = SPLL_ReferenceClock / McuSPLLInputClkPreDivider. Note: Implementation Specific Parameter.
          integer McuSPLLMultiplier: 16..47, origin=NXP, post-build-variant-value=true, set at pre-compile in variant pre-compile / post-build in variant post-build, default-value=24  # System PLL Multiplier. Set the SCG_SPLLCFG[MULT] field register. Valid range is in [16..47]. Note: Implementation Specific Parameter.
        container McuSIMClockConfig  # Configures SIM_CHIPCTL[TRACECLK_SEL], SIM_CHIPCTL[CLKOUTSEL] bits and SIM_PLATGC and SIM_CLKDIV4 registers. Note: Implementation specific Container.
          boolean McuDebugTraceDividerEnable: origin=NXP, post-build-variant-value=true, set at pre-compile in variant pre-compile / post-build in variant post-build, default-value=true  # SIM_CLKDIV4[TRACEDIVEN] - Debug Trace Divider Control 0 - Debug trace divider disabled. 1 - Debug trace divider enabled. Note: Implementation Specific Parameter.
          integer McuTraceClockDivider: 1..8, origin=NXP, post-build-variant-value=true, set at pre-compile in variant pre-compile / post-build in variant post-build, default-value=1  # Configures the SIM_CLKDIV4[TRACEDIV] bitfield Trace clock divider divisor - This field sets the divide value for the fractional clock divider used as a source for trace clock. The source clock for the trace clock is set by the SIM_CHIPCTRL[TRACECLK_SEL]. Divider output clock = Divider input clock * [(TRACEFRAC+1)/(TRACEDIV+1)]. Note: implementation specific parameter.
          integer McuTraceClockFraction: 0..1, origin=NXP, post-build-variant-value=true, set at pre-compile in variant pre-compile / post-build in variant post-build, default-value=0  # Configures the SIM_CLKDIV4[TRACEFRAC] bitfield Trace clock divider fraction - This field sets the divide value for the fractional clock divider used as a source for trace clock. The source clock for the trace clock is set by the SIM_CHIPCTRL[TRACECLK_SEL]. Divider output clock = Divider input clock * [(TRACEFRAC+1)/(TRACEDIV+1)]. Note: implementation specific parameter.
          enumeration McuTraceClockSelect: {CORE_CLK, PLATFORM_CLK}, origin=NXP, post-build-variant-value=true, set at pre-compile in variant pre-compile / post-build in variant post-build, default-value=CORE_CLK  # SIM_CHIPCTL[TRACECLK_SEL] - Debug trace clock select Selects core clock or platform clock as the trace clock source. Note: Implementation Specific Parameter.
          boolean McuClockOutEnable: origin=NXP, post-build-variant-value=true, set at pre-compile in variant pre-compile / post-build in variant post-build, default-value=false  # SIM_CHIPCTL[CLKOUTEN] - CLKOUT enable unchecked - Clockout disabled. checked - Clockout enabled. Note: Implementation Specific Parameter.
          integer McuClockOutDivider: 1..8, origin=NXP, post-build-variant-value=true, set at pre-compile in variant pre-compile / post-build in variant post-build, default-value=1  # Configures the SIM_CHIPCTL[CLKOUTDIV] bitfield CLKOUT Divide Ratio. Note: implementation specific parameter.
          enumeration McuClockOutSelect: {SCG_CLKOUT, SOSC_DIV2, SIRC_DIV2, FIRC_DIV2, HCLK, SPLL_DIV2, BUS_CLK, LPO_CLK_128K, LPO_CLK, RTC_CLK}, origin=NXP, post-build-variant-value=true, set at pre-compile in variant pre-compile / post-build in variant post-build, default-value=SCG_CLKOUT  # SIM_CHIPCTL[CLKOUTSEL] - CLKOUT select Selects the clock to output on the CLKOUT pin. 0 SCG_CLKOUT 2 SOSC_DIV2 4 SIRC_DIV2 5 QSPI_SFIF_CLK_HYP Divide by 2 clock (configured through SCLKCONFIG[5]) for HyperRAM going to sfif clock to QSPI(Specific for S32K148) 6 FIRC_DIV2 7 HCLK 8 SPLL_DIV2 9 BUS_CLK A LPO_CLK_128K B QSPI_IPG_CLK (Specific for S32K148) C LPO_CLK as selected by SIM_LPOCLKS[LPOCLKSEL] D QSPI_IPG_CLK_SFIF (Specific for S32K148) E RTC_CLK as selected by SIM CLK 32 KHz Select F QSPI_IPG_CLK_2XSFIF (Specific for S32K148) Note: Implementation Specific Parameter.
          boolean McuEIMClockGatingEnable: origin=NXP, post-build-variant-value=true, set at pre-compile in variant pre-compile / post-build in variant post-build, default-value=true  # SIM_PLATCGC[CGCEIM] - EIM Clock Gating Control Controls the clock gating to the EIM. 0 - Clock disabled. 1 - Clock enabled. Note: Implementation Specific Parameter.
          boolean McuERMClockGatingEnable: origin=NXP, post-build-variant-value=true, set at pre-compile in variant pre-compile / post-build in variant post-build, default-value=true  # SIM_PLATCGC[CGCERM] - ERM Clock Gating Control Controls the clock gating to the ERM. 0 - Clock disabled. 1 - Clock enabled. Note: Implementation Specific Parameter.
          boolean McuDMAClockGatingEnable: origin=NXP, post-build-variant-value=true, set at pre-compile in variant pre-compile / post-build in variant post-build, default-value=true  # SIM_PLATCGC[CGCDMA] - DMA Clock Gating Control Controls the clock gating to the DMA module. 0 - Clock disabled. 1 - Clock enabled. Note: Implementation Specific Parameter.
          boolean McuMPUClockGatingEnable: origin=NXP, post-build-variant-value=true, set at pre-compile in variant pre-compile / post-build in variant post-build, default-value=true  # SIM_PLATCGC[CGCMPU] - MPU Clock Gating Control Controls the clock gating to the MPU module. 0 - Clock disabled. 1 - Clock enabled. Note: Implementation Specific Parameter.
          boolean McuMSCMClockGatingEnable: origin=NXP, post-build-variant-value=true, set at pre-compile in variant pre-compile / post-build in variant post-build, default-value=true  # SIM_PLATCGC[CGCMSCM] - MSCM Clock Gating Control Controls the clock gating to the MSCM module. 0 - Clock disabled. 1 - Clock enabled. Note: Implementation Specific Parameter.
          boolean McuGPIOClockGatingEnable: origin=NXP, set at pre-compile in variant pre-compile / post-build in variant post-build, default-value=false  # SIM_PLATCGC[CGCGPIO] - GPIO Clock Gating Control Controls the clock gating to the GPIO module. 0 - Clock disabled. 1 - Clock enabled. Note: Implementation Specific Parameter.This bit is available in S32K11X variants only
        container McuClkMonitor_0  # This container contains the specific configuration (parameters) of the Monitor_0. Clock Monitor Unit for Motor Clock. This parameter is enabled only if "McuClockSrcFailureNotification" is enabled. Note: Implementation Specific Parameter.
          boolean McuClkMonitorEn: origin=NXP, post-build-variant-value=true, set at pre-compile in variant pre-compile / post-build in variant post-build, default-value=false  # Enables/Disables the clock monitor (CMU_GCR[FCE]). Note: Implementation Specific Parameter.This bit is available in S32K11X variants only
          boolean McuFrequencyHigherInterrupt: origin=NXP, post-build-variant-value=true, set at pre-compile in variant pre-compile / post-build in variant post-build, default-value=false  # Enables/Disables FHH asynchronous interrupt at the module boundary (CMU0_IER[FHHAIE]). Note: Implementation Specific Parameter.This bit is available in S32K11X variants only
          boolean McuFrequencyLowerInterrupt: origin=NXP, post-build-variant-value=true, set at pre-compile in variant pre-compile / post-build in variant post-build, default-value=false  # Enables/Disables FLL asynchronous interrupt at the module boundary (CMU0_IER[FLLAIE]). Note: Implementation Specific Parameter.This bit is available in S32K11X variants only
          integer McuReferenceCountConfiguration: 0..65535, origin=NXP, post-build-variant-value=true, set at pre-compile in variant pre-compile / post-build in variant post-build, default-value=65535  # Set the CMU0: CMU_RCCR[REF_CNT] field register. CMU_RCCR[REF_CNT] is the number of reference clock counts that the frequency check runs. This field defines the duration of one frequency check window. Note: Implementation Specific Parameter.This bit is available in S32K11X variants only
          integer McuHighFrequencyRef: 0..16777215, origin=NXP, post-build-variant-value=true, set at pre-compile in variant pre-compile / post-build in variant post-build, default-value=16777215  # The value of the Max Frequency. CMU0 detects if the monitored clock is greater than McuHighFrequencyRef. The HCTR[HFREF] value is determined by the equation: (( fMonitored_clock / fReference_clock ) * RCCR[REF_CNT] ) + high threshold margin Note: Implementation Specific Parameter.This bit is available in S32K11X variants only
          integer McuLowFrequencyRef: 0..16777215, origin=NXP, post-build-variant-value=true, set at pre-compile in variant pre-compile / post-build in variant post-build, default-value=0  # The value of the Min Frequency. CMU0 detects if the monitored clock is smaller than McuLowFrequencyRef. LCTR[LFREF] determines the low reference value for the monitored clock frequency. The LCTR[LFREF] value is determined by the equation: fMonitored_clock / fReference_clock * RCCR[REF_CNT] ? low threshold margin. Note: Implementation Specific Parameter.This bit is available in S32K11X variants only
        container McuClkMonitor_1  # This container contains the specific configuration (parameters) of the Monitor_1. Clock Monitor Unit for Motor Clock. This parameter is enabled only if "McuClockSrcFailureNotification" is enabled. Note: Implementation Specific Parameter.
          boolean McuClkMonitorEn: origin=NXP, post-build-variant-value=true, set at pre-compile in variant pre-compile / post-build in variant post-build, default-value=false  # Enables/Disables the clock monitor (CMU_GCR[FCE]). Note: Implementation Specific Parameter.This bit is available in S32K11X variants only
          boolean McuFrequencyHigherInterrupt: origin=NXP, post-build-variant-value=true, set at pre-compile in variant pre-compile / post-build in variant post-build, default-value=false  # Enables/Disables FHH interrupt at the module boundary (CMU1_IER[FHHIE]). Note: Implementation Specific Parameter.This bit is available in S32K11X variants only
          boolean McuFrequencyLowerInterrupt: origin=NXP, post-build-variant-value=true, set at pre-compile in variant pre-compile / post-build in variant post-build, default-value=false  # Enables/Disables FLL interrupt at the module boundary.(CMU1_IER[FLLIE]). Note: Implementation Specific Parameter.This bit is available in S32K11X variants only
          integer McuReferenceCountConfiguration: 0..65535, origin=NXP, post-build-variant-value=true, set at pre-compile in variant pre-compile / post-build in variant post-build, default-value=65535  # Set the CMU0: CMU_RCCR[REF_CNT] field register. CMU_RCCR[REF_CNT] is the number of reference clock counts that the frequency check runs. This field defines the duration of one frequency check window. Note: Implementation Specific Parameter.This bit is available in S32K11X variants only
          integer McuHighFrequencyRef: 0..16777215, origin=NXP, post-build-variant-value=true, set at pre-compile in variant pre-compile / post-build in variant post-build, default-value=16777215  # The value of the Max Frequency. CMU0 detects if the monitored clock is greater than McuHighFrequencyRef. The HCTR[HFREF] value is determined by the equation: (( fMonitored_clock / fReference_clock ) * RCCR[REF_CNT] ) + high threshold margin Note: Implementation Specific Parameter.This bit is available in S32K11X variants only
          integer McuLowFrequencyRef: 0..16777215, origin=NXP, post-build-variant-value=true, set at pre-compile in variant pre-compile / post-build in variant post-build, default-value=0  # The value of the Min Frequency. CMU0 detects if the monitored clock is smaller than McuLowFrequencyRef. LCTR[LFREF] determines the low reference value for the monitored clock frequency. The LCTR[LFREF] value is determined by the equation: fMonitored_clock / fReference_clock * RCCR[REF_CNT] ? low threshold margin. Note: Implementation Specific Parameter.This bit is available in S32K11X variants only
        container McuPeripheralClockConfig [32..32]  # This contains the combination for current peripheral in Run and LowPower Mode. Note: Implementation Specific Container.
          enumeration McuPerName: {FTFC, DMAMUX0, FLEXCAN0, FLEXCAN1, FTM3, ADC1, FLEXCAN2, LPSPI0, LPSPI1, LPSPI2, PDB1, CRC, PDB0, LPIT, FTM0, FTM1, FTM2, ADC0, RTC, LPTMR0, PORTA, PORTB, PORTC, PORTD, PORTE, FLEXIO, EWM, LPI2C0, LPUART0, LPUART1, LPUART2, CMP0}, origin=NXP, post-build-variant-value=true, set at pre-compile in variant pre-compile / post-build in variant post-build, default-value=FTFC  # This is the name of the peripheral. Note: Implementation Specific Parameter.
          boolean McuPeripheralClockEnable: origin=NXP, post-build-variant-value=true, set at pre-compile in variant pre-compile / post-build in variant post-build, default-value=true  # Sets PCC_[peripheral][CGC] bit. This read/write bit enables the clock for the peripheral. 0 - Clock disabled. 1 - Clock enabled. Note: Implementation Specific Parameter.
          enumeration McuPeripheralClockSelect: {EXT_CLK_OR_CLK_OFF, SOSC, SIRC, FIRC, SPLL}, origin=NXP, post-build-variant-value=true, set at pre-compile in variant pre-compile / post-build in variant post-build, default-value=EXT_CLK_OR_CLK_OFF  # Configures PCC_[peripheral][PCS]. This is used for peripherals that support various clock selections. If the peripheral does not support various clock selections the field won't be editable. This field can only be written when the CGC bit is 0 (clock disabled). Likewise, if the INUSE flag is set, this field is locked. 0 - Clock is off (or external clock as selected by FTMnCLKSEL for FTM modules). 1 - SOSCDIV2_CLK (SOCDIV1_CLK for FTM modules) 2 - SIRCDIV2_CLK (SIRCDIV1_CLK for FTM modules) 3 - FIRCDIV2_CLK (FIRCDIV1_CLK for FTM modules) 6 - SPLLDIV2_CLK (SPLLDIV1_CLK for FTM modules) Note: Please make sure that the divider of clock source is not 0 . Note: Implementation Specific Parameter. If the field is not editable, it means the bit field is read only and the value will not be used.
          integer McuPeripheralClockDivider: 1..8, origin=NXP, post-build-variant-value=true, set at pre-compile in variant pre-compile / post-build in variant post-build, default-value=1  # Configures PCC_[peripheral][PCD]. This is used for peripherals that require a clock divider. At SOC integration, each peripheral is assigned either a divider or not. This field can only be written when the CGC bit is 0 (clock disabled). Likewise, if the INUSE flag is set, this field is locked. Allowed values are from 1 to 8. Note: Implementation Specific Parameter. If the field is not editable, it means the bit field is read only and the value will not be used.
          integer McuPeripheralFractionalDivider: 0..1, origin=NXP, post-build-variant-value=true, set at pre-compile in variant pre-compile / post-build in variant post-build, default-value=0  # Configures PCC_[peripheral][FRAC]. This sets the fraction multiply value for the fractional clock divider used as a clock source. Divider output clock = Divider input clock x [(FRAC+1)/(DIV+1)]. This field can only be written when the CGC bit is 0 (clock disabled). Likewise, if the INUSE flag is set, this field is locked. 0 - Fractional value is 0. 1 - Fractional value is 1. Note: Implementation Specific Parameter. If the field is not editable, it means the bit field is read only and the value will not be used.
          float McuPeripheralClockFrequency: 0.0..1.12E8, origin=NXP, post-build-variant-value=true, set at pre-compile in variant pre-compile / post-build in variant post-build, default-value=0.0  # Divider output clock = Divider input clock x [(FRAC+1)/(DIV+1)]. This is only calculated if the clock source is selectable and if the peripheral is enabled. This is the frequency for the specific instance of the "McuClockReferencePoint" container. Value calculated for user info. It is given in Hz. Note: The maximum frequency of LPUARTx, LPSPIx, LPI2Cx, FLEXIO, LPTMR0 and LPIT are governed by BUS_CLK, FTMx are governed by SYS_CLK, ADCx are 50MHz but always less than BUS_CLK. So please check configuration value is fit for SYS_CLK and BUS_CLK values correspond to MCU mode. Note: Implementation Specific Parameter.
        container McuClockReferencePoint [1..*]: multiplicity set at pre-compile  # This container defines a reference point in the Mcu Clock tree. It defines the frequency which then can be used by other modules as an input value. Lower multiplictiy is 1, as even in the simpliest case (only one frequency is used), there is one frequency to be defined.
          float McuClockReferencePointFrequency: 0.0..3.2E8, scope=ECU, post-build-variant-value=true, set at pre-compile in variant pre-compile / post-build in variant post-build, default-value=4.8E7  # This is the frequency for the specific instance of the McuClockReferencePoint container. It shall be given in Hz. Calculated value.
          enumeration McuClockFrequencySelect: {CUSTOM, FIRC_CLK, FIRCDIV2_CLK, FIRCDIV1_CLK, SIRC_CLK, SIRCDIV2_CLK, SIRCDIV1_CLK, SOSC_CLK, SOSCDIV2_CLK, SOSCDIV1_CLK, LPO_CLK_128K, LPO_CLK_32K, LPO_CLK_1K, SPLL_CLK, SPLLDIV2_CLK, SPLLDIV1_CLK, RUN_CORE_CLK, RUN_SYS_CLK, RUN_FLASH_CLK, RUN_BUS_CLK, HSRUN_CORE_CLK, HSRUN_SYS_CLK, HSRUN_FLASH_CLK, HSRUN_BUS_CLK, VLPR_CORE_CLK, VLPR_SYS_CLK, VLPR_FLASH_CLK, VLPR_BUS_CLK, FTM3_CLK, ADC1_CLK, LPSPI0_CLK, LPSPI1_CLK, LPSPI2_CLK, LPIT_CLK, FTM0_CLK, FTM1_CLK, FTM2_CLK, ADC0_CLK, LPTMR0_CLK, FLEXIO_CLK, LPI2C0_CLK, LPUART0_CLK, LPUART1_CLK, LPUART2_CLK}, origin=NXP, post-build-variant-value=true, set at pre-compile in variant pre-compile / post-build in variant post-build, default-value=RUN_SYS_CLK  # Select clock source for the specific instance of the McuClockReferencePoint container. Note: The clock frequency configured in McuPeripheralClockConfig should be used to export the clock frequency through McuClockReferencePoint. This reference point should be used in the configuration of the module that uses it (SPI, I2C, GPT, etc.). If the configured module has also an internal clock selection (like FlexTimer for example), the clock reference point should be configured taking the internal clock selection into account and the reference used should reflect the clock that finally enters the used peripheral.
      container McuDemEventParameterRefs [0..1]: multiplicity set at pre-compile  # Container for the references to DemEventParameter elements which shall be invoked using the API Dem_ReportErrorStatus API in case the corresponding error occurs. The EventId is taken from the referenced DemEventParameter's DemEventId value. The standardized errors are provided in the container and can be extended by vendor specific error references.
        symbolic name reference MCU_E_TIMEOUT_FAILURE [0..1]: multiplicity set at pre-compile, origin=NXP, set at pre-compile, destination=DemEventParameter  # Reference to configured DEM event to report Timeout failure.
        symbolic name reference MCU_E_CLOCK_FAILURE [0..1]: multiplicity set at pre-compile, set at pre-compile, destination=DemEventParameter  # Reference to configured DEM event to report Clock source failure.
      container McuModeSettingConf [1..*]: multiplicity set at pre-compile  # This container contains the configuration for the Mode setting of the MCU. Note: Implementation Specific Parameter.
        integer McuMode: 0..255, set at pre-compile, symbolic-name-value=true, default-value=0  # This parameter shall represent the ID of the MCU mode.
        enumeration McuPowerMode: {RUN, HSRUN, VLPR, VLPS, STOP1, STOP2}, origin=NXP, post-build-variant-value=true, set at pre-compile in variant pre-compile / post-build in variant post-build, default-value=RUN  # This parameter selects the Power Mode to be used. For valid Mode transitions refers to Power mode state diagram from Reference Manual. Note: Implementation Specific Parameter.
      container McuRamSectorSettingConf [0..*]: multiplicity set at pre-compile  # This container contains the configuration for the RAM Sector setting.
        integer McuRamSectorId: 0..4294967295, origin=NXP, set at pre-compile, symbolic-name-value=true, default-value=0  # This parameter shall represent the ID of the MCU RAM Sector configuration.
        integer McuRamDefaultValue: 0..255, post-build-variant-value=true, set at pre-compile in variant pre-compile / post-build in variant post-build, default-value=0  # This parameter shall represent the Data pre-setting to be initialized. Default value is 0xbabababa. Note: Implementation Specific Parameter.
        integer McuRamSectionBaseAddress: 536838144..536903679, post-build-variant-value=true, set at pre-compile in variant pre-compile / post-build in variant post-build, default-value=536869888  # This parameter represents the RAM section base address. The address must be aligned to 4 bytes. Note: Implementation Specific Parameter.
        integer McuRamSectionSize: 0..65535, post-build-variant-value=true, set at pre-compile in variant pre-compile / post-build in variant post-build, default-value=1024  # This parameter represents the RAM section size in bytes. The size must be multiple of 4. Note: Implementation Specific Parameter.
        string McuRamSectionBaseAddrLinkerSym: origin=NXP, post-build-variant-value=true, set at pre-compile in variant pre-compile / post-build in variant post-build  # This parameter represents the RAM section base address. The address must be aligned to 4 bytes. If this parameter is empty, then the integer values from "McuRamSectionBaseAddress" will be used. Note: Implementation Specific Parameter.
        string McuRamSectionSizeLinkerSym: origin=NXP, post-build-variant-value=true, set at pre-compile in variant pre-compile / post-build in variant post-build  # This parameter represents the RAM section size in bytes. The size must be multiple of 4. If this parameter is empty, then the integer values from "McuRamSectionSize" will be used. Note: Implementation Specific Parameter.
      container McuInterruptEvents  # Configuration for different interrupts handled by MCU. Note: Implementation specific Container.
        boolean McuVoltageErrorEvent: origin=NXP, set at pre-compile, default-value=false  # Power Management Unit Fault Monitoring Interrupts. Note: Implementation Specific Parameter.
        boolean McuAlternateResetEvent: origin=NXP, set at pre-compile, default-value=false  # Some events can generate an interrupt from RCM. Note: Implementation Specific Parameter.
      container McuResetConfig  # The Reset Control Module (MC_RCM) centralizes the different reset sources and manages the reset sequence of the device. Note: Implementation Specific Parameter.
        integer McuResetPinFilterBusClockSelect: 0..31, origin=NXP, post-build-variant-value=true, set at pre-compile in variant pre-compile / post-build in variant post-build, default-value=0  # RCM_RPC[RSTFLTSEL] - Reset Pin Filter Bus Clock Select. Selects the reset pin bus clock filter width. Transitions for less than (RSTFLTSEL+1) bus clock cycles are always filtered, transitions equal to (RSTFLTSEL+1) bus clock cycles may be filtered. Note: Implementation Specific Parameter.
        enumeration McuResetPinFilterInStopMode: {ALL_FILTERING_DISABLE, LPO_CLOCK_FILTER_ENABLE}, origin=NXP, post-build-variant-value=true, set at pre-compile in variant pre-compile / post-build in variant post-build, default-value=ALL_FILTERING_DISABLE  # RCM_RPC[RSTFLTSS] - Reset Pin Filter Select in Stop Mode. Selects how the reset pin filter is enabled in any stop mode. 0 - All filtering disabled. 1 - LPO clock filter enabled. Note: Implementation Specific Parameter.
        enumeration McuResetPinFilterInRunAndWait: {ALL_FILTERING_DISABLE, BUS_CLOCK_FILTER_ENABLE, LPO_CLOCK_FILTER_ENABLE}, origin=NXP, post-build-variant-value=true, set at pre-compile in variant pre-compile / post-build in variant post-build, default-value=ALL_FILTERING_DISABLE  # RCM_RPC[RSTFLTSRW] - Reset Pin Filter Select in Run and Wait Modes. Selects how the reset pin filter is enabled in run and wait modes. 0 - All filtering disabled. 1 - Bus clock filter enabled for normal operation. 2 - LPO clock filter enabled for normal operation. Note: Implementation Specific Parameter.
        container McuSystemInterruptEnable  # Configures RCM_SRIE This registers delays the assertion of a system reset for a period of time (DELAY field) while an interrupt is generated. This allows software to perform a graceful shutdown. A Chip POR source cannot be delayed by this feature, and entering Stop mode will terminate the delay. The SRS will only update after the system reset occurs. Note: Implementation specific Container.
          enumeration McuResetDelayTime: {DELAY_10_LPO_CYCLES, DELAY_34_LPO_CYCLES, DELAY_130_LPO_CYCLES, DELAY_514_LPO_CYCLES}, origin=NXP, post-build-variant-value=true, set at pre-compile in variant pre-compile / post-build in variant post-build, default-value=DELAY_10_LPO_CYCLES  # RCM_SRIE[DELAY] - Reset Delay Time. Configures the maximum reset delay time from when the interrupt is asserted and the system reset occurs. 0 - 10 LPO cycles. 1 - 34 LPO cycles. 2 - 130 LPO cycles. 2 - 514 LPO cycles. Note: Implementation Specific Parameter.
          boolean McuStopAcknowledgeErrorInterrupt: origin=NXP, post-build-variant-value=true, set at pre-compile in variant pre-compile / post-build in variant post-build, default-value=false  # RCM_SRIE[SACKERR] - Stop Acknowledge Error Interrupt. 0 - Interrupt disabled. 1 - Interrupt enabled. Note: Implementation Specific Parameter.
          boolean McuMDMAPSystemResetInterrupt: origin=NXP, post-build-variant-value=true, set at pre-compile in variant pre-compile / post-build in variant post-build, default-value=false  # RCM_SRIE[MDM_AP] - MDM-AP System Reset Request. 0 - Interrupt disabled. 1 - Interrupt enabled. Note: Implementation Specific Parameter.
          boolean McuSoftwareInterrupt: origin=NXP, post-build-variant-value=true, set at pre-compile in variant pre-compile / post-build in variant post-build, default-value=false  # RCM_SRIE[SW] - Software Interrupt. 0 - Interrupt disabled. 1 - Interrupt enabled. Note: Implementation Specific Parameter.
          boolean McuCoreLockupInterrupt: origin=NXP, post-build-variant-value=true, set at pre-compile in variant pre-compile / post-build in variant post-build, default-value=false  # RCM_SRIE[LOCKUP] - Core Lockup Interrupt. 0 - Interrupt disabled. 1 - Interrupt enabled. Note: Implementation Specific Parameter.
          boolean McuJTAGResetInterrupt: origin=NXP, post-build-variant-value=true, set at pre-compile in variant pre-compile / post-build in variant post-build, default-value=false  # RCM_SRIE[JTAG] - JTAG generated reset. 0 - Interrupt disabled. 1 - Interrupt enabled. Note: Implementation Specific Parameter.
          boolean McuGlobalInterrupt: origin=NXP, post-build-variant-value=true, set at pre-compile in variant pre-compile / post-build in variant post-build, default-value=false  # RCM_SRIE[GIE] - Global Interrupt Enable. 0 - All interrupt sources disabled. 1 - All interrupt sources enabled. Note: Implementation Specific Parameter.
          boolean McuExternalResetPinInterrupt: origin=NXP, post-build-variant-value=true, set at pre-compile in variant pre-compile / post-build in variant post-build, default-value=false  # RCM_SRIE[PIN] - External Reset Pin Interrupt. 0 - Interrupt disabled. 1 - Interrupt enabled. Note: Implementation Specific Parameter.
          boolean McuWatchdogInterrupt: origin=NXP, post-build-variant-value=true, set at pre-compile in variant pre-compile / post-build in variant post-build, default-value=false  # RCM_SRIE[WDOG] - Watchdog Interrupt. 0 - Interrupt disabled. 1 - Interrupt enabled. Note: Implementation Specific Parameter.
          boolean McuCMULossOfClockResetInterrupt: origin=NXP, post-build-variant-value=true, set at pre-compile in variant pre-compile / post-build in variant post-build, default-value=false  # RCM_SRIE[CMU_LOC] - CMU Loss-of-Clock Reset Interrupt. 0 - Interrupt disabled. 1 - Interrupt enabled. Note: Implementation Specific Parameter.
          boolean McuLossOfLockInterrupt: origin=NXP, post-build-variant-value=true, set at pre-compile in variant pre-compile / post-build in variant post-build, default-value=false  # RCM_SRIE[LOL] - Loss of Lock Interrupt. 0 - Interrupt disabled. 1 - Interrupt enabled. Note: Implementation Specific Parameter.
          boolean McuLossOfClockInterrupt: origin=NXP, post-build-variant-value=true, set at pre-compile in variant pre-compile / post-build in variant post-build, default-value=false  # RCM_SRIE[LOC] - Loss of Clock Interrupt. 0 - Interrupt disabled. 1 - Interrupt enabled. Note: Implementation Specific Parameter.
      container McuPowerControl  # Note: Implementation Specific Parameter.
        boolean McuLowVoltageDetectInterruptEnable: origin=NXP, post-build-variant-value=true, set at pre-compile in variant pre-compile / post-build in variant post-build, default-value=false  # PMC_LVDSC1[LVDIE] - Low Voltage Detect Interrupt Enable. This bit enables hardware interrupt requests for LVDF. 0 - Hardware interrupt disabled (use polling). 1 - Request a hardware interrupt when LVDF = 1. Note: Implementation Specific Parameter.
        boolean McuLowVoltageDetectResetEnable: origin=NXP, post-build-variant-value=true, set at pre-compile in variant pre-compile / post-build in variant post-build, default-value=false  # PMC_LVDSC1[LVDRE] - Low Voltage Detect Reset Enable. This bit enables the low voltage detect events to generate a system reset. 0 - No system resets on low voltage detect events. 1 - If the supply voltage falls below VLVD, a system reset will be generated. Note: Implementation Specific Parameter.
        boolean McuLowVoltageWarningInterruptEnable: origin=NXP, post-build-variant-value=true, set at pre-compile in variant pre-compile / post-build in variant post-build, default-value=false  # PMC_LVDSC2[LVWIE] - Low-Voltage Warning Interrupt Enable. This bit enables hardware interrupt requests for LVWF. 0 - Hardware interrupt disabled (use polling). 1 - Request a hardware interrupt when LVWF = 1. Note: Implementation Specific Parameter.
        boolean McuLPODisable: origin=NXP, post-build-variant-value=true, set at pre-compile in variant pre-compile / post-build in variant post-build, default-value=false  # PMC_REGSC[LPODIS] - This bit enables or disable the low power oscillator. After disabling the LPO a time of 2 LPO clock cycles is required before it is allowed to enable it again. Violating this waiting time of 2 cycles can result in malfunction of the LPO. unchecked - Low power oscillator enabled. checked - Low power oscillator disabled. Note: Implementation Specific Parameter.
        boolean McuClockBiasDisable: origin=NXP, post-build-variant-value=true, set at pre-compile in variant pre-compile / post-build in variant post-build, default-value=false  # PMC_REGSC[CLKBIASDIS] - Clock Bias Disable Bit. This bit disables the bias currents and reference voltages for some clock modules in order to further reduce power consumption in VLPS mode. Note: While using this bit, it must be ensured that respective clock modules are disabled in VLPS mode. Else, severe malfunction of clock modules will happen. unchecked - No effect. checked - In VLPS mode, the bias currents and reference voltages for the following clock modules are disabled: SIRC, FIRC, PLL. Note: Implementation Specific Parameter.
        boolean McuLowPowerBiasEnable: origin=NXP, post-build-variant-value=true, set at pre-compile in variant pre-compile / post-build in variant post-build, default-value=false  # PMC_REGSC[BIASEN] - Bias Enable Bit. This bit enables source and well biasing for the core logic in low power mode. In full performance mode this bit has no effect. This is useful to further reduce MCU power consumption in low power mode. unchecked - Biasing disabled, core logic can run in full performance. checked - Biasing enabled, core logic is slower and there are restrictions in allowed system clock speed. Note: Implementation Specific Parameter.
        integer McuLpoTrimming: 0..31, origin=NXP, set at pre-compile in variant pre-compile / post-build in variant post-build, default-value=0  # Configures the PMC_LPOTRIM[LPOTRIM] bitfield. These bits are used for trimming the frequency of the low power oscillator: 10000 - Period of LPO clock is lowest 10001 to 11111 - Period of LPO clock is increasing 00000 - Period of LPO clock is typical 128 kHz 00001 to 01110 - Period of LPO clock is increasing 01111 - Period of LPO clock is highest Note: implementation specific parameter.
