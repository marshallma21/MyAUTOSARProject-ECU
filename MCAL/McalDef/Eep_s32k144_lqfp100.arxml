AUTOSAR XML (schema 4-3-0)
package /TS_T40D2M10I2R0
  ecuc definition collection Eep_EcuParameterDefinition: module=Eep
  module definition Eep [1..*]: refined-module-def=Eep, variants post-build/pre-compile  # Configuration of the Eep (internal or external eeprom driver) module.
    container EepInitConfiguration  # Container for runtime configuration parameters of the eeprom driver. Implementation Type: Eep_ConfigType.
      integer EepSize: 0..4294967295, post-build-variant-value=true, set at post-build in variant post-build / pre-compile in variant pre-compile, default-value=4096  # This parameter is the used size of EEPROM device in bytes.
      integer EepBaseAddress: 0..4294967295, post-build-variant-value=true, set at post-build in variant post-build / pre-compile in variant pre-compile, default-value=335544320  # The eeprom memory start address (see also EEP118). EEP169: This parameter defines the lower boundary for read / write / erase and compare jobs.Note:Not needed / supported by the driver.
      integer EepAcWrite: 0..4294967295, origin=NXP, post-build-variant-value=true, set at post-build in variant post-build / pre-compile in variant pre-compile, default-value=1073751296  # Address offset in RAM to which the erase eeprom access code shall be loaded. Used as function pointer to access the erase eeprom access code. Note: To use Eep Access Code Erase be sure Eep Access Code Erase Pointer is NULL or NULL_PTR.
      function name EepAcWritePointer: origin=NXP, post-build-variant-value=true, set at post-build in variant post-build / pre-compile in variant pre-compile, default-value=NULL_PTR  # Vendor specific: Pointer in RAM to which the write eeprom access code shall be loaded. Used as function pointer to access the write eeprom access code.
      float EepJobCallCycle: 0.0..1.0, post-build-variant-value=true, set at post-build in variant post-build / pre-compile in variant pre-compile, default-value=0.0  # Cycle time of calls of the eeprom driver main functionNote:Not supported by the driver.
      enumeration EepDefaultMode: {MEMIF_MODE_FAST, MEMIF_MODE_SLOW}, post-build-variant-value=true, set at post-build in variant post-build / pre-compile in variant pre-compile, default-value=MEMIF_MODE_SLOW  # This parameter is the default EEP device mode after initialization.
      function name EepACCallback [0..1]: multiplicity set at post-build in variant post-build / pre-compile in variant pre-compile, origin=NXP, post-build-variant-multiplicity=true, post-build-variant-value=true, set at post-build in variant post-build / pre-compile in variant pre-compile, default-value=Eep_AC_Callback  # Vendor specific: Mapped to the Access Code Callback provided by some upper layer module, typically the Wdg module. Note: Disable the Access Code Callback to have it set as NULL_PTR.
      function name EepJobEndNotification [0..1]: multiplicity set at post-build in variant post-build / pre-compile in variant pre-compile, post-build-variant-multiplicity=true, post-build-variant-value=true, set at post-build in variant post-build / pre-compile in variant pre-compile, default-value=Ea_JobEndNotification  # Mapped to the job end notification routine provided by some upper layer module, typically the Fee module. Note: Disable the end notification to have it set as NULL_PTR
      function name EepJobErrorNotification [0..1]: multiplicity set at post-build in variant post-build / pre-compile in variant pre-compile, post-build-variant-multiplicity=true, post-build-variant-value=true, set at post-build in variant post-build / pre-compile in variant pre-compile, default-value=Ea_JobErrorNotification  # Mapped to the job error notification routine provided by some upper layer module, typically the Fee module. Note: Disable the error notification to have it set as NULL_PTR
      function name EepStartEepromAccessNotif [0..1]: multiplicity set at post-build in variant post-build / pre-compile in variant pre-compile, origin=NXP, post-build-variant-multiplicity=true, post-build-variant-value=true, set at post-build in variant post-build / pre-compile in variant pre-compile, default-value=Eep_StartEepromAccessNotif  # Start eeprom access. If configured, this notification will be called before any EFLASH memory access in synchronuous mode. The purpose of this notification together with EepFinishedEepromAccess, is to be used by the integrator in case operations are needed before and after EFLASH access, for eg to avoid concurrent access issue.
      function name EepFinishedEepromAccessNotif [0..1]: multiplicity set at post-build in variant post-build / pre-compile in variant pre-compile, origin=NXP, post-build-variant-multiplicity=true, post-build-variant-value=true, set at post-build in variant post-build / pre-compile in variant pre-compile, default-value=Eep_FinishedEepromAccessNotif  # Finished eeprom access. If configured, this notification will be called before any EFLASH memory access in synchronuous mode. The purpose of this notification together with EepStartEepromAccess, is to be used by the integrator in case operations are needed before and after EFLASH access, for eg to avoid concurrent access issue.
      integer EepFastReadBlockSize: 0..4294967295, post-build-variant-value=true, set at post-build in variant post-build / pre-compile in variant pre-compile, default-value=128  # The maximum number of bytes to read or compare in one cycle of the eeprom driver's job processing function in fast mode.
      integer EepNormalReadBlockSize: 0..4294967295, post-build-variant-value=true, set at post-build in variant post-build / pre-compile in variant pre-compile, default-value=128  # The maximum number of bytes to read or compare in one cycle of the eeprom driver's job processing function in normal mode.
      integer EepFastWriteBlockSize: 0..4294967295, post-build-variant-value=true, set at post-build in variant post-build / pre-compile in variant pre-compile, default-value=128  # The maximum number of bytes to write in one cycle of the eeprom driver's job processing function in fast mode.
      integer EepNormalWriteBlockSize: 0..4294967295, post-build-variant-value=true, set at post-build in variant post-build / pre-compile in variant pre-compile, default-value=128  # The maximum number of bytes to write in one cycle of the eeprom driver's job processing function in normal mode.
      container EepDemEventParameterRefs [0..1]: multiplicity set at pre-compile in variant pre-compile / post-build in variant post-build  # Container for the references to DemEventParameter elements which shall be invoked using the Dem_ReportErrorStatus API in case the corresponding error occurs. The EventId is taken from the referenced DemEventParameter's DemEventId value. The standardized errors are provided in the container and can be extended by vendor specific error references.
        symbolic name reference EEP_E_COMPARE_FAILED [0..1]: multiplicity set at post-build in variant post-build / pre-compile in variant pre-compile, post-build-variant-multiplicity=true, post-build-variant-value=true, set at post-build in variant post-build / pre-compile in variant pre-compile, destination=DemEventParameter  # Reference to the DemEventParameter which shall be issued when the error "Eeprom compare failed (HW)" has occurred.
        symbolic name reference EEP_E_ERASE_FAILED [0..1]: multiplicity set at post-build in variant post-build / pre-compile in variant pre-compile, post-build-variant-multiplicity=true, post-build-variant-value=true, set at post-build in variant post-build / pre-compile in variant pre-compile, destination=DemEventParameter  # Reference to the DemEventParameter which shall be issued when the error "Eeprom erase failed (HW)" has occurred.
        symbolic name reference EEP_E_READ_FAILED [0..1]: multiplicity set at post-build in variant post-build / pre-compile in variant pre-compile, post-build-variant-multiplicity=true, post-build-variant-value=true, set at post-build in variant post-build / pre-compile in variant pre-compile, destination=DemEventParameter  # Reference to the DemEventParameter which shall be issued when the error "Eeprom read failed (HW)" has occurred.
        symbolic name reference EEP_E_WRITE_FAILED [0..1]: multiplicity set at post-build in variant post-build / pre-compile in variant pre-compile, post-build-variant-multiplicity=true, post-build-variant-value=true, set at post-build in variant post-build / pre-compile in variant pre-compile, destination=DemEventParameter  # Reference to the DemEventParameter which shall be issued when the error "Eeprom write failed (HW)" has occurred.
        symbolic name reference EEP_E_BO_MAINTENANCE [0..1]: multiplicity set at post-build in variant post-build / pre-compile in variant pre-compile, origin=NXP, post-build-variant-multiplicity=true, post-build-variant-value=true, set at post-build in variant post-build / pre-compile in variant pre-compile, destination=DemEventParameter  # Reference to the DemEventParameter which shall be issued when the error "Brown out detected before completing EEPROM quick write maintenance (HW)" has occurred.
        symbolic name reference EEP_E_BO_QUICK_WRITES [0..1]: multiplicity set at post-build in variant post-build / pre-compile in variant pre-compile, origin=NXP, post-build-variant-multiplicity=true, post-build-variant-value=true, set at post-build in variant post-build / pre-compile in variant pre-compile, destination=DemEventParameter  # Reference to the DemEventParameter which shall be issued when the error "Brown out detected before completing EEPROM quick writes (HW)" has occurred.
        symbolic name reference EEP_E_BO_NORMAL_WRITES [0..1]: multiplicity set at post-build in variant post-build / pre-compile in variant pre-compile, origin=NXP, post-build-variant-multiplicity=true, post-build-variant-value=true, set at post-build in variant post-build / pre-compile in variant pre-compile, destination=DemEventParameter  # Reference to the DemEventParameter which shall be issued when the error "Brown out detected before completing EEPROM normal writes (HW)" has occurred.
      container EepExternalDriver [0..1]: multiplicity set at pre-compile in variant pre-compile / post-build in variant post-build  # This container is present for external Eeprom drivers only. Internal Eeprom drivers do not use the parameter listed in this container, hence its multiplicity is 0 for internal drivers.
        symbolic name reference EepSpiReference [1..*]: multiplicity set at post-build in variant post-build / pre-compile in variant pre-compile, set at post-build in variant post-build / pre-compile in variant pre-compile, destination=SpiSequence  # Reference to SPI sequence (required for external Eeprom drivers).
    container NonAutosar  # Vendor specific: This container contains the global Non-Autosar configuration parameters of the Eep driver. This container is a MultipleConfigurationContainer, i.e. this container and its sub-containers exist once per configuration set.
      boolean EepAcLoadOnJobStart: origin=NXP, set at pre-compile, default-value=false  # The eeprom driver shall load the eeprom access code to RAM whenever an erase or write job is started and unload (overwrite) it after that job has been finished or canceled. true: Eeprom access code loaded on job start / unloaded on job end or error. false: Eeprom access code not loaded to / unloaded from RAM.
      boolean EepCancelApi: origin=NXP, set at pre-compile, default-value=true  # Compile switch to enable and disable the Eep_Cancel function. true: API supported / function provided. false: API not supported / function not provided
      boolean EepCompareApi: origin=NXP, set at pre-compile, default-value=true  # Compile switch to enable and disable the Eep_Compare function. true: API supported / function provided. false: API not supported / function not provided
      boolean EepGetJobResultApi: origin=NXP, set at pre-compile, default-value=true  # Compile switch to enable and disable the Eep_GetJobResult function. true: API supported / function provided. false: API not supported / function not provided
      boolean EepGetStatusApi: origin=NXP, set at pre-compile, default-value=true  # Compile switch to enable and disable the Eep_GetStatus function. true: API supported / function provided. false: API not supported / function not provided
      boolean EepSetModeApi: origin=NXP, set at pre-compile, default-value=true  # Compile switch to enable and disable the Eep_SetMode function. true: API supported / function provided. false: API not supported / function not provided
      boolean EepEnableQuickWriteApi: origin=NXP, set at pre-compile, default-value=false  # Compile switch to enable and disable the Eep_EnableQuickWrites function. true: API supported / function provided. false: API not supported / function not provided
      boolean EepPageAsynchBehaviorEn: origin=NXP, set at pre-compile, default-value=false  # Vendor specific: Enable asynchronous execution of the write or erase job in the Eep_MainFunction function which doesn't wait (block) for completion of the page write or erase operation(s). The eeprom driver doesn't use the access code in asynchronous mode.
      boolean EepDisableDemReportErrorStatus: origin=NXP, set at pre-compile, default-value=false  # Vendor specific: Switches the Diagnostic Error Reporting and Notification OFF.
      boolean EepEnableUserModeSupport: origin=NXP, set at pre-compile, default-value=false  # When this parameter is enabled, the EEP module will adapt to run from User Mode, with the following measures: configuring REG_PROT for Eep IPs so that the registers under protection can be accessed from user mode by setting UAA bit in REG_PROT_GCR to 1 for more information and availability on this platform, please see chapter User Mode Support in IM
      integer EepSizeUsedForCSEC: 0..512, origin=NXP, set at pre-compile, default-value=0  # This parameter is the size of FLEXRAM used by CSEC in bytes. For example if 3 CSEC keys are used this size is 512 bytes.
    container EepGeneral  # Container for general parameters of the eeprom driver. These parameters are always pre-compile.
      boolean EepDevErrorDetect: set at pre-compile, default-value=true  # Pre-processor switch to enable and disable development error detection (see EEP077). true: Development error detection enabled. false: Development error detection disabled.
      integer EepDriverIndex: 0..254, scope=ECU, set at pre-compile, symbolic-name-value=true, default-value=0  # Index of the driver, used by FEE.
      boolean EepUseInterrupts: set at pre-compile, default-value=false  # Job processing triggered by hardware interrupt. true: Job processing triggered by interrupt (hardware controlled) false: Job processing not triggered by interrupt (software controlled) Note:Not supported by hardware.
      boolean EepVersionInfoApi: set at pre-compile, default-value=true  # Pre-processor switch to enable / disable the API to read out the modules version information. true: Version info API enabled. false: Version info API disabled.
      boolean EepWriteCycleReduction: set at pre-compile, default-value=false  # Switches to activate or deactivate write cycle reduction (EEPROM value is read and compared before being overwritten). true: writecycle reduction enabled. false: Write cycle reduction disabled. The parameter is currently not used as the support for the write cycle reduction is implemented in hardware.
      container EepTimeouts [0..1]: multiplicity set at pre-compile  # Container for hardware timeout handling.
        integer EepAsyncWriteTimeout: 0..2147483647, origin=NXP, set at pre-compile, default-value=2147483647  # Vendor specific: Eep Async Write Timeout is the timeout value for write operation in asynchronous mode.
        integer EepSyncWriteTimeout: 0..2147483647, origin=NXP, set at pre-compile, default-value=2147483647  # Vendor specific: Eep Sync Write Timeout is the timeout value for write operation in synchronous mode.
        integer EepAbortTimeout: 0..2147483647, origin=NXP, set at pre-compile, default-value=32767  # Vendor specific: Eep Abort Timeout is the timeout value for aborting an ongoing operation.
    container EepPublishedInformation  # Additional published parameters not covered by CommonPublishedInformation container. Note that these parameters do not have any configuration class setting, since they are published information.
      integer EepEraseUnitSize: 0..4294967295, set at published-information, default-value=1  # Size of smallest erasable EEPROM data unit in bytes.FLEXRAM does not allow erase.
      float EepEraseTime: 0.0..5.0E-4, set at published-information, default-value=0.0005  # Maximum time to erase one complete eeprom data unit. Note:This value can be found on DS as the maximum erase time occurs after the specified number of program/erase cycles. FLEXRAM does not allow erase, only DFLASH, PFLASH allow erase.
      integer EepEraseValue: 0..255, set at published-information, default-value=255  # The contents of an erased eeprom memory cell.
      integer EepMinimumAddressType: 0..4294967295, set at published-information, default-value=4  # Minimum expected size of Eep_AddressType.
      integer EepMinimumLengthType: 0..4294967295, set at published-information, default-value=1  # Minimum expected size of Eep_LengthType.
      integer EepReadUnitSize: 0..4294967295, set at published-information, default-value=1  # Size of smallest readable EEPROM data unit in bytes.
      integer EepTotalSize: 0..4294967295, set at published-information, default-value=0  # This parameter is the used size of EEPROM device in bytes (K14x is 4096 bytes, K11x is 2048 bytes).
      integer EepAllowedWriteCycles: 0..4294967295, set at published-information, default-value=100000  # Specified maximum number of write cycles under worst case conditions of specific EEPROM hardware.
      integer EepSpecifiedEraseCycles: 0..4294967295, set at published-information, default-value=100000  # Number of erase cycles specified for the EEP device (usually given in the device data sheet). FLEXRAM does not allow erase.
      float EepWriteTime: 0.0..5.0E-4, set at published-information, default-value=0.0005  # Maximum time to program one complete eeprom page.
      integer EepWriteUnitSize: 0..4294967295, set at published-information, default-value=1  # Size of smallest writeble EEPROM data unit in bytes.
    container CommonPublishedInformation  # Common container, aggregated by all modules. It contains published information about vendor and versions.
      integer ArReleaseMajorVersion: 4..4, origin=NXP, set at published-information, default-value=4  # Vendor specific: Major version number of AUTOSAR specification on which the appropriate implementation is based on.
      integer ArReleaseMinorVersion: 2..2, origin=NXP, set at published-information, default-value=2  # Vendor specific: Minor version number of AUTOSAR specification on which the appropriate implementation is based on.
      integer ArReleaseRevisionVersion: 2..2, origin=NXP, set at published-information, default-value=2  # Vendor specific: Patch version number of AUTOSAR specification on which the appropriate implementation is based on.
      integer ModuleId: 90..90, origin=NXP, set at published-information, default-value=90  # Vendor specific: Module ID of this module.
      integer SwMajorVersion: 1..1, origin=NXP, set at published-information, default-value=1  # Major version number of the vendor specific implementation of the module. The numbering is vendor specific.
      integer SwMinorVersion: 0..0, origin=NXP, set at published-information, default-value=0  # Minor version number of the vendor specific implementation of the module. The numbering is vendor specific.
      integer SwPatchVersion: 2..2, origin=NXP, set at published-information, default-value=2  # Patch level version number of the vendor specific implementation of the module. The numbering is vendor specific.
      string VendorApiInfix [0..1]: multiplicity set at published-information, origin=NXP, set at published-information  # In driver modules which can be instantiated several times on a single ECU, BSW00347 requires that the name of APIs is extended by the VendorId and a vendor specific name. This parameter is used to specify the vendor specific name. In total, the implementation specific name is generated as follows: <ModuleName>_>VendorId>_<VendorApiInfix>. E.g. assuming that the VendorId of the implementor is 123 and the implementer chose a VendorApiInfix of "v11r456" a api name Can_Write defined in the SWS will translate to Can_123_v11r456Write. This parameter is mandatory for all modules with upper multiplicity > 1. It shall not be used for modules with upper multiplicity =1.
      integer VendorId: 43..43, origin=NXP, set at published-information, default-value=43  # Vendor ID of the dedicated implementation of this module according to the AUTOSAR vendor list.
