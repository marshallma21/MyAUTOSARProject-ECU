AUTOSAR XML (schema 4-2-2)
package /TS_T40D2M10I2R0
  ecuc definition collection Os_EcuParameterDefinition: module=Os
  module definition Os: post-build-variant-support=true, variants pre-compile  # Configuration of the Os (Operating System) module.
    container OsCounter [0..*]  # Configuration information for the counters that belong to the OsApplication.
      integer OsCounterMaxAllowedValue: 1..9223372036854775807, set at pre-compile  # Maximum possible allowed value of the system counter in ticks.
      integer OsCounterMinCycle: 1..9223372036854775807, set at pre-compile  # The MINCYCLE attribute specifies the minimum allowed number of counter ticks for a cyclic alarm linked to the counter.
      integer OsCounterTicksPerBase: 1..4294967295, set at pre-compile  # The TICKSPERBASE attribute specifies the number of ticks required to reach a counterspecific unit. The interpretation is implementation-specific.
      enumeration OsCounterType: {HARDWARE, SOFTWARE}, set at pre-compile  # This parameter contains the natural type or unit of the counter.
      float OsSecondsPerTick [0..1]: 0.0..INF, set at pre-compile  # Time of one counter tick in seconds.
