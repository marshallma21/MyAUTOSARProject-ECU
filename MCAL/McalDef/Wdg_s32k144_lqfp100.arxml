AUTOSAR XML (schema 4-3-0)
package /TS_T40D2M10I2R0
  ecuc definition collection Wdg_EcuParameterDefinition: module=Wdg
  module definition Wdg: post-build-variant-support=true, refined-module-def=Wdg, variants link-time/post-build/pre-compile  # Wdg Configuration of the Wdg (Watchdog driver) module
    container WdgDemEventParameterRefs [0..1]: multiplicity set at pre-compile  # Container for the references to DemEventParameter elements which shall be invoked using the API Dem_ReportErrorStatus in case the corresponding error occurs. The EventId is taken from the referenced DemEventParameter's DemEventId value. The standardized errors are provided in the container and can be extended by vendor-specific error references.
      symbolic name reference WDG_E_DISABLE_REJECTED [0..1]: multiplicity set at pre-compile, set at pre-compile, destination=DemEventParameter  # Reference to the DemEventParameter which shall be issued when the error "Initialization or mode switch failed because it would disable the watchdog" has occurred.
      symbolic name reference WDG_E_MODE_FAILED [0..1]: multiplicity set at pre-compile, set at pre-compile, destination=DemEventParameter  # Reference to the DemEventParameter which shall be issued when the error "Setting a watchdog mode failed (during initialization or mode switch)" has occurred.
      symbolic name reference WDG_E_CORRUPT_CONFIG [0..1]: multiplicity set at pre-compile, origin=NXP, set at pre-compile, destination=DemEventParameter  # Vendor specific: Reference to the DemEventParameter which shall be issued when Wdg detects a memory corruption.
      symbolic name reference WDG_E_UNLOCKED [0..1]: multiplicity set at pre-compile, origin=NXP, set at pre-compile, destination=DemEventParameter  # Vendor specific: Reference to the DemEventParameter which shall be issued when Wdg detects the call of SafetyCheck when the driver is unlocked.
      symbolic name reference WDG_E_INVALID_PARAMETER [0..1]: multiplicity set at pre-compile, origin=NXP, set at pre-compile, destination=DemEventParameter  # Vendor specific: Reference to the DemEventParameter which shall be issued when Wdg detects the call of a function was made with invalid parameters.
      symbolic name reference WDG_E_FORBIDDEN_INVOCATION [0..1]: multiplicity set at pre-compile, origin=NXP, set at pre-compile, destination=DemEventParameter  # Vendor specific: Reference to the DemEventParameter which shall be issued when Wdg detects a non reentrant function shall detect if it is pre-empting itself
      symbolic name reference WDG_E_INVALID_CALL [0..1]: multiplicity set at pre-compile, origin=NXP, set at pre-compile, destination=DemEventParameter  # Vendor specific: Reference to the DemEventParameter which shall be issued when Wdg detects calling on a locked configuration.
    container WdgGeneral  # WdgGeneral All general parameters of the watchdog driver are collected here.
      boolean WdgDevErrorDetect: set at pre-compile, default-value=true  # Wdg Development Error Detect Compile switch to enable / disable development error detection for this module. True: Development error detection enabled False: Development error detection disabled
      boolean WdgDisableAllowed: set at pre-compile, default-value=false  # Wdg Disable Allowed Compile switch to allow / forbid disabling the watchdog driver during runtime. True: Disabling the watchdog driver at runtime is allowed False:Disabling the watchdog driver at runtime is not allowed
      boolean WdgEnableUserModeSupport: origin=NXP, set at pre-compile, default-value=false  # Wdg Enable User Mode Support When this parameter is enabled, the Wdg module will adapt to run from User Mode, with the following measure : using 'call trusted function' stubs for all internal function calls that access registers requiring supervisor mode. For more information and availability on this platform, please see chapter "User Mode Support" in IM. True: Wdg module will adapt to run from User Mode. False:Wdg module will not apdapt to run from User Mode. If this parameter is not ediatable, that means Wdg driver can run in User Mode.
      integer WdgIndex: 0..255, set at pre-compile, symbolic-name-value=true, default-value=0  # Wdg Instance 0 Index Represents the watchdog driver's ID for Instance 0 so that it can be referenced by the watchdog interface.
      integer WdgIndex{1..3}: 0..255, origin=NXP, set at pre-compile, default-value={1..3}  # Vendor specific: Wdg Instance {1..3} Index Represents the watchdog driver's ID for Instance {1..3} so that it can be referenced by the watchdog interface.
      float WdgInitialTimeout: 0.0..65.535, set at pre-compile, default-value=0  # Wdg Initial Timeout The initial timeout (sec) for the trigger condition to be initialized during Init function. It shall be not larger than WdgMaxTimeout.
      float WdgMaxTimeout: 0.0..65.535, set at pre-compile, default-value=0  # Wdg Max Timeout The maximum timeout (seconds) to which the watchdog trigger condition can be initialized.
      enumeration WdgRunArea: {RAM, ROM}, set at pre-compile, default-value=ROM  # Wdg Run Area Represents the watchdog driver execution area is either from ROM(Flash) or RAM as required with the particular microcontroller.
      function name WdgTriggerLocation: set at pre-compile, default-value=NULL_PTR  # Wdg Trigger Location Location (memory address) of the watchdog trigger routine. Note:Not supported by the current hardware.
      function name WdgCallbackNotification0: origin=NXP, post-build-variant-value=true, set at link in variant link-time / pre-compile in variant pre-compile / post-build in variant post-build, default-value=NULL_PTR  # Vendor specific: WdgCallbackNotification0 Callback notification for the ISR Wdg_Wdog0_Isr function
      boolean WdgVersionInfoApi: set at pre-compile, default-value=true  # Wdg VersionInfo Api Compile switch to enable or disable the version information API. True: API enabled False:API disabled
      container NonAutosar  # Non Autosar settings.
        boolean WdgDisableDemReportErrorStatus: origin=NXP, set at pre-compile, default-value=false  # Enable/Disable Dem error reporting.
    container WdgSettingsConfig [1..*]  # WdgSettingsConfig Configuration items for the different watchdog settings, including those for external watchdog hardware.
      enumeration WdgInstance: {WDOG0}, origin=NXP, set at pre-compile, default-value=WDOG0  # Vendor specific: Wdg Hardware Instance Select specific hardware instance for watchdog driver initialization.
      enumeration WdgDefaultMode: {WDGIF_FAST_MODE, WDGIF_OFF_MODE, WDGIF_SLOW_MODE}, post-build-variant-value=true, set at link in variant link-time / pre-compile in variant pre-compile / post-build in variant post-build, default-value=WDGIF_SLOW_MODE  # Wdg Default Mode Default mode for watchdog driver initialization.
      boolean WdgInterruptContentEnable: origin=NXP, set at pre-compile, default-value=true  # Vendor specific: Wdg Interrupt Enable This parametter is used to generate interrupt content for each WDOG. True = Interrupt content is generated. False = Interrupt content is not generated.
      choice reference WdgExternalTriggerCounterRef: origin=NXP, post-build-variant-value=true, set at link in variant link-time / pre-compile in variant pre-compile / post-build in variant post-build, destination=GptChannelConfiguration  # Vendor specific: Wdg External Trigger Counter Reference to the GptChannel configuration which set for the watchdog servicing routine implementation.
      container WdgExternalConfiguration [0..1]: multiplicity set at pre-compile  # WdgExternalConfiguration Configuration items for an external watchdog hardware
        choice reference WdgExternalContainerRef [0..1]: multiplicity set at link in variant link-time / pre-compile in variant pre-compile / post-build in variant post-build, post-build-variant-multiplicity=true, post-build-variant-value=true, set at link in variant link-time / pre-compile in variant pre-compile / post-build in variant post-build, destination=[DioChannelGroup, SpiSequence]  # WdgExternalContainerRef Reference to either - a DioChannelGroup container in case the hardware watchdog is connected via DIO pins - a SpiSequenceConfiguration container in case the watchdog hardware is accessed via SPI Note:This parameter is not used by current implementation
      container WdgSettingsFast  # WdgSettingsFast Hardware dependent settings for the watchdog driver's fast mode.
        integer WdgClockValue: 0..40000, origin=NXP, post-build-variant-value=true, set at link in variant link-time / pre-compile in variant pre-compile / post-build in variant post-build, default-value=0  # Vendor specific: Wdg Clock Value This is the Implementation Specific parameter. Indicates Wdg Clock Value in KHz.
        boolean WdgRunsInStopMode: origin=NXP, post-build-variant-value=true, set at link in variant link-time / pre-compile in variant pre-compile / post-build in variant post-build, default-value=true  # Vendor specific: Wdg Runs in Stop Mode This is the Implementation Specific parameter. Enabled: WDOG continues to count even while the processor core is in stop mode. Disabled: WDOG stops counting if the processor core is in stop mode.
        boolean WdgRunsInDebugMode: origin=NXP, post-build-variant-value=true, set at link in variant link-time / pre-compile in variant pre-compile / post-build in variant post-build, default-value=false  # Vendor specific: Wdg Runs In Debug Mode This is the Implementation Specific parameter. Enabled: WDOG continues to count even while the device enters the debug mode. Disabled: WDOG stops counting if the processor core when the device enters the debug mode
        boolean WdgRunsInWaitMode: origin=NXP, post-build-variant-value=true, set at link in variant link-time / pre-compile in variant pre-compile / post-build in variant post-build, default-value=false  # Vendor specific: Wdg Runs In Wait Mode This is the Implementation Specific parameter. Enabled: WDOG continues to count even while the device enters the wait mode. Disabled: WDOG stops counting if the processor core when the device enters the wait mode
        enumeration WdgOperationMode: {ResetOnTimeOut, Interrupt}, origin=NXP, post-build-variant-value=true, set at link in variant link-time / pre-compile in variant pre-compile / post-build in variant post-build, default-value=ResetOnTimeOut  # Vendor specific: Wdg Operation Mode This is the Implementation Specific parameter. ResetOnTimeOut: Generate a reset on a time-out. Interrupt: Generate an interrupt on an initial time-out, reset after 128 cycles.
        enumeration WdgClockSelection: {Bus_Clock, LPO_Clock, SOSC_Clock, SIRC_Clock}, origin=NXP, post-build-variant-value=true, set at link in variant link-time / pre-compile in variant pre-compile / post-build in variant post-build, default-value=Bus_Clock  # Vendor specific: Wdg Clock Selection Selection for WDOG clock.
        float WdgTimeoutPeriod: 0.0..16776.96, origin=NXP, post-build-variant-value=true, set at link in variant link-time / pre-compile in variant pre-compile / post-build in variant post-build, default-value=0.01  # Vendor specific: Wdg Timeout Period Wdg Timeout Period
        boolean WdgWindowMode: origin=NXP, post-build-variant-value=true, set at link in variant link-time / pre-compile in variant pre-compile / post-build in variant post-build, default-value=false  # Vendor specific: Wdg WindowMode. Disabled: Regular mode, service sequence can be done at any time. Enabled : Windowed mode, the service sequence is only valid when the up counter is higher than value in the WDOG WIN register.
        float WdgWindowPeriod: 0.0..16776.96, origin=NXP, post-build-variant-value=true, set at link in variant link-time / pre-compile in variant pre-compile / post-build in variant post-build, default-value=0.004  # Vendor specific: Wdg Window Period This is the Implementation Specific parameter. Window start value. When window mode is enabled, the service sequence can only be written when the internal up counter is higher than this value.
        boolean WdgPrescalerEnabled: origin=NXP, post-build-variant-value=true, set at link in variant link-time / pre-compile in variant pre-compile / post-build in variant post-build, default-value=true  # Vendor specific: Wdg Prescaler Enabled. Disabled: Prescaler Disabled. Enabled : Prescaler Enabled.
        boolean WdgAllowUpdates: origin=NXP, post-build-variant-value=true, set at link in variant link-time / pre-compile in variant pre-compile / post-build in variant post-build, default-value=true  # Vendor specific: Wdg Allow Updates. Disabled: Updates not allowed. Enabled : Updates allowed.
        enumeration WdgTestMode: {TestModeDisabled, UserModeEnabled, TestModeLowByte, TestModeHighByte}, origin=NXP, post-build-variant-value=true, set at link in variant link-time / pre-compile in variant pre-compile / post-build in variant post-build, default-value=TestModeDisabled  # Vendor specific: WWdg Test Mode TestModeDisabled: Watchdog test mode disabled. UserModeEnabled : Watchdog user mode enabled. TestModeLowByte: Watchdog test mode enabled, only the low byte is used. TestModeHighByte : Watchdog test mode enabled, only the high byte is used.
        reference WdgClkSrcRef: origin=NXP, post-build-variant-value=true, set at link in variant link-time / pre-compile in variant pre-compile / post-build in variant post-build, destination=WdgClockReferencePoint  # Reference to the WdgClockReferencePoint from which the clock is derived.
      container WdgSettingsOff  # WdgSettingsOff Hardware dependent settings for the watchdog driver's off mode.
        boolean WdgAllowUpdates: origin=NXP, post-build-variant-value=true, set at link in variant link-time / pre-compile in variant pre-compile / post-build in variant post-build, default-value=true  # Vendor specific: Wdg Allow Updates. Disabled: Updates not allowed. Enabled : Updates allowed.
      container WdgSettingsSlow  # WdgSettingsSlow Hardware dependent settings for the watchdog driver's slow mode.
        integer WdgClockValue: 0..40000, origin=NXP, post-build-variant-value=true, set at link in variant link-time / pre-compile in variant pre-compile / post-build in variant post-build, default-value=0  # Vendor specific: Wdg Clock Value This is the Implementation Specific parameter. Indicates Wdg Clock Value in KHz.
        boolean WdgRunsInStopMode: origin=NXP, post-build-variant-value=true, set at link in variant link-time / pre-compile in variant pre-compile / post-build in variant post-build, default-value=true  # Vendor specific: Wdg Runs in Stop Mode This is the Implementation Specific parameter. Enabled: WDOG continues to count even while the processor core is in stop mode. Disabled: WDOG stops counting if the processor core is in stop mode.
        boolean WdgRunsInDebugMode: origin=NXP, post-build-variant-value=true, set at link in variant link-time / pre-compile in variant pre-compile / post-build in variant post-build, default-value=false  # Vendor specific: Wdg Runs In Debug Mode This is the Implementation Specific parameter. Enabled: WDOG continues to count even while the device enters the debug mode. Disabled: WDOG stops counting if the processor core when the device enters the debug mode.
        boolean WdgRunsInWaitMode: origin=NXP, post-build-variant-value=true, set at link in variant link-time / pre-compile in variant pre-compile / post-build in variant post-build, default-value=false  # Vendor specific: Wdg Runs In Wait Mode This is the Implementation Specific parameter. Enabled: WDOG continues to count even while the device enters the wait mode. Disabled: WDOG stops counting if the processor core when the device enters the wait mode
        enumeration WdgOperationMode: {ResetOnTimeOut, Interrupt}, origin=NXP, post-build-variant-value=true, set at link in variant link-time / pre-compile in variant pre-compile / post-build in variant post-build, default-value=ResetOnTimeOut  # Vendor specific: Wdg Operation Mode This is the Implementation Specific parameter. ResetOnTimeOut: Generate a reset on a time-out. Interrupt: Generate an interrupt on an initial time-out, reset after 128 cycles.
        enumeration WdgClockSelection: {Bus_Clock, LPO_Clock, SOSC_Clock, SIRC_Clock}, origin=NXP, post-build-variant-value=true, set at link in variant link-time / pre-compile in variant pre-compile / post-build in variant post-build, default-value=Bus_Clock  # Vendor specific: Wdg Clock Selection WDOG clock selection.
        float WdgTimeoutPeriod: 0.0..16776.96, origin=NXP, post-build-variant-value=true, set at link in variant link-time / pre-compile in variant pre-compile / post-build in variant post-build, default-value=0.01  # Vendor specific: Wdg Timeout Period This is the Implementation Specific parameter. Software Watchdog Time-Out Period in seconds. Selects the time-out period for the WDOG.
        boolean WdgWindowMode: origin=NXP, post-build-variant-value=true, set at link in variant link-time / pre-compile in variant pre-compile / post-build in variant post-build, default-value=false  # Vendor specific: Wdg WindowMode. Disabled: Regular mode, service sequence can be done at any time. Enabled : Windowed mode, the service sequence is only valid when the up counter is higher than value in the WDOG WN register.
        float WdgWindowPeriod: 0.0..16776.96, origin=NXP, post-build-variant-value=true, set at link in variant link-time / pre-compile in variant pre-compile / post-build in variant post-build, default-value=0.004  # Vendor specific: Wdg Window Period This is the Implementation Specific parameter. Window start value. When window mode is enabled, the service sequence can only be written when the internal up counter is higher than this value.
        boolean WdgPrescalerEnabled: origin=NXP, post-build-variant-value=true, set at link in variant link-time / pre-compile in variant pre-compile / post-build in variant post-build, default-value=true  # Vendor specific: Wdg WindowMode. Disabled: Prescaler Disabled. Enabled : Prescaler Enabled.
        boolean WdgAllowUpdates: origin=NXP, post-build-variant-value=true, set at link in variant link-time / pre-compile in variant pre-compile / post-build in variant post-build, default-value=true  # Vendor specific: Wdg Allow Updates. Disabled: Updates not allowed. Enabled : Updates allowed.
        enumeration WdgTestMode: {TestModeDisabled, UserModeEnabled, TestModeLowByte, TestModeHighByte}, origin=NXP, post-build-variant-value=true, set at link in variant link-time / pre-compile in variant pre-compile / post-build in variant post-build, default-value=TestModeDisabled  # Vendor specific: WWdg Test Mode TestModeDisabled: Watchdog test mode disabled. UserModeEnabled : Watchdog user mode enabled. TestModeLowByte: Watchdog test mode enabled, only the low byte is used. TestModeHighByte : Watchdog test mode enabled, only the high byte is used.
        reference WdgClkSrcRef: origin=NXP, post-build-variant-value=true, set at link in variant link-time / pre-compile in variant pre-compile / post-build in variant post-build, destination=WdgClockReferencePoint  # Reference to the WdgClockReferencePoint from which the clock is derived.
    container WdgClockReferencePoint [1..4]: multiplicity set at pre-compile  # This container contains a parameter, which represents a reference to a container of the type McuClockReferencePoint (defined in module MCU). If the cip is trimmed, then configure in MCU a reference point of clock source type(LPO_CLK, SIRC_CLK, SOSC_CLK, or Bus_CLK). If the cip is not trimmed (IRC_CLK running at frequency different than clock source type), then configure in MCU a reference point of CUSTOM type with the real clock frequency measured on the cip.
      reference WdgClockReference: origin=NXP, set at pre-compile, destination=McuClockReferencePoint  # Reference to a container of the type McuClockReferencePoint, to select an input clock.
    container WdgPublishedInformation  # WdgPublishedInformation Container holding all Wdg specific published information parameters
      enumeration WdgTriggerMode: {WDG_BOTH, WDG_TOGGLE, WDG_WINDOW}, set at published-information, default-value=WDG_BOTH  # Wdg Trigger Mode Watchdog trigger mode (toggle/window/both).
    container CommonPublishedInformation  # Common container, aggregated by all modules. It contains published information about vendor and versions.
      integer ArReleaseMajorVersion: 4..4, origin=NXP, set at published-information, default-value=4  # Vendor specific: Major version number of AUTOSAR specification on which the appropriate implementation is based on.
      integer ArReleaseMinorVersion: 2..2, origin=NXP, set at published-information, default-value=2  # Vendor specific: Minor version number of AUTOSAR specification on which the appropriate implementation is based on.
      integer ArReleaseRevisionVersion: 2..2, origin=NXP, set at published-information, default-value=2  # Vendor specific: Revision version number of AUTOSAR specification on which the appropriate implementation is based on.
      integer ModuleId: 102..102, origin=NXP, set at published-information, default-value=102  # Vendor specific: Module ID of this module from Module List.
      integer SwMajorVersion: 1..1, origin=NXP, set at published-information, default-value=1  # Vendor specific: Major version number of the vendor specific implementation of the module. The numbering is vendor specific.
      integer SwMinorVersion: 0..0, origin=NXP, set at published-information, default-value=0  # Vendor specific: Minor version number of the vendor specific implementation of the module. The numbering is vendor specific.
      integer SwPatchVersion: 2..2, origin=NXP, set at published-information, default-value=2  # Vendor specific: Patch level version number of the vendor specific implementation of the module. The numbering is vendor specific.
      string VendorApiInfix [0..1]: multiplicity set at published-information, origin=NXP, set at published-information  # In driver modules which can be instantiated several times on a single ECU, BSW00347 requires that the name of APIs is extended by the VendorId and a vendor specific name. This parameter is used to specify the vendor specific name. In total, the implementation specific name is generated as follows: <ModuleName>_>VendorId>_<VendorApiInfix> E.g. assuming that the VendorId of the implementor is 123 and the implementer chose a VendorApiInfix of "v11r456" a api name Can_Write defined in the SWS will translate to Can_123_v11r456Write. This parameter is mandatory for all modules with upper multiplicity > 1. It shall not be used for modules with upper multiplicity =1.
      integer VendorId: 43..43, origin=NXP, set at published-information, default-value=43  # Vendor ID of the dedicated implementation of this module according to the AUTOSAR vendor list.
