AUTOSAR XML (schema 4-3-0)
package /TS_T40D2M10I2R0
  ecuc definition collection Adc_EcuParameterDefinition: module=Adc
  module definition Adc: post-build-variant-support=true, refined-module-def=Adc, variants post-build/pre-compile  # Configuration of the Adc (Analog Digital Conversion) module.
    container AdcConfigSet  # This is the base container that contains the post-build selectable configuration parameters
      container AdcHwUnit [1..*]: multiplicity set at pre-compile  # This container contains the Driver configuration (parameters) depending on grouping of channels.
        enumeration AdcTransferType: {ADC_DMA, ADC_INTERRUPT}, origin=NXP, post-build-variant-value=true, set at post-build in variant post-build / pre-compile in variant pre-compile, default-value=ADC_INTERRUPT  # Select the Interrupt or Dma transfer Type. If DMA is used, user must not run SW and HW groups at the same time on the same HW unit because the same DMA channel will be used for both. If DMA is required for AdcTransferType, it is recommended to keep AdcWithoutInterrupts as false, otherwise, DMA will not be configured and it will be user responsibilty to read the results from registers directly by calling Adc_ReadGroup
        enumeration AdcClockSource [0..1]: {ADC_ALTCLK1, ADC_ALTCLK2, ADC_ALTCLK3, ADC_ALTCLK4}, multiplicity set at post-build in variant post-build / pre-compile in variant pre-compile, post-build-variant-multiplicity=true, post-build-variant-value=true, set at post-build in variant post-build / pre-compile in variant pre-compile, default-value=ADC_ALTCLK1  # Selects the input clock source to generate the internal clock ADCK. ADC_ALTCLK1 is the only clock available for ADC. ADC_ALTCLK1 - Alternate clock 1. ADC_ALTCLK2 - Alternate clock 2. ADC_ALTCLK3 - Alternate clock 3. ADC_ALTCLK4 - Alternate clock 4. . Note: Only ADC_ALTCLK1 is used by the current implementation.
        enumeration AdcHwUnitId: {ADC0, ADC1}, post-build-variant-value=true, set at post-build in variant post-build / pre-compile in variant pre-compile, default-value=ADC0  # Specifies the used ADC Hardware Unit.
        integer AdcLogicalUnitId: 0..1, origin=NXP, set at pre-compile, default-value=0  # Specifies the Logical id of the Hardware Unit.
        enumeration AdcVoltageReferenceSelection: {VREFH_VREFL, VALTH_VREFL}, origin=NXP, post-build-variant-value=true, set at post-build in variant post-build / pre-compile in variant pre-compile, default-value=VREFH_VREFL  # Selects the voltage reference source used for conversions. Refer to the chip configuration chapter's ADC section for details of these field definitions for this chip. VREFH_VREFL - Selects VREFH/VREFL as reference voltage. VALTH_VREFL - Selects VALTH/VREFL as reference voltage. .
        integer AdcPrescale [0..1]: 0..65535, multiplicity set at post-build in variant post-build / pre-compile in variant pre-compile, post-build-variant-multiplicity=true, post-build-variant-value=true, set at post-build in variant post-build / pre-compile in variant pre-compile, default-value=1  # The prescaler Value is not used in this implementation.
        enumeration AdcResolution: {BITS_8, BITS_10, BITS_12}, origin=NXP, post-build-variant-value=true, set at post-build in variant post-build / pre-compile in variant pre-compile, default-value=BITS_12  # Used to set the ADC resolution mode. BITS_8 - 8-bit conversion. BITS_10 - 10-bit conversion. BITS_12 - 12-bit conversion. .
        integer AdcOffsetCorrectionValue: 0..255, origin=NXP, post-build-variant-value=true, set at post-build in variant post-build / pre-compile in variant pre-compile, default-value=0  # Value to be written in the ADC_OFS(Offset correction value register). This value will be added with the converted result value to generate final result to be loaded into ADC_Rn.
        container AdcPdbSettings [0..1]: multiplicity set at post-build in variant post-build / pre-compile in variant pre-compile  # Confiugration for the PDB unit associated with this Adc hardware unit.
          integer AdcPdbPrescalerDividerSelect: 0..7, origin=NXP, post-build-variant-value=true, set at post-build in variant post-build / pre-compile in variant pre-compile, default-value=0  # Determines the prescaler used for the PDB counter. 0 - Counting uses the peripheral clock divided by multiplication factor selected by AdcPdbMultiplicationFactorSelect. 1 - Counting uses the peripheral clock divided by twice of the multiplication factor selected by AdcPdbMultiplicationFactorSelect. 2 - Counting uses the peripheral clock divided by four of the multiplication factor selected by AdcPdbMultiplicationFactorSelect. 3 - Counting uses the peripheral clock divided by eight of the multiplication factor selected by AdcPdbMultiplicationFactorSelect. 4 - Counting uses the peripheral clock divided by 16 times of the multiplication factor selected by AdcPdbMultiplicationFactorSelect. 5 - Counting uses the peripheral clock divided by 32 times of the multiplication factor selected by AdcPdbMultiplicationFactorSelect. 6 - Counting uses the peripheral clock divided by 64 times of the multiplication factor selected by AdcPdbMultiplicationFactorSelect. 7 - Counting uses the peripheral clock divided by 128 times of the multiplication factor selected by AdcPdbMultiplicationFactorSelect. .
          integer AdcPdbMultiplicationFactorSelect: 0..3, origin=NXP, post-build-variant-value=true, set at post-build in variant post-build / pre-compile in variant pre-compile, default-value=0  # Selects the multiplication factor of the prescaler divider for the counter clock of the associated PDB unit. 0 - Multiplication factor is 1. 1 - Multiplication factor is 10. 2 - Multiplication factor is 20. 3 - Multiplication factor is 40. .
          boolean AdcPdbChannelSequenceErrorEnable: origin=NXP, set at pre-compile, default-value=false  # Enables the PDB sequence error interrupt. When this field is set, any of the PDB channel sequence error flags generates a PDB sequence error interrupt.
          function name AdcPdbErrorNotification: origin=NXP, post-build-variant-value=true, set at post-build in variant post-build / pre-compile in variant pre-compile, default-value=NULL_PTR  # Callback function for PDB channel sequence error. This function pointer is called everytime when PDB channel sequence error occurred.
        container AdcNormalConversionTimings [0..1]: multiplicity set at post-build in variant post-build / pre-compile in variant pre-compile  # Selects Normal values used for programming clock frequency, conversion timing and hardwre averaging used at initialization and also by Adc_SetClockMode API when it is called with parameter ADC_NORMAL.
          boolean AdcHardwareAverageEnable: origin=NXP, post-build-variant-value=true, set at post-build in variant post-build / pre-compile in variant pre-compile, default-value=false  # Enables the hardware average function of the ADC.
          enumeration AdcHardwareAverageSelect: {SAMPLES_4, SAMPLES_8, SAMPLES_16, SAMPLES_32}, origin=NXP, post-build-variant-value=true, set at post-build in variant post-build / pre-compile in variant pre-compile, default-value=SAMPLES_4  # Determines how many ADC conversions will be averaged to create the ADC average result. This functionality is activated when ADCx_SC3[AVGE] = 1. SAMPLES_4 - 4 samples averaged. SAMPLES_8 - 8 samples averaged. SAMPLES_16 - 16 samples averaged. SAMPLES_32 - 32 samples averaged. .
          integer AdcSampleTimeDuration: 2..256, origin=NXP, post-build-variant-value=true, set at post-build in variant post-build / pre-compile in variant pre-compile, default-value=2  # Selects a sample time of 2 to 256 ADCK clock cycles. The value written to this register is the desired sample time minus 1.
          enumeration AdcClockDivideSelect: {DIV_NONE, DIV_2, DIV_4, DIV_8}, origin=NXP, post-build-variant-value=true, set at post-build in variant post-build / pre-compile in variant pre-compile, default-value=DIV_NONE  # Selects the divide ratio used by the ADC to generate the internal clock ADCK. DIV_NONE - Input clock. DIV_2 - Input clock / 2. DIV_4 - Input clock / 4. DIV_8 - Input clock / 8. .
        container AdcAlternateConversionTimings [0..1]: multiplicity set at post-build in variant post-build / pre-compile in variant pre-compile  # Selects Alternate values used for programming clock frequency, conversion timing and hardwre averaging used by Adc_SetClockMode API when it is called with parameter ADC_ALTERNATE. This is available when AdcEnableDualClockMode is enabled.
          boolean AdcHardwareAverageEnableAlternate: origin=NXP, post-build-variant-value=true, set at post-build in variant post-build / pre-compile in variant pre-compile, default-value=false  # Alternate configuration: Enables the hardware average function of the ADC.
          enumeration AdcHardwareAverageSelectAlternate: {SAMPLES_4, SAMPLES_8, SAMPLES_16, SAMPLES_32}, origin=NXP, post-build-variant-value=true, set at post-build in variant post-build / pre-compile in variant pre-compile, default-value=SAMPLES_4  # Alternate configuration: Determines how many ADC conversions will be averaged to create the ADC average result. This functionality is activated when ADCx_SC3[AVGE] = 1. SAMPLES_4 - 4 samples averaged. SAMPLES_8 - 8 samples averaged. SAMPLES_16 - 16 samples averaged. SAMPLES_32 - 32 samples averaged. .
          integer AdcSampleTimeDurationAlternate: 2..256, origin=NXP, post-build-variant-value=true, set at post-build in variant post-build / pre-compile in variant pre-compile, default-value=2  # Alternate configuration: Selects a sample time of 2 to 256 ADCK clock cycles. The value written to this register is the desired sample time minus 1..
          enumeration AdcClockDivideSelectAlternate: {DIV_NONE, DIV_2, DIV_4, DIV_8}, origin=NXP, post-build-variant-value=true, set at post-build in variant post-build / pre-compile in variant pre-compile, default-value=DIV_NONE  # Alternate configuration: Selects the divide ratio used by the ADC to generate the internal clock ADCK. DIV_NONE - Input clock. DIV_2 - Input clock / 2. DIV_4 - Input clock / 4. DIV_8 - Input clock / 8. .
        container AdcChannel [1..*]: multiplicity set at pre-compile  # This container contains the channel configuration (parameters) depending on the hardware capability.
          integer AdcLogicalChannelId: 0..1024, origin=NXP, set at pre-compile, default-value=0  # This is the logical Id of the ADC channel.
          enumeration AdcChannelId: {AN_0, AN_1, AN_2, AN_3, AN_4, AN_5, AN_6, AN_7, AN_8, AN_9, AN_10, AN_11, AN_12, AN_13, AN_14, AN_15, INT_AN_0, BAND_GAP, VREFH, VREFL}, post-build-variant-value=true, set at post-build in variant post-build / pre-compile in variant pre-compile, default-value=AN_0  # This parameter defines the assignment of the channel to the physical ADC hardware channel. Note: Range of the ADC Channels depends on the selected package.
          boolean AdcChannelLimitCheck [0..1]: multiplicity set at pre-compile, set at pre-compile, default-value=false  # Enables or disables limit checking for an ADC channel.
          integer AdcChannelHighLimit [0..1]: 0..9223372036854775807, multiplicity set at pre-compile, set at pre-compile, default-value=0  # High limit - used for limit checking.
          integer AdcChannelLowLimit [0..1]: 0..9223372036854775807, multiplicity set at pre-compile, set at pre-compile, default-value=0  # Low limit - used for limit checking.
          enumeration AdcChannelRangeSelect [0..1]: {ADC_RANGE_ALWAYS, ADC_RANGE_BETWEEN, ADC_RANGE_NOT_BETWEEN, ADC_RANGE_NOT_OVER_HIGH, ADC_RANGE_NOT_UNDER_LOW, ADC_RANGE_OVER_HIGH, ADC_RANGE_UNDER_LOW}, multiplicity set at pre-compile, set at pre-compile, default-value=ADC_RANGE_ALWAYS  # In case of active limit checking: defines which conversion values are taken into account related to the boarders defined with AdcChannelLowLimit and AdcChannelHighLimit.
          integer AdcChannelConvTime [0..1]: 0..9223372036854775807, multiplicity set at post-build in variant post-build / pre-compile in variant pre-compile, post-build-variant-multiplicity=true, post-build-variant-value=true, set at post-build in variant post-build / pre-compile in variant pre-compile, default-value=0  # Configuration of conversion time, i.e. the time during which the analogue value is converted into digital representation, (in clock cycles) for each channel, if supported by hardware. This parameter is not used by the current implementation.
          enumeration AdcChannelRefVoltsrcHigh [0..1]: {UPPER_REF_VOLT_0}, multiplicity set at post-build in variant post-build / pre-compile in variant pre-compile, post-build-variant-multiplicity=true, post-build-variant-value=true, set at post-build in variant post-build / pre-compile in variant pre-compile, default-value=UPPER_REF_VOLT_0  # Upper reference voltage source for each channel.This parameter is not used by the current implementation.
          enumeration AdcChannelRefVoltsrcLow [0..1]: {LOWER_REF_VOLT_0}, multiplicity set at post-build in variant post-build / pre-compile in variant pre-compile, post-build-variant-multiplicity=true, post-build-variant-value=true, set at post-build in variant post-build / pre-compile in variant pre-compile, default-value=LOWER_REF_VOLT_0  # Lower reference voltage source for each channel.This parameter is not used by the current implementation.
          integer AdcChannelResolution [0..1]: 1..63, multiplicity set at post-build in variant post-build / pre-compile in variant pre-compile, post-build-variant-multiplicity=true, post-build-variant-value=true, set at post-build in variant post-build / pre-compile in variant pre-compile, default-value=12  # Channel Resolution in bits of converted value. This parameter is not used by the current implementation.
          integer AdcChannelSampTime [0..1]: 8..254, multiplicity set at post-build in variant post-build / pre-compile in variant pre-compile, post-build-variant-multiplicity=true, post-build-variant-value=true, set at post-build in variant post-build / pre-compile in variant pre-compile, default-value=8  # Sampling time, i.e. the time during whuch the value is sampled, (in clock cycles) for each channel. Not used.
        container AdcGroup [1..*]: multiplicity set at pre-compile  # This container contains the Group configuration (parameters).
          enumeration AdcGroupAccessMode: {ADC_ACCESS_MODE_SINGLE, ADC_ACCESS_MODE_STREAMING}, post-build-variant-value=true, set at post-build in variant post-build / pre-compile in variant pre-compile, default-value=ADC_ACCESS_MODE_SINGLE  # Type of access mode to group conversion results.
          enumeration AdcGroupConversionMode: {ADC_CONV_MODE_CONTINUOUS, ADC_CONV_MODE_ONESHOT}, post-build-variant-value=true, set at post-build in variant post-build / pre-compile in variant pre-compile, default-value=ADC_CONV_MODE_ONESHOT  # Type of Conversion mode of the channel group.
          enumeration AdcGroupConversionType: {ADC_CONV_TYPE_NORMAL, ADC_CONV_TYPE_INJECTED}, origin=NXP, post-build-variant-value=true, set at post-build in variant post-build / pre-compile in variant pre-compile, default-value=ADC_CONV_TYPE_NORMAL  # Normal or Injected conversion type. Not used in this implementation.
          integer AdcGroupId: 0..1023, set at pre-compile, symbolic-name-value=true, default-value=0  # Numeric ID of the group. This parameter is the symbolic name to be used on the API. This symbolic name allows accessing Channel Group data. This value will be assigned to the symbolic name derived of the AdcGroup container shortName.
          integer AdcGroupPriority [0..1]: 0..255, multiplicity set at post-build in variant post-build / pre-compile in variant pre-compile, post-build-variant-multiplicity=true, post-build-variant-value=true, set at post-build in variant post-build / pre-compile in variant pre-compile, default-value=0  # Priority level of the AdcGroup. This item is ignored if Adc/AdcGeneral/AdcPriorityImplementation is defined to ADC_PRIORITY_NONE.
          enumeration AdcGroupReplacement [0..1]: {ADC_GROUP_REPL_ABORT_RESTART, ADC_GROUP_REPL_SUSPEND_RESUME}, multiplicity set at post-build in variant post-build / pre-compile in variant pre-compile, post-build-variant-multiplicity=true, post-build-variant-value=true, set at post-build in variant post-build / pre-compile in variant pre-compile, default-value=ADC_GROUP_REPL_ABORT_RESTART  # Replacement mechanism used on ADC group level, if a group conversion is interrupted by a group which has a higher priority. It's fixed to Abort/Restart
          enumeration AdcGroupTriggSrc: {ADC_TRIGG_SRC_HW, ADC_TRIGG_SRC_SW}, post-build-variant-value=true, set at post-build in variant post-build / pre-compile in variant pre-compile, default-value=ADC_TRIGG_SRC_SW  # Type of source event that starts a group conversion. It' s possible select Hw or Sw trigger. In case of Hw trigger the trigger source can be from the PDB. Only trigger sources from PDB is used by the current implementation. The trigger source connected to PDB can be configured from Mcl module.
          enumeration AdcHwTrigSignal [0..1]: {ADC_HW_TRIG_FALLING_EDGE, ADC_HW_TRIG_RISING_EDGE}, multiplicity set at post-build in variant post-build / pre-compile in variant pre-compile, post-build-variant-multiplicity=true, post-build-variant-value=true, set at post-build in variant post-build / pre-compile in variant pre-compile, default-value=ADC_HW_TRIG_RISING_EDGE  # Configures on which edge of the hardware trigger signal the driver should reach, i.e. start the conversion. Note: Only ADC_HW_TRIG_RISING_EDGE is used by the current implementation.
          integer AdcHwTrigTimer [0..1]: 0..4294967295, multiplicity set at post-build in variant post-build / pre-compile in variant pre-compile, post-build-variant-multiplicity=true, post-build-variant-value=true, set at post-build in variant post-build / pre-compile in variant pre-compile, default-value=50  # Reload value of the ADC module embedded timer. This parameter is not used by the current implementation
          function name AdcNotification [0..1]: multiplicity set at post-build in variant post-build / pre-compile in variant pre-compile, post-build-variant-multiplicity=true, post-build-variant-value=true, set at post-build in variant post-build / pre-compile in variant pre-compile, default-value=NULL_PTR  # Callback function for each group. This function pointer is called everytime when the conversion of this group is completed.
          function name AdcExtraNotification: origin=NXP, post-build-variant-value=true, set at post-build in variant post-build / pre-compile in variant pre-compile, default-value=NULL_PTR  # Extra callback function for each group. This function pointer will be called at the beginning of the interrupt routine, before updating andy HW registers or Group status.
          enumeration AdcStreamingBufferMode: {ADC_STREAM_BUFFER_CIRCULAR, ADC_STREAM_BUFFER_LINEAR}, post-build-variant-value=true, set at post-build in variant post-build / pre-compile in variant pre-compile, default-value=ADC_STREAM_BUFFER_LINEAR  # Select the streaming buffer as linear buffer (i.e. the ADC Driver stops the conversion as soon as the stream buffer is full) or as ring buffer (wraps around if the end of the stream buffer is reached).
          boolean AdcEnableDoubleBuffering: origin=NXP, post-build-variant-value=true, set at post-build in variant post-build / pre-compile in variant pre-compile, default-value=false  # Enable/ Disable the Double Buffering feature for Adc group conversions. this Parameter can be configured only for groups configured with ADC_ACCESS_MODE_STREAMING Access Mode, and only if ADC_DMA is configured as the transfer method for the Adc Unit. When this parameter is Disabled, normal functionlaity shall be executed. Note: This is an Implementation Specific Parameter. This feature supported only for Groups which is configured as hardware trigger
          boolean AdcEnableHalfInterrupt: origin=NXP, post-build-variant-value=true, set at post-build in variant post-build / pre-compile in variant pre-compile, default-value=false  # Enable/ Disable the interrupt when half sample complete for double bufferring feature. Double buffering must be enable for configure this feature.
          integer AdcStreamingNumSamples: 1..1024, post-build-variant-value=true, set at post-build in variant post-build / pre-compile in variant pre-compile, default-value=1  # Number of ADC values to be acquired per channel in streaming access mode.
          boolean AdcWithoutInterrupts: origin=NXP, post-build-variant-value=true, set at post-build in variant post-build / pre-compile in variant pre-compile, default-value=false  # Enable/ Disable the occuring of ADC data transferring from ADC data registers Rn to user-defined buffers by using ADC Interrupt or DMA transferring. - When this parameter is enabled: A) Application can read the results by calling Adc_ReadGroup(). B) The result buffer is no longer to be used to read the results as the results will be directly read from HW registers. C) This feature can be enabled only for ADC groups that consist of only 1 channel. - When this parameter is Disabled: Normal functionlaity shall be executed. Note: This is an Implementation Specific Parameter.
          boolean AdcGroupInBacktoBackMode: origin=NXP, post-build-variant-value=true, set at post-build in variant post-build / pre-compile in variant pre-compile, default-value=true  # Enable/ Disable the channel conversions occuring in Back to Back mode. The PDB hardware unit is used to initiate individual channel conversions that are required for each group conversion, with one PDB pretrigger controlling the timing of each ADC channel conversion. When AdcGroupInBacktoBackMode is enabled, the PDB pretriggers will be confiugred to work in back to back mode: PDB_CH1n_C1[BB] bits are set for all the group channels, except the first one. The first channel conversion complete will trigger the PDB channel's second pretrigger, and so on until the last channel of the group. This ensures that the channel conversions occur in sequence, as quickly as possible and without causing internal PDB errors. The Adc driver can convert only up to N channels at once; for groups larger than N channels, Adc driver will split the group in sub-groups of N and convert them with sub-group conversions. Interrupt processing is needed between the sub-groups for register re-configuration. The 16 channels are converted using 2 PDB channels (each controlling 8 pretriggers), but the 2 channels do not work in back to back mode together, so a delay is needed for the 2nd PDB channel, otherwise PDB errors will occur. Adc driver will configure this delay value when Back to back mode is used, with the value defined by the user in AdcDelayNextPdb parameter. The sequences of 8 channels associated to a PDB channel will happen in back to back mode. If AdcGroupInBacktoBackMode is not enabled for a group, all pretriggers of the PDB channels will be triggered at the same time causing internal PDB errors, unless the coherence of channel conversions is ensured via the delay configured for each pretrigger. This is why at least one of AdcGroupInBacktoBackMode and AdcGroupUsesChannelDelays options needs to be configured for an Adc Group. If both parameters are configured for the Adc Group, the user can configure a delay only for the first channel conversion, and the rest will be converted in back to back mode. If AdcGroupUsesChannelDelays is not configured for the group, the first channel will have an associated delay of 0, and will convert immediately after the external trigger is received.
          boolean AdcGroupUsesChannelDelays: origin=NXP, post-build-variant-value=true, set at post-build in variant post-build / pre-compile in variant pre-compile, default-value=false  # Enable/ Disable the usage of channel delays in PDB pretriggers. The PDB hardware unit is used to initiate individual channel conversions that are required for each group conversion, with one PDB pretrigger controlling the timing of each ADC channel conversion. When AdcGroupUsesChannelDelays is enabled, the PDB pretriggers will have individual delays configured. PDB_CH1nDLYx will be set with the values configured in AdcChannelDelay list for each channel. The values must not be equal or too close, otherwise PDB internal errors will occur. The Adc driver can convert only up to 16 channels at once; for groups larger than 16 channels, Adc driver will split the group in sub-groups of 16 and convert them with sub-group conversions. Interrupt processing is needed between the sub-groups for register re-configuration. The timing of the channel conversions will be accurate only for the first 16 channels; for the next ones, the on top of the configured delay, the delay of previous conversions and interrupt processing will be implicitly added. For this reason, it's safe co confiugre a delay of 0 for the 17th channel. But the delay values for each group of 16 need to be increasing, so that the channel conversions occur in the order they were defined in the group. If AdcGroupInBacktoBackMode is also configured for the Adc Group, the user can configure a delay only for the first channel conversion, and the rest will be converted in back to back mode (see description of AdcGroupInBacktoBackMode). The delay value defined by the user in AdcDelayNextPdb parameter will be used for 2nd PDB channel to avoid PDB internal errors.
          integer AdcDelayNextPdb: 0..65535, origin=NXP, post-build-variant-value=true, set at post-build in variant post-build / pre-compile in variant pre-compile, default-value=0  # The PDB unit can have one or more PDB Channels of 8 pretriggers each that will be used together for setting up conversions of large groups. The PDB Channels will be started together when the PDB unit is triggered, thus risking to request conversions at the same time and causing internal errors. For this reason, the value of AdcDelayNextPdb is needed to be added as delay between PDB channels when Back to Back mode is used. The AdcDelayNextPdb value should be greater than the timing to convert 8 channels. The maximum total conversion time is determined by the clock source chosen and the divide ratio selected. The clock source is selectable by CFG1[ADICLK], and the divide ratio is specified by CFG1[ADIV]. To calculate total conversion time for one channel the following formula is applied: ADC TOTAL CONVERSION TIME = Sample Phase Time (set by SMPLTS+1) + Hold Phase (1 ADC Cycle) + Compare Phase Time (8-bit Mode=20 ADC Cycles, 10-bit Mode=24 ADC Cycles, 12-bit Mode=28 ADC Cycles) + Single or First continuous time adder (5 ADC cycles + 5 bus clock cycles).
          integer AdcPdbPeriodContinuousMode: 0..65535, origin=NXP, post-build-variant-value=true, set at post-build in variant post-build / pre-compile in variant pre-compile, default-value=0  # The period of PBD module in continuous mode. This is specific and only used for continuous group without interrupt. The PDB period should be big enough to ensure all of the channels complete the convertion before PDB restarts
          integer AdcChannelDelay [0..*]: 0..65535, multiplicity set at post-build in variant post-build / pre-compile in variant pre-compile, origin=NXP, post-build-variant-value=true, set at post-build in variant post-build / pre-compile in variant pre-compile, default-value=0  # Delay of the associated PDB pretrigger for this channel. If Back to Back mode is not used for this group, the user must ensure the difference between the delays of different channels are big enough to accomodate the Adc conversions without PDB channel sequence errors. If Back to Back mode is used for this group, only the delay for the first channel will be considered - the rest of the channels will be converted in back to back mode. The delay value have to be a increasing numbers for each sequence of 16.
          reference AdcGroupDefinition [1..*]: multiplicity set at post-build in variant post-build / pre-compile in variant pre-compile, post-build-variant-multiplicity=true, post-build-variant-value=true, set at post-build in variant post-build / pre-compile in variant pre-compile, destination=AdcChannel  # Assignment of channels to a AdcGroups. For each AdcChannel that should belong to the group, a reference needs to be defined.
          container AdcGroupNormalConversionTimings [0..1]: multiplicity set at pre-compile  # Selects Normal values used for programming clock frequency, conversion timing and hardwre averaging used at initialization and also by Adc_SetClockMode API when it is called with parameter ADC_NORMAL.
            boolean AdcGroupHardwareAverageEnable: origin=NXP, post-build-variant-value=true, set at post-build in variant post-build / pre-compile in variant pre-compile, default-value=false  # Enables the hardware average function of the ADC.
            enumeration AdcGroupHardwareAverageSelect: {SAMPLES_4, SAMPLES_8, SAMPLES_16, SAMPLES_32}, origin=NXP, post-build-variant-value=true, set at post-build in variant post-build / pre-compile in variant pre-compile, default-value=SAMPLES_4  # Determines how many ADC conversions will be averaged to create the ADC average result. This functionality is activated when ADCx_SC3[AVGE] = 1. SAMPLES_4 - 4 samples averaged. SAMPLES_8 - 8 samples averaged. SAMPLES_16 - 16 samples averaged. SAMPLES_32 - 32 samples averaged. .
            integer AdcGroupSampleTimeDuration: 2..256, origin=NXP, post-build-variant-value=true, set at post-build in variant post-build / pre-compile in variant pre-compile, default-value=2  # Selects a sample time of 2 to 256 ADCK clock cycles. The value written to this register is the desired sample time minus 1.
            enumeration AdcGroupClockDivideSelect: {DIV_NONE, DIV_2, DIV_4, DIV_8}, origin=NXP, post-build-variant-value=true, set at post-build in variant post-build / pre-compile in variant pre-compile, default-value=DIV_NONE  # Selects the divide ratio used by the ADC to generate the internal clock ADCK. DIV_NONE - Input clock. DIV_2 - Input clock / 2. DIV_4 - Input clock / 4. DIV_8 - Input clock / 8. .
          container AdcGroupAlternateConversionTimings [0..1]: multiplicity set at pre-compile  # Selects alternate values used for programming clock frequency, conversion timing and hardwre averaging. This is available when AdcEnableDualClockMode has been enabled and AdcConvTimeOnce has been disable.
            boolean AdcGroupAltHardwareAverageEnable: origin=NXP, post-build-variant-value=true, set at post-build in variant post-build / pre-compile in variant pre-compile, default-value=false  # Enables the alternate hardware average function of the ADC.
            enumeration AdcGroupAltHardwareAverageSelect: {SAMPLES_4, SAMPLES_8, SAMPLES_16, SAMPLES_32}, origin=NXP, post-build-variant-value=true, set at post-build in variant post-build / pre-compile in variant pre-compile, default-value=SAMPLES_4  # Selects the Group Alternate Hardware Average to determine how many ADC conversions will be averaged to create the ADC average result. This functionality is activated when ADCx_SC3[AVGE] = 1. SAMPLES_4 - 4 samples averaged. SAMPLES_8 - 8 samples averaged. SAMPLES_16 - 16 samples averaged. SAMPLES_32 - 32 samples averaged. .
            integer AdcGroupAltSampleTimeDuration: 2..256, origin=NXP, post-build-variant-value=true, set at post-build in variant post-build / pre-compile in variant pre-compile, default-value=2  # Selects a alternate sample time of 2 to 256 ADCK clock cycles. The alternate value written to this register is the desired sample time minus 1.
            enumeration AdcGroupAltClockDivideSelect: {DIV_NONE, DIV_2, DIV_4, DIV_8}, origin=NXP, post-build-variant-value=true, set at post-build in variant post-build / pre-compile in variant pre-compile, default-value=DIV_NONE  # Selects the alternate divide ratio used by the ADC to generate the internal clock ADCK. DIV_NONE - Input clock. DIV_2 - Input clock / 2. DIV_4 - Input clock / 4. DIV_8 - Input clock / 8. .
    container AdcGeneral  # General configuration (parameters) of the ADC Driver software module.
      boolean AdcDeInitApi: set at pre-compile, default-value=true  # Adds/removes the service Adc_DeInit() from the code.
      boolean AdcDevErrorDetect: set at pre-compile, default-value=true  # Enable/Disable Development Error Detection.
      boolean AdcEnableLimitCheck: set at pre-compile, default-value=false  # Enable/disable limit checking feature in the ADC driver.
      boolean AdcEnableQueuing: set at pre-compile, default-value=true  # Enable/Disable the Queue. Note that if AdcPriorityImplementation=ADC_PRIORITY_HW_SW this field is always enabled.
      boolean AdcEnableStartStopGroupApi: set at pre-compile, default-value=true  # Adds / removes the services Adc_StartGroupConversion() and Adc_StopGroupConversion from the code.
      boolean AdcGrpNotifCapability: set at pre-compile, default-value=true  # Determines, if the group notification mechanism (the functions to enable and disable the notifications) is available at runtime.
      boolean AdcHwTriggerApi: set at pre-compile, default-value=false  # Adds / removes the services Adc_EnableHardwareTrigger() and Adc_DisableHardwareTrigger() from the code.
      boolean AdcReadGroupApi: set at pre-compile, default-value=true  # Adds / removes the service Adc_ReadGroup() from the code.
      boolean AdcVersionInfoApi: set at pre-compile, default-value=true  # Adds / removes the service Adc_GetVersionInfo() from the code.
      enumeration AdcPriorityImplementation: {ADC_PRIORITY_HW, ADC_PRIORITY_HW_SW, ADC_PRIORITY_NONE}, set at pre-compile, default-value=ADC_PRIORITY_NONE  # Select the Priority mechanism. In this version the ADC_PRIORITY_HW isn't used.
      enumeration AdcResultAlignment: {ADC_ALIGN_LEFT, ADC_ALIGN_RIGHT}, set at pre-compile, default-value=ADC_ALIGN_RIGHT  # Alignment of ADC raw results in ADC result buffer (left/right alignment).
      integer AdcTimeout: 1000..4294967295, origin=NXP, set at pre-compile, default-value=65535  # This is a timeout value which is used to wait till - ADC hardware is disabled - Convertion completed in calibration feature If the Status is not updated then after this timeout the ADC_E_TIMEOUT production error will be reported and the rest of the functionality will be skipped
      integer AdcDmaTimeout: 1000..4294967295, origin=NXP, set at pre-compile, default-value=65535  # This is a timeout value which is used to wait till Dma transfering finish. It's used to ensure the re-configure dma setting when PDB error occur If the Status is not updated then after this timeout the ADC_E_TIMEOUT production error will be reported and the rest of the functionality will be skipped.
      integer AdcPriorityQueueMaxDepth: 1..1024, origin=NXP, set at pre-compile, default-value=1  # Maximum depth of queue used for queuing of incoming conversion requests when hardware unit is busy.
      boolean AdcLowPowerStatesSupport [0..1]: multiplicity set at pre-compile, set at pre-compile, default-value=false  # Adds / removes all power state management related APIs (Adc_SetPowerState, Adc_GetCurrentPowerState, Adc_GetTargetPowerState, Adc_PreparePowerState, Adc_Main_PowerTransitionManager), indicating if the HW offers low power state management. This parameter is disabled, there is no power management support implemented for this platform.
      boolean AdcPowerStateAsynchTransitionMode [0..1]: multiplicity set at pre-compile, set at pre-compile, default-value=false  # Enables / disables support of the ADCDriver to the asynchronous power state transition. This feature is not implemented on this platform.
      container AdcPowerStateConfig [0..*]: multiplicity set at pre-compile  # Each instance of this parameter defines a power state and the callback to be called when this power state is reached.
        integer AdcPowerState: 0..18446744073709551615, set at pre-compile, symbolic-name-value=true, default-value=0  # Each instance of this parameter describes a different power state supported by the ADC HW. It should be defined by the HW supplier and used by the ADCDriver to reference specific HW configurations which set the ADC HW module in the referenced power state. At least the power mode corresponding to full power state shall be always configured. This parameter shall only be configured if the parameter AdcLowPowerStatesSupport is set to true.
        function name AdcPowerStateReadyCbkRef: set at pre-compile, default-value=NULL_PTR  # Each instance of this parameter contains a reference to a power mode callback defined in a CDD or IoHwAbs component. This parameter shall only be configured if the parameter AdcLowPowerStatesSupport is set to true
    container AdcInterrupt [2..*]: multiplicity set at pre-compile  # Selects whether the interrupt for each ADC Unit will be enabled. For each Adc HW unit, there are 2 interrupts that can be enabled: the End of Conversion and the Watchdong interrupts. These settings are used for optimizing the code size by removing the interrupt handling code for interrupts that are not needed. .
      enumeration AdcInterruptSource: {ADC0_COCO, ADC1_COCO}, origin=NXP, set at pre-compile, default-value=ADC0_COCO  # The name of the interrupt. Note: Implementation Specific Parameter.
      boolean AdcInterruptEnable: origin=NXP, set at pre-compile, default-value=false  # Adds / removes the interrupt handling routine from the ADC driver code.
    container AdcPublishedInformation  # Additional published parameters not covered by CommonPublishedInformation container. Note that these parameters do not have any configuration class setting, since they are published information.
      boolean AdcChannelValueSigned: set at published-information, default-value=false  # Information whether the result value of the ADC driver has sign information (true) or not (false). If the result shall be interpreted as signed value it shall apply to C-language rules.
      boolean AdcGroupFirstChannelFixed: set at published-information, default-value=false  # Information whether the first channel of an ADC Channel group can be configured (false) or is fixed (true) to a value determined by the ADC HW Unit.
      integer AdcMaxChannelResolution: 1..63, set at published-information, default-value=12  # Maximum Channel resolution in bits (does not specify accuracy).
    container CommonPublishedInformation  # Common container, aggregated by all modules. It contains published information about vendor and versions.
      integer ArReleaseMajorVersion: 4..4, origin=NXP, set at published-information, default-value=4  # Major version number of AUTOSAR specification on which the appropriate implementation is based on.
      integer ArReleaseMinorVersion: 2..2, origin=NXP, set at published-information, default-value=2  # Minor version number of AUTOSAR specification on which the appropriate implementation is based on.
      integer ArReleaseRevisionVersion: 2..2, origin=NXP, set at published-information, default-value=2  # Revision version number of AUTOSAR specification on which the appropriate implementation is based on.
      integer ModuleId: 123..123, origin=NXP, set at published-information, default-value=123  # Module ID of this module from Module List.
      integer SwMajorVersion: 1..1, origin=NXP, set at published-information, default-value=1  # Major version number of the vendor specific implementation of the module. The numbering is vendor specific.
      integer SwMinorVersion: 0..0, origin=NXP, set at published-information, default-value=0  # Minor version number of the vendor specific implementation of the module. The numbering is vendor specific.
      integer SwPatchVersion: 2..2, origin=NXP, set at published-information, default-value=2  # Patch level version number of the vendor specific implementation of the module. The numbering is vendor specific.
      string VendorApiInfix: origin=NXP, set at published-information  # In driver modules which can be instantiated several times on a single ECU, BSW00347 requires that the name of APIs is extended by the VendorId and a vendor specific name. This parameter is used to specify the vendor specific name. In total, the implementation specific name is generated as follows: <ModuleName>_>VendorId>_<VendorApiInfix>. E.g. assuming that the VendorId of the implementor is 123 and the implementer chose a VendorApiInfix of "v11r456" a api name Can_Write defined in the SWS will translate to Can_123_v11r456Write. This parameter is mandatory for all modules with upper multiplicity > 1. It shall not be used for modules with upper multiplicity =1.
      integer VendorId: 43..43, origin=NXP, set at published-information, default-value=43  # Vendor ID of the dedicated implementation of this module according to the AUTOSAR vendor list.
    container NonAutosar  # Non Autosar API settings.
      boolean AdcEnableGroupDependentChannelNames: origin=NXP, set at pre-compile, default-value=false  # This is used to generate ADC symbolic names, that depend also on the ADC group to which each ADC channel is mapped. The generated symbolic name will be something like: #define "ADC_GroupName"_"ADC_ChannelName" "Channel index value", where "Channel index value" is the channel index in the current group. Channel indexes in each group are generated to allow result buffer access by symbolic names.
      boolean AdcEnableDualClockMode: origin=NXP, set at pre-compile, default-value=false  # Adds/removes the Dual Clock mode service Adc_SetClockMode from the code.
      boolean AdcEnableCalibration: origin=NXP, set at pre-compile, default-value=false  # If this parameter has been configured to "TRUE", the Non-Autosar function "Adc_Calibrate()" shall be accessible, otherwise this function shall be removed from the code. NoteThis is an Implementation Specific Parameter.
      boolean AdcEnableSetChannel: origin=NXP, set at pre-compile, default-value=false  # If this parameter has been configured to "TRUE", the Non-Autosar function "Adc_SetChannel()" shall be accessible, otherwise this function shall be removed from the code. NoteThis is an Implementation Specific Parameter.
      boolean AdcEnableInitialNotification: origin=NXP, set at pre-compile, default-value=false  # Enable/disable an extra notification to be called for each Adc Group conversion. NoteThis feature is intended to be used together with Adc_SetChannel service. The initial notification can be used by the user application to call Adc_SetChannel API before Adc driver updates the HW configuration for the next conversion.
      boolean AdcDisableDemReportErrorStatus: origin=NXP, set at pre-compile, default-value=false  # Enable/Disable Dem error reporting.
      boolean AdcConvTimeOnce: origin=NXP, set at pre-compile, default-value=false  # Implementation Specific Parameter. Enable/Disable one time setting of the registers. If Enabled, the setting of the conversion time registers will be done only once in Adc_Init() function for the configured hardware unit.
      boolean AdcOptimizeOneShotHwTriggerConversions: origin=NXP, set at pre-compile, default-value=false  # Implementation Specific Parameter. Enable/Disable The Adc driver optimization for HW Triggered groups, OneShot, Single access. If Enabled, other types of groups cannot be configured in ADC driver and the code for interrupt routine / Dma notification will be optimized for speed. Also, all groups must have at most 8 channels configrued.
      boolean AdcEnableDoubleBufferingOptimization: origin=NXP, set at pre-compile, default-value=false  # Implementation Specific Parameter. Enable/Disable The Adc driver double buffering optimization for HW Triggered groups, OneShot, Streamin access, Circular Buffer. Also, all groups that enable this feature must have at only 1 channels configrued.
      boolean AdcEnableDmaTrasferMode: origin=NXP, set at pre-compile, default-value=false  # This parameter globally enables the possibility to confiugre DMA transfer for ADC converted data. If this parameter is disabled then DMA handling code will be removed at pre-compile time and DMA transfer cannot be confiugred for any Adc unit in any variant. If this parameter is enabled then the DMA confiugration code will not be removed. This is an Implementation Specific Parameter.
      boolean AdcUseHardwareNormalGroups: origin=NXP, set at pre-compile, default-value=false  # This parameter defines if Hardware Normal Groups are used in any Hardware Unit, any variant. It needs to be enabled if Hardware Normal Groups are needed. If Hardware Normal Groups are not needed, this parameter should be disabled - for code optimizations. This is an Implementation Specific Parameter.
      boolean AdcEnableUserModeSupport: origin=NXP, set at pre-compile, default-value=false  # When this parameter is enabled, the Adc module will adapt to run from User Mode. Note: No special measures need to be taken to run ADC driver from user mode; The Adc driver code can be executed at any time from both supervisor and user mode.
      boolean AdcBypassConsistencyLoop: origin=NXP, set at pre-compile, default-value=false  # This is used to increase ADC performances. If checking the HW-SW coherency is no longer guaranteed by the driver, the user must make sure he does not call a ADC service before the HW reaches the correct state.
      boolean AdcContinuousWithoutInterrupt: origin=NXP, set at pre-compile, default-value=false  # This parameter globally enables the possibility to confiugre continuous without interrupt. This is an Implementation Specific Parameter.
    container AdcDemEventParameterRefs [0..1]: multiplicity set at pre-compile  # Container for the references to DemEventParameter elements which shall be invoked using the API Serr_NotifyErrorEvent API in case the corresponding error occurs. The EventId is taken from the referenced DemEventParameter's DemEventId value. The standardized errors are provided in the container and can be extended by vendor specific error references.
      symbolic name reference ADC_E_TIMEOUT [0..1]: multiplicity set at pre-compile, origin=NXP, set at pre-compile, destination=DemEventParameter  # Reference to configured DEM event to report "Timeout failure".
