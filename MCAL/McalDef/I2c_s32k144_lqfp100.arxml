AUTOSAR XML (schema 4-3-0)
package /TS_T40D2M10I2R0
  ecuc definition collection I2c_EcuParameterDefinition: module=I2c
  module definition I2c: post-build-variant-support=true, variants post-build/pre-compile  # Configuration of the Inter-integrated circuit (I2c) module.
    container GeneralConfiguration  # GeneralConfiguration This container contains the global configuration parameters of the Non-Autosar I2c driver. Note: Implementation Specific Parameter.
      boolean I2cDevErrorDetect: origin=NXP, set at pre-compile, default-value=true  # I2cDevErrorDetect Switches the Development Error Detection and Notification ON or OFF. Note: Implementation Specific Parameter.
      boolean I2cDisableDemReportErrorStatus: origin=NXP, set at pre-compile, default-value=false  # I2cDisableDemReportErrorStatus Switches the Diagnostic Error Reporting and Notification OFF. Note: Implementation Specific Parameter.
      boolean I2cDmaUsed: origin=NXP, set at pre-compile, default-value=false  # I2cDmaUsed Check this in order to be able to use DMA in the I2c driver. Leaving this unchecked will allow the I2c driver to compile with no dependencies from the Mcl driver. Note: Implementation Specific Parameter.
      boolean I2cFlexIOUsed: origin=NXP, set at pre-compile, default-value=false  # I2cFlexIOUsed Check this in order to be able to use FlexIO channels. Leaving this unchecked will allow the I2c driver to generate code without configuring the FlexIO module. Note: Implementation Specific Parameter.
      integer I2cTimeoutDuration: 1..65535, origin=NXP, set at pre-compile, default-value=1000  # Specifies the maximum number of loops for blocking function until a timeout is raised in short term wait loops Note: Implementation Specific Parameter.
      boolean I2cVersionInfoApi: origin=NXP, set at pre-compile, default-value=true  # I2cVersionInfoApi Switches the I2c_GetVersionInfo function ON or OFF. Note: Implementation Specific Parameter.
      function name I2cErrorNotification [0..1]: multiplicity set at pre-compile, origin=NXP, set at pre-compile, default-value=NULL_PTR  # Function name of callout. This function will be called if an error is detected. Note: Implementation Specific Parameter.
      function name I2cMasterTransmitCompleteNotification [0..1]: multiplicity set at pre-compile, origin=NXP, set at pre-compile, default-value=NULL_PTR  # Function name of callout. This function will be called when a data transmission completes. (Only applicable in master mode!) Note: Implementation Specific Parameter.
      function name I2cMasterReceiveCompleteNotification [0..1]: multiplicity set at pre-compile, origin=NXP, set at pre-compile, default-value=NULL_PTR  # Function name of callout. This function will be called when a data reception completes. (Only applicable in master mode!) Note: Implementation Specific Parameter.
      function name I2cSlaveAddressMatchNotification [0..1]: multiplicity set at pre-compile, origin=NXP, set at pre-compile, default-value=NULL_PTR  # Function name of callout. This function will be called if an address matching is detected. Note: Implementation Specific Parameter.
      function name I2cSlaveTransmitCompleteNotification [0..1]: multiplicity set at pre-compile, origin=NXP, set at pre-compile, default-value=NULL_PTR  # Function name of callout. This function will be called when a data transmission completes. (Only applicable in slave mode!) Note: Implementation Specific Parameter.
      function name I2cSlaveReceiveCompleteNotification [0..1]: multiplicity set at pre-compile, origin=NXP, set at pre-compile, default-value=NULL_PTR  # Function name of callout. This function will be called when a data reception completes. (Only applicable in slave mode!) Note: Implementation Specific Parameter.
      function name I2cSlaveByteReceiveNotification [0..1]: multiplicity set at pre-compile, origin=NXP, set at pre-compile, default-value=NULL_PTR  # Function name of callout. This function will be called every time (after) a byte is received. (Only applicable in slave mode!) This function must have the following signature/prototype: boolean(uint8 u8ChannelIndex, uint8 u8ByteIndex). The Slave will send: 1. ACK when this function returns TRUE. 2. NACK when this function returns FALSE. Note: Implementation Specific Parameter.
      boolean I2cEnableUserModeSupport: origin=NXP, set at pre-compile, default-value=false  # When this parameter is enabled, the I2c module will adapt to run from User Mode. Note I2c module does not include registers protection. So, It is accessible to all registered in any public mode. I2c is not affected by this field.
    container I2cGlobalConfig  # This container contains the global configuration parameter of the I2c driver. This container is a MultipleConfigurationContainer, i.e. this container and its sub-containers exit once per configuration set.
      container I2cFlexIOModuleConfiguration  # This container contains the configuration (parameters) of the Master Configuration.
        reference I2cClockRef [0..1]: multiplicity set at post-build in variant post-build / pre-compile in variant pre-compile, origin=NXP, post-build-variant-value=true, set at post-build in variant post-build / pre-compile in variant pre-compile, destination=McuClockReferencePoint  # Reference to the FlexIO clock source configuration, which is set in the MCU driver configuration. Note: Implementation Specific Parameter.
      container I2cChannel [1..3]: multiplicity set at pre-compile  # This container contains the configuration (parameters) of the I2c Controller(s). Note:"User should use unique names for naming the I2c channels across different I2cGlobalConfig Sets."
        integer I2cChannelId: 0..2, origin=NXP, set at pre-compile, symbolic-name-value=true, default-value=1  # Identifies the I2c channel. Note: Implementation Specific Parameter.
        enumeration I2cHwChannel: {LPI2C_0, FLEXIO_0_CH_0_1, FLEXIO_0_CH_2_3}, origin=NXP, set at pre-compile, default-value=LPI2C_0  # Selects the physical I2c Channel. Note: Implementation Specific Parameter.
        enumeration I2cMasterSlaveConfiguration: {MASTER_MODE, SLAVE_MODE}, origin=NXP, post-build-variant-value=true, set at pre-compile in variant pre-compile / post-build in variant post-build, default-value=MASTER_MODE  # Selects the master slave configuration. Select wether the selected channel will be used as Master, Slave or both. Note: Implementation Specific Parameter.
        enumeration I2cPinConfiguration: {PINCFG_2PIN_OPEN_DRAIN, PINCFG_2PIN_PUSH_PULL, PINCFG_2PIN_OUTPUT_ONLY, PINCFG_2PIN_OPEN_DRAIN_SEPARATE_SLAVE, PINCFG_2PIN_PUSH_PULL_SEPARATE_SLAVE}, origin=NXP, post-build-variant-value=true, set at pre-compile in variant pre-compile / post-build in variant post-build, default-value=PINCFG_2PIN_OPEN_DRAIN  # Selects the pin configuration. Configures the pin mode. 000b - LPI2C configured for 2-pin open drain mode (Master and Slave using SDA/SCL). 001b - LPI2C configured for 2-pin output only mode in UFM (NOT SUPPORTED!). 010b - LPI2C configured for 2-pin push-pull mode (Master and Slave using SDA/SCL). 100b - LPI2C configured for 2-pin open drain mode with separate LPI2C slave (Master using SDA/SCL, Slave using SDAS/SCLS). 110b - LPI2C configured for 2-pin push-pull mode with separate LPI2C slave (Master using SDA/SCL, Slave using SDAS/SCLS). Note: Implementation Specific Parameter.
        container I2cMasterConfiguration  # This container contains the configuration (parameters) of the Master Configuration.
          boolean I2cMasterEnabledInDebug: origin=NXP, post-build-variant-value=true, set at post-build in variant post-build / pre-compile in variant pre-compile, default-value=false  # I2cMasterEnabledInDebug configures LPI2C_MCR[DBGEN] Check to enable the master in debug mode. Uncheck to disable it. Note: Implementation Specific Parameter.
          boolean I2cMasterEnabledInDozeMode: origin=NXP, post-build-variant-value=true, set at post-build in variant post-build / pre-compile in variant pre-compile, default-value=true  # I2cMasterEnabledInDozeMode configures LPI2C_MCR[DOZEN] Check to enable the master in doze mode. Uncheck to disable it. Note: Implementation Specific Parameter.
          enumeration I2cAsyncMethod: {INTERRUPT, DMA}, origin=NXP, post-build-variant-value=true, set at post-build in variant post-build / pre-compile in variant pre-compile, default-value=INTERRUPT  # Configures the asynchronous mechanism used by the 'AsyncTransmit' function (interrupts or DMA). Note: Implementation Specific Parameter.
          enumeration I2cPrescaler: {DIVIDE_BY_1, DIVIDE_BY_2, DIVIDE_BY_4, DIVIDE_BY_8, DIVIDE_BY_16, DIVIDE_BY_32, DIVIDE_BY_64, DIVIDE_BY_128}, origin=NXP, post-build-variant-value=true, set at post-build in variant post-build / pre-compile in variant pre-compile, default-value=DIVIDE_BY_1  # PRESCALE: Configures LPI2C_MCFGR1[PRESCALE] Configures the clock prescaler used for all LPI2C master logic, except the digital glitch filters. Note: Implementation Specific Parameter.
          integer I2cGlitchFilterSDA: 0..15, origin=NXP, post-build-variant-value=true, set at post-build in variant post-build / pre-compile in variant pre-compile, default-value=0  # Glitch Filter SDA: Configures LPI2C_MCFGR2[FILTSDA] Configures the I2c master digital glitch filters for SDA input, a configuration of 0 will disable the glitch filter. Glitches equal to or less than FILTSDA cycles long will be filtered out and ignored. The latency through the glitch filter is equal to FILTSDA cycles and must be configured less than the minimum SCL low or high period. The glitch filter cycle count is not affected by the PRESCALE configuration and is automatically bypassed in High Speed mode. Note: Implementation Specific Parameter.
          integer I2cGlitchFilterSCL: 0..15, origin=NXP, post-build-variant-value=true, set at post-build in variant post-build / pre-compile in variant pre-compile, default-value=0  # Glitch Filter SCL: Configures LPI2C_MCFGR2[FILTSCL] Configures the I2c master digital glitch filters for SCL input, a configuration of 0 will disable the glitch filter. Glitches equal to or less than FILTSCL cycles long will be filtered out and ignored. The latency through the glitch filter is equal to FILTSCL cycles and must be configured less than the minimum SCL low or high period. The glitch filter cycle count is not affected by the PRESCALE configuration and is automatically bypassed in High Speed mode. Note: Implementation Specific Parameter.
          integer I2cBusIdleTimeout: 0..4095, origin=NXP, post-build-variant-value=true, set at post-build in variant post-build / pre-compile in variant pre-compile, default-value=0  # Bus Idle Timeout: Configures LPI2C_MCFGR2[BUSIDLE] Configures the bus idle timeout period in clock cycles. If both SCL and SDA are high for longer than BUSIDLE cycles, then the I2c bus is assumed to be idle and the master can generate a START condition. When set to zero, this feature is disabled. Note: Implementation Specific Parameter.
          integer I2cPinLowTimeout: 0..4095, origin=NXP, post-build-variant-value=true, set at post-build in variant post-build / pre-compile in variant pre-compile, default-value=0  # Pin Low Timeout: Configures LPI2C_MCFGR3[PINLOW] Configures the pin low timeout flag in clock cycles. If SCL and/or SDA is low for longer than (PINLOW * 256) cycles then PLTF is set. When set to zero, this feature is disabled. Note: Implementation Specific Parameter.
          integer I2cDataValidDelay: 1..63, origin=NXP, post-build-variant-value=true, set at post-build in variant post-build / pre-compile in variant pre-compile, default-value=1  # Data Valid Delay: Configures LPI2C_MCCR0[DATAVD] Minimum number of cycles (minus one) that is used as the data hold time for SDA. Must be configured less than the minimum SCL low period. Note: Implementation Specific Parameter.
          integer I2cSetupHoldDelay: ..63, origin=NXP, post-build-variant-value=true, set at post-build in variant post-build / pre-compile in variant pre-compile, default-value=2  # Setup Hold Delay: Configures LPI2C_MCCR0[SETHOLD] Minimum number of cycles (minus one) that is used by the master as the setup and hold time for a (repeated) START condition and setup time for a STOP condition. The setup time is extended by the time it takes to detect a rising edge on the external SCL pin. Ignoring any additional board delay due to external loading, this is equal to (2 + FILTSCL) / 2^PRESCALE cycles. Note: Implementation Specific Parameter.
          integer I2cClockHighPeriod: 1..63, origin=NXP, post-build-variant-value=true, set at post-build in variant post-build / pre-compile in variant pre-compile, default-value=1  # Clock High Period: Configures LPI2C_MCCR0[CLKHI] Minimum number of cycles (minus one) that the SCL clock is driven high by the master. The SCL high time is extended by the time it takes to detect a rising edge on the external SCL pin. Ignoring any additional board delay due to external loading, this is equal to (2 + FILTSCL) / 2^PRESCALE cycles. Note: Implementation Specific Parameter.
          integer I2cClockLowPeriod: 3..63, origin=NXP, post-build-variant-value=true, set at post-build in variant post-build / pre-compile in variant pre-compile, default-value=3  # Clock Low Period: Configures LPI2C_MCCR0[CLKLO] Minimum number of cycles (minus one) that the SCL clock is driven low by the master. This value is also used for the minimum bus free time between a STOP and a START condition. Note: Implementation Specific Parameter.
          float I2cBaudRate: 0.0..6000000.0, origin=NXP, post-build-variant-value=true, set at post-build in variant post-build / pre-compile in variant pre-compile, default-value=0.0  # Calculated as Frequency/(((CLKLO+CLKHI+2)*2^PRESCALER)+ROUNDDOWN((2+FILTSCL)/2^PRESCALER)) The functional clock must be at least 8 times faster than the I2c bus bandwidth. Note: Implementation Specific Parameter.
          reference I2cClockRef [0..1]: multiplicity set at post-build in variant post-build / pre-compile in variant pre-compile, origin=NXP, post-build-variant-value=true, set at post-build in variant post-build / pre-compile in variant pre-compile, destination=McuClockReferencePoint  # Reference to the I2c clock source configuration, which is set in the MCU driver configuration. Note: Implementation Specific Parameter.
          reference I2cDmaTxChannelRef [0..1]: multiplicity set at post-build in variant post-build / pre-compile in variant pre-compile, origin=NXP, post-build-variant-value=true, set at post-build in variant post-build / pre-compile in variant pre-compile, destination=DMAChannel  # Reference to the DMA TX channel, which is set in the Mcl driver configuration. Note: Implementation Specific Parameter.
          reference I2cDmaRxChannelRef [0..1]: multiplicity set at post-build in variant post-build / pre-compile in variant pre-compile, origin=NXP, post-build-variant-value=true, set at post-build in variant post-build / pre-compile in variant pre-compile, destination=DMAChannel  # Reference to the DMA RX channel, which is set in the Mcl driver configuration. Note: Implementation Specific Parameter.
          container I2cHighSpeedModeConfiguration  # This container contains the configuration (parameters) of the Master Clock Configuration Register 1.
            integer I2cDataValidDelay: 1..63, origin=NXP, post-build-variant-value=true, set at post-build in variant post-build / pre-compile in variant pre-compile, default-value=1  # Data Valid Delay: Configures LPI2C_MCCR1[DATAVD] Minimum number of cycles (minus one) that is used as the data hold time for SDA. Must be configured less than the minimum SCL low period. Note: Implementation Specific Parameter.
            integer I2cSetupHoldDelay: ..63, origin=NXP, post-build-variant-value=true, set at post-build in variant post-build / pre-compile in variant pre-compile, default-value=2  # Setup Hold Delay: Configures LPI2C_MCCR1[SETHOLD] Minimum number of cycles (minus one) that is used by the master as the setup and hold time for a (repeated) START condition and setup time for a STOP condition. The setup time is extended by the time it takes to detect a rising edge on the external SCL pin. Ignoring any additional board delay due to external loading, this is equal to (2 + FILTSCL) / 2^PRESCALE cycles. Note: Implementation Specific Parameter.
            integer I2cClockHighPeriod: 1..63, origin=NXP, post-build-variant-value=true, set at post-build in variant post-build / pre-compile in variant pre-compile, default-value=1  # Clock High Period: Configures LPI2C_MCCR1[CLKHI] Minimum number of cycles (minus one) that the SCL clock is driven high by the master. The SCL high time is extended by the time it takes to detect a rising edge on the external SCL pin. Ignoring any additional board delay due to external loading, this is equal to (2 + FILTSCL) / 2^PRESCALE cycles. Note: Implementation Specific Parameter.
            integer I2cClockLowPeriod: 3..63, origin=NXP, post-build-variant-value=true, set at post-build in variant post-build / pre-compile in variant pre-compile, default-value=3  # Clock Low Period: Configures LPI2C_MCCR1[CLKLO] Minimum number of cycles (minus one) that the SCL clock is driven low by the master. This value is also used for the minimum bus free time between a STOP and a START condition. Note: Implementation Specific Parameter.
            float I2cHighSpeedBaudRate: 0.0..6000000.0, origin=NXP, post-build-variant-value=true, set at post-build in variant post-build / pre-compile in variant pre-compile, default-value=0.0  # Calculated as Frequency/(((CLKLO+CLKHI+2)*2^PRESCALER)+ROUNDDOWN((2+FILTSCL)/2^PRESCALER)) The functional clock must be at least 8 times faster than the I2c bus bandwith. Note: Implementation Specific Parameter.
        container I2cSlaveConfiguration  # This container contains the configuration (parameters) of the Slave Channel.
          integer I2cSlaveAddress: 0..1023, origin=NXP, post-build-variant-value=true, set at post-build in variant post-build / pre-compile in variant pre-compile, default-value=0  # The address of the slave: Configures LPI2C_SAMR[ADDR0] Configures the I2c slave address. Note: Implementation Specific Parameter.
          boolean I2cSlaveDisableFilterInDoze: origin=NXP, post-build-variant-value=true, set at post-build in variant post-build / pre-compile in variant pre-compile, default-value=false  # I2cSlaveDisableFilterInDoze configures LPI2C_SCR[FILTDZ] Check to disable the filter in Doze mode. Uncheck to have the filters enabled in Doze mode. Note: Implementation Specific Parameter.
          boolean I2cSlaveFilterEnable: origin=NXP, post-build-variant-value=true, set at post-build in variant post-build / pre-compile in variant pre-compile, default-value=true  # I2cSlaveFilterEnable configures LPI2C_SCR[FILTEN] Check to enable the digital filter and output delay counter for slave mode. Note: Implementation Specific Parameter.
          boolean I2cSlaveAckStall: origin=NXP, post-build-variant-value=true, set at post-build in variant post-build / pre-compile in variant pre-compile, default-value=false  # I2cSlaveAckStall configures LPI2C_SCFGR1[ACKSTALL] Enables SCL clock stretching during slave-transmit address byte(s) and slave-receiver address and data byte(s) to allow software to write the Transmit ACK Register before the ACK or NACK is transmitted. Clock stretching occurs when transmitting the 9th bit and is therefore not compatible with high speed mode. When ACKSTALL is enabled, there is no need to set either RXSTALL or ADRSTALL. Note: Implementation Specific Parameter.
          boolean I2cSlaveTxStall: origin=NXP, post-build-variant-value=true, set at post-build in variant post-build / pre-compile in variant pre-compile, default-value=false  # I2cSlaveAckStall configures LPI2C_SCFGR1[TXSTALL] Enables SCL clock stretching when the transmit data flag is set during a slave-transmit transfer. Clock stretching occurs following the 9th bit and is therefore compatible with high speed mode. Note: Implementation Specific Parameter.
          boolean I2cSlaveRxStall: origin=NXP, post-build-variant-value=true, set at post-build in variant post-build / pre-compile in variant pre-compile, default-value=false  # I2cSlaveAckStall configures LPI2C_SCFGR1[RXSTALL] Enables SCL clock stretching when the receive data flag is set during a slave-receive transfer. Clock stretching occurs following the 9th bit and is therefore compatible with high speed mode. Note: Implementation Specific Parameter.
          boolean I2cSlaveAdrStall: origin=NXP, post-build-variant-value=true, set at post-build in variant post-build / pre-compile in variant pre-compile, default-value=false  # I2cSlaveAdrStall configures LPI2C_SCFGR1[ADRSTALL] Enables SCL clock stretching when the address valid flag is asserted. Clock stretching only occurs following the 9th bit and is therefore compatible with high speed mode. Note: Implementation Specific Parameter.
          integer I2cGlitchFilterSDA: 0..15, origin=NXP, post-build-variant-value=true, set at post-build in variant post-build / pre-compile in variant pre-compile, default-value=0  # Glitch Filter SDA: Configures LPI2C_MCFGR2[FILTSDA] Configures the I2c master digital glitch filters for SDA input, a configuration of 0 will disable the glitch filter. Glitches equal to or less than FILTSDA cycles long will be filtered out and ignored. The latency through the glitch filter is equal to FILTSDA cycles and must be configured less than the minimum SCL low or high period. The glitch filter cycle count is not affected by the PRESCALE configuration and is automatically bypassed in High Speed mode. Note: Implementation Specific Parameter.
          integer I2cGlitchFilterSCL: 0..15, origin=NXP, post-build-variant-value=true, set at post-build in variant post-build / pre-compile in variant pre-compile, default-value=0  # Glitch Filter SCL: Configures LPI2C_MCFGR2[FILTSCL] Configures the I2c master digital glitch filters for SCL input, a configuration of 0 will disable the glitch filter. Glitches equal to or less than FILTSCL cycles long will be filtered out and ignored. The latency through the glitch filter is equal to FILTSCL cycles and must be configured less than the minimum SCL low or high period. The glitch filter cycle count is not affected by the PRESCALE configuration and is automatically bypassed in High Speed mode. Note: Implementation Specific Parameter.
          integer I2cDataValidDelay: 0..63, origin=NXP, post-build-variant-value=true, set at post-build in variant post-build / pre-compile in variant pre-compile, default-value=0  # Data Valid Delay: Configures LPI2C_SCFGR2[DATAVD] Configures the SDA data valid delay time for the I2c slave equal to FILTSCL+DATAVD+3 cycles. This data valid delay must be configured to less than the minimum SCL low period. The I2c slave data valid delay time is not affected by the PRESCALE configuration, and is disabled in high speed mode. Note: Implementation Specific Parameter.
          integer I2cClockHoldPeriod: 0..15, origin=NXP, post-build-variant-value=true, set at post-build in variant post-build / pre-compile in variant pre-compile, default-value=0  # Clock Hold Period: Configures LPI2C_SCFGR2[CLKHOLD] Minimum number of cycles (minus one) that the SCL clock is driven high by the master. Configures the minimum clock hold time for the I2c slave, when clock stretching is enabled. The minimum hold time is equal to CLKHOLD+3 cycles. The I2c slave clock hold time is not affected by the PRESCALE configuration, and is disabled in high speed mode. Note: Implementation Specific Parameter.
        container I2cFlexIOConfiguration  # This container contains the configuration (parameters) of the Master Configuration.
          enumeration I2cAsyncMethod: {INTERRUPT, DMA}, origin=NXP, post-build-variant-value=true, set at post-build in variant post-build / pre-compile in variant pre-compile, default-value=INTERRUPT  # Configures the asynchronous mechanism used by the 'AsyncTransmit' function (interrupts or DMA). Note: Implementation Specific Parameter.
          enumeration I2cFlexIOSclPin: {FXIO_D0, FXIO_D1, FXIO_D2, FXIO_D3, FXIO_D4, FXIO_D5, FXIO_D6, FXIO_D7}, origin=NXP, set at post-build in variant post-build / pre-compile in variant pre-compile, default-value=FXIO_D1  # This configures FLEXIO_TIMCTLa[PINSEL] Selects which pin is used by the Timer input or output. PINSEL=i will select the FXIO_Di pin. Note: Implementation Specific Parameter.
          enumeration I2cFlexIOSdaPin: {FXIO_D0, FXIO_D1, FXIO_D2, FXIO_D3, FXIO_D4, FXIO_D5, FXIO_D6, FXIO_D7}, origin=NXP, set at post-build in variant post-build / pre-compile in variant pre-compile, default-value=FXIO_D0  # This configures FLEXIO_SHIFTCTLa[PINSEL] Selects which pin is used by the Shifter input or output. PINSEL=i will select the FXIO_Di pin. Note: Implementation Specific Parameter.
          integer I2cFlexIOCompareValue: 0..255, origin=NXP, post-build-variant-value=true, set at post-build in variant post-build / pre-compile in variant pre-compile, default-value=8  # This configures FLEXIO_TIMCMPa[CMP[7:0]] This is used to calculate the Baud rate of the I2c. The baud rate divider is equal to (CMP[7:0] + 1) * 2. The divider will be (input_clock + desired_baud_rate) div (2* desired_baud_rate) - 2. The extra -1 is from the timer reset setting used for clock stretching. Round to nearest integer. This must be manually inserted, and the baud rate will be calculated based on it. Note: Implementation Specific Parameter.
          float I2cBaudRate: 0.0..6000000.0, origin=NXP, post-build-variant-value=true, set at post-build in variant post-build / pre-compile in variant pre-compile, default-value=0.0  # Considering Timer Compare Value = cmp and Frequency the input frequency of the FlexIO the baud rate is calculated as: Frequency div (2 * cmp + 3) Note: Implementation Specific Parameter.
          reference I2cDmaTxChannelRef [0..1]: multiplicity set at post-build in variant post-build / pre-compile in variant pre-compile, origin=NXP, post-build-variant-value=true, set at post-build in variant post-build / pre-compile in variant pre-compile, destination=DMAChannel  # Reference to the DMA TX channel, which is set in the Mcl driver configuration. Note: Implementation Specific Parameter.
          reference I2cDmaRxChannelRef [0..1]: multiplicity set at post-build in variant post-build / pre-compile in variant pre-compile, origin=NXP, post-build-variant-value=true, set at post-build in variant post-build / pre-compile in variant pre-compile, destination=DMAChannel  # Reference to the DMA RX channel, which is set in the Mcl driver configuration. Note: Implementation Specific Parameter.
      container I2cDemEventParameterRefs [0..1]: multiplicity set at pre-compile  # Container for the references to DemEventParameter elements which shall be invoked using the API Dem_ReportErrorStatus API in case the corresponding error occurs. The EventId is taken from the referenced DemEventParameter's DemEventId value. The standardized errors are provided in the container and can be extended by vendor specific error references.
        symbolic name reference I2C_E_TIMEOUT_FAILURE [0..1]: multiplicity set at pre-compile, origin=NXP, set at pre-compile, destination=DemEventParameter  # Reference to the DemEventParameter which shall be issued when the error "Timeout caused by hardware error" has occured.
    container CommonPublishedInformation  # Common container, aggregated by all modules. It contains published information about vendor and versions.
      integer ArReleaseMajorVersion: 4..4, origin=NXP, set at published-information, default-value=4  # Major version number of AUTOSAR specification on which the appropriate implementation is based on.
      integer ArReleaseMinorVersion: 2..2, origin=NXP, set at published-information, default-value=2  # Minor version number of AUTOSAR specification on which the appropriate implementation is based on.
      integer ArReleaseRevisionVersion: 2..2, origin=NXP, set at published-information, default-value=2  # Revision version number of AUTOSAR specification on which the appropriate implementation is based on.
      integer ModuleId: 255..255, origin=NXP, set at published-information, default-value=255  # Module ID of this module from Module List. Note: Implementation Specific Parameter
      integer SwMajorVersion: 1..1, origin=NXP, set at published-information, default-value=1  # Major version number of the vendor specific implementation of the module. The numbering is vendor specific. Note: Implementation Specific Parameter
      integer SwMinorVersion: 0..0, origin=NXP, set at published-information, default-value=0  # Minor version number of the vendor specific implementation of the module. The numbering is vendor specific. Note: Implementation Specific Parameter
      integer SwPatchVersion: 2..2, origin=NXP, set at published-information, default-value=2  # Patch level version number of the vendor specific implementation of the module. The numbering is vendor specific. Note: Implementation Specific Parameter
      string VendorApiInfix: origin=NXP, set at published-information  # In driver modules which can be instantiated several times on a single ECU, BSW00347 requires that the name of APIs is extended by the VendorId and a vendor specific name. This parameter is used to specify the vendor specific name. In total, the Implementation specific name is generated as follows: <ModuleName>_>VendorId>_<VendorApiInfix>. E.g. assuming that the VendorId of the implementor is 123 and the implementer chose a VendorApiInfix of "v11r456" a api name Can_Write defined in the SWS will translate to Can_123_v11r456Write. This parameter is mandatory for all modules with upper multiplicity > 1. It shall not be used for modules with upper multiplicity =1. Note: Implementation Specific Parameter
      integer VendorId: 43..43, origin=NXP, set at published-information, default-value=43  # Vendor ID of the dedicated implementation of this module according to the AUTOSAR vendor list. Note: Implementation Specific Parameter
