AUTOSAR XML (schema 4-3-0)
package /TS_T40D2M10I2R0
  ecuc definition collection Lin_EcuParameterDefinition: module=Lin
  module definition Lin: post-build-variant-support=true, refined-module-def=Lin, variants post-build/pre-compile  # Configuration of the Lin (Local Interconnect Network) module.
    container NonAutosar  # NonAutosar Autosar Requirements: This container contains the global configuration parameters of the Non-Autosar Lin driver. This container is a MultipleConfigurationContainer, i.e. this container and its sub-containers exist once per configuration set.
      boolean LinDisableDemReportErrorStatus: origin=NXP, set at pre-compile, default-value=false  # LinDisableDemReportErrorStatus Switches the Diagnostic Error Reporting and Notification OFF.
      boolean LinFrameTimeoutDisable: origin=NXP, set at pre-compile, default-value=false  # LinFrameTimeoutDisable The master will accept the frame that is longer than TFrame_Maximum.
      boolean LinEnableUserModeSupport: origin=NXP, set at pre-compile, default-value=false  # LinEnableUserModeSupport When this parameter is enabled, the LIN module will adapt to run from User Mode Note: Lin module does not include registers protection. So, It is accessible to all registered in any public mode. Lin module is not affected by this field
      integer LinMaxDataLength: 1..8, origin=NXP, set at pre-compile in variant pre-compile / post-build in variant post-build, default-value=8  # Defines the maximun data length of LIN frame. Note: This Parameter is an Implementation Specific Parameter.
    container LinGeneral  # LinGeneral Autosar Requirements: LIN183_Conf This container contains the parameters related to each LIN Driver Unit. This container is a MultipleConfigurationContainer, i.e. this container and its sub-containers exit once per configuration set.
      boolean LinDevErrorDetect: set at pre-compile, default-value=false  # LinDevErrorDetect Autosar Requirements: LIN066_Conf Switches the Default Error Detection and Notification ON or OFF.
      integer LinIndex: 0..255, set at pre-compile, default-value=0  # Specifies the InstanceId of this module instance. If only one instance is present it shall have the Id 0. Note, this parameter is not used in the current implementation.
      integer LinTimeoutDuration: 0..65535, set at pre-compile, default-value=1000  # Specifies the maximum number of loops for blocking function until a timeout is raised in short term wait loops
      boolean LinVersionInfoApi: set at pre-compile, default-value=false  # LinVersionInfoApi Autosar Requirements: LIN067_Conf Switches the Lin_GetVersionInfo function ON or OFF.
    container LinDemEventParameterRefs [0..1]: multiplicity set at pre-compile  # Container for the references to DemEventParameter elements which shall be invoked using the API Dem_ReportErrorStatus API in case the corresponding error occurs. The EventId is taken from the referenced DemEventParameter's DemEventId value. The standardized errors are provided in the container and can be extended by vendor specific error references.
      symbolic name reference LIN_E_TIMEOUT [0..1]: multiplicity set at pre-compile, set at pre-compile, destination=DemEventParameter  # Reference to the DemEventParameter which shall be issued when the error "Timeout caused by hardware error" has occured.
    container LinGlobalConfig  # This container contains the global configuration parameter of the Lin driver. This container is a MultipleConfigurationContainer, i.e. this container and its sub-containers exit once per configuration set.
      container LinChannel [1..*]: multiplicity set at pre-compile  # This container contains the configuration (parameters) of the LIN Controller(s). Note:"User should use unique names for naming the LIN channels across different LinGlobalConfig Sets."
        integer LinChannelId: 0..65535, set at pre-compile, symbolic-name-value=true, default-value=0  # Identifies the LIN channel. Replaces LIN_CHANNEL_INDEX_NAME from the LIN SWS.
        integer LinChannelBaudRate: 1000..20000, post-build-variant-value=true, set at post-build in variant post-build / pre-compile in variant pre-compile, default-value=9600  # LinChannelBaudRate Autosar Requirements: LIN180_Conf Specifies the baud rate of the LIN channel in 'bps'. Valid range: 1000..20000.
        enumeration BreakLength: {BL_13, BL_14, BL_15}, origin=NXP, set at pre-compile, default-value=BL_13  # Defines the break length in bits. Note: This Parameter is an Implementation Specific Parameter. In LPUART break length is default 13 bit. In FLEXIO break length is from 13 to 15 bit.
        enumeration LinHwChannel: {LPUART_0, LPUART_1, LPUART_2, FLEXIO_0_LIN_0, FLEXIO_0_LIN_1}, origin=NXP, set at pre-compile, default-value=LPUART_0  # Selects the Lin Hardware Channel. Note: This Parameter is an Implementation Specific Parameter.
        boolean LinChannelWakeupSupport: set at pre-compile, default-value=false  # LinChannelWakeupSupport Autosar Requirements: LIN182_Conf Specifies if the LIN hardware channel supports wake up functionality.
        reference LinClockRef: post-build-variant-value=true, set at post-build in variant post-build / pre-compile in variant pre-compile, destination=McuClockReferencePoint  # Reference to the LIN clock source configuration, which is set in the MCU driver configuration.
        reference LinClockRef_Alternate [0..1]: multiplicity set at pre-compile, origin=NXP, set at pre-compile, destination=McuClockReferencePoint  # Alternate reference to the LIN clock source configuration, which is set in the MCU driver configuration, used in Low Power Mode.
        symbolic name reference LinChannelEcuMWakeupSource [0..1]: multiplicity set at pre-compile, set at pre-compile, destination=EcuMWakeupSource  # This parameter contains a reference to the Wakeup Source for this controller as defined in the ECU State Manager.
        container LinFlexIOModuleConfiguration  # This container contains the configuration (parameters) of the LIN Controller(s). Note:"User should use unique names for naming the LIN channels across different LinGlobalConfig Sets."
          enumeration LinTxPinConfiguration: {FXIO_D0, FXIO_D1, FXIO_D2, FXIO_D3, FXIO_D4, FXIO_D5, FXIO_D6, FXIO_D7}, origin=NXP, set at post-build in variant post-build / pre-compile in variant pre-compile, default-value=FXIO_D0  # Vendor specific: Tx Pin Configuration
          enumeration LinRxPinConfiguration: {FXIO_D0, FXIO_D1, FXIO_D2, FXIO_D3, FXIO_D4, FXIO_D5, FXIO_D6, FXIO_D7}, origin=NXP, set at post-build in variant post-build / pre-compile in variant pre-compile, default-value=FXIO_D1  # Vendor specific: Rx Pin Configuration
    container CommonPublishedInformation  # Common container, aggregated by all modules. It contains published information about vendor and versions.
      integer ArReleaseMajorVersion: 4..4, origin=NXP, set at published-information, default-value=4  # Major version number of AUTOSAR specification on which the appropriate implementation is based on.
      integer ArReleaseMinorVersion: 2..2, origin=NXP, set at published-information, default-value=2  # Minor version number of AUTOSAR specification on which the appropriate implementation is based on.
      integer ArReleaseRevisionVersion: 2..2, origin=NXP, set at published-information, default-value=2  # Revision version number of AUTOSAR specification on which the appropriate implementation is based on.
      integer ModuleId: 82..82, origin=NXP, set at published-information, default-value=82  # Module ID of this module from Module List.
      integer SwMajorVersion: 1..1, origin=NXP, set at published-information, default-value=1  # Major version number of the vendor specific implementation of the module. The numbering is vendor specific.
      integer SwMinorVersion: 0..0, origin=NXP, set at published-information, default-value=0  # Minor version number of the vendor specific implementation of the module. The numbering is vendor specific.
      integer SwPatchVersion: 2..2, origin=NXP, set at published-information, default-value=2  # Patch level version number of the vendor specific implementation of the module. The numbering is vendor specific.
      string VendorApiInfix [0..1]: multiplicity set at published-information, origin=NXP, set at published-information  # In driver modules which can be instantiated several times on a single ECU, BSW00347 requires that the name of APIs is extended by the VendorId and a vendor specific name. This parameter is used to specify the vendor specific name. In total, the implementation specific name is generated as follows: <ModuleName>_>VendorId>_<VendorApiInfix>. E.g. assuming that the VendorId of the implementor is 123 and the implementer chose a VendorApiInfix of "v11r456" a api name Can_Write defined in the SWS will translate to Can_123_v11r456Write. This parameter is mandatory for all modules with upper multiplicity > 1. It shall not be used for modules with upper multiplicity =1.
      integer VendorId: 43..43, origin=NXP, set at published-information, default-value=43  # Vendor ID of the dedicated implementation of this module according to the AUTOSAR vendor list.
