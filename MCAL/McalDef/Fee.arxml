AUTOSAR XML (schema 4-2-2)
package /TS_T40D2M10I2R0
  ecuc definition collection Fee_EcuParameterDefinition: module=Fee
  module definition Fee: refined-module-def=Fee, variants pre-compile  # Configuration of the Fee (Flash EEPROM Emulation) module.
    container FeeClusterGroup [1..*]: multiplicity set at pre-compile  # Vendor specific: Configuration of cluster group specific parameters for the Flash EEPROM Emulation module.
      container FeeCluster [2..*]: multiplicity set at pre-compile  # Vendor specific: Configuration of cluster specific parameters for the Flash EEPROM Emulation module.
        container FeeSector [1..*]: multiplicity set at pre-compile  # Vendor specific: Configuration of sector specific parameters for the Flash EEPROM Emulation module.
          integer FeeSectorIndex: 0..65534, origin=NXP, set at pre-compile, default-value=0  # Vendor specific: Fee Sector Index is an invariant index, used to order Fee sectors and loop over them in the correct, configured order. Its value should be equal with the position of the configured sector inside the configured sector list (the same value as the shown index). Rationale: The generated .epc configuration might reorder the flash sectors(alphabetically), thus the index parameter changes, becoming out of sync with the real intended order . Range: min = 0 max = 65534
          reference FeeSectorRef: origin=NXP, set at pre-compile, destination=FlsSector  # Vendor specific: Reference to a logical Fls sector the Fee cluster consist of.
    container FeeBlockConfiguration [1..*]: multiplicity set at pre-compile  # Configuration of block specific parameters for the Flash EEPROM Emulation module.
      integer FeeBlockNumber: 1..65534, scope=ECU, set at pre-compile, symbolic-name-value=true, default-value=1  # Block identifier (handle). 0x0000 and 0xFFFF shall not be used for block numbers (see FEE006). Range: min = 2^NVM_DATA_SELECTION_BITS max = 0xFFFF&nbsp;-&nbsp;2^NVM_DATA_SELECTION_BITS Note: Depending on the number of bits set aside for dataset selection several other block numbers shall also be left out to ease implementation.
      integer FeeBlockSize: 1..65535, scope=ECU, set at pre-compile, default-value=1  # Size of a logical block in bytes.
      boolean FeeImmediateData: scope=ECU, set at pre-compile, default-value=false  # Marker for high priority data. true: Block contains immediate data. false: Block does not contain immediate data.
      integer FeeNumberOfWriteCycles: 0..4294967295, set at pre-compile, default-value=0  # Number of write cycles required for this block.
      enumeration FeeBlockAssignment: {APPLICATION, BOOTLOADER, SHARED}, origin=NXP, set at pre-compile, default-value=APPLICATION  # Choose to which project this block is assigned. BootLoader - Block is used only by the boot loader project Application - Block is used only by the application project Shared - Block is used for the Application and Boot Loader projects
      reference FeeClusterGroupRef: origin=NXP, set at pre-compile, destination=FeeClusterGroup  # Vendor specific: Reference to the Fee cluster group which the Fee block belongs to. In other words, FeeClusterGroupRef assigns the Fee block to particular Fee cluster group.
      symbolic name reference FeeDeviceIndex: set at pre-compile, destination=FlsGeneral  # Device index (handle). Range: 0 .. 254 (0xFF reserved for broadcast call to GetStatus function).
    container FeeGeneral  # Container for general parameters. These parameters are not specific to a block.
      boolean FeeDevErrorDetect: set at pre-compile, default-value=true  # Pre-processor switch to enable and disable development error detection. true: Development error detection enabled. false: Development error detection disabled.
      boolean FeeEnableUserModeSupport: origin=NXP, set at pre-compile, default-value=false  # Fee driver is an independent hardware module, so it can run in user mode without any specific measures. The parameter is not used in the Fee implementation.
      float FeeMainFunctionPeriod: 1.0E-7..100000.0, scope=ECU, set at pre-compile, default-value=5.0E-3  # The period between successive calls to the main function in seconds.
      function name FeeNvmJobEndNotification [0..1]: multiplicity set at pre-compile, set at pre-compile, default-value=NvM_JobEndNotification  # Mapped to the job end notification routine provided by the upper layer module (NvM_JobEndNotification). Note: Disable the end notification to have it set as NULL_PTR.
      function name FeeNvmJobErrorNotification [0..1]: multiplicity set at pre-compile, set at pre-compile, default-value=NvM_JobErrorNotification  # Mapped to the job error notification routine provided by the upper layer module (NvM_JobErrorNotification). Note: Disable the error notification to have it set as NULL_PTR.
      function name FeeClusterFormatNotification [0..1]: multiplicity set at pre-compile, origin=NXP, set at pre-compile, default-value=NULL_PTR  # Fee calls this notification to inform the user in case a cluster erase and write cluster header is performed during the Fee initialization. Note: Disable the error notification to have it set as NULL_PTR.
      boolean FeePollingMode: set at pre-compile, default-value=false  # Pre-processor switch to enable and disable the polling mode for this module Note: This paramater is not utilized in this BSW module implementation
      boolean FeeSetModeSupported: set at pre-compile, default-value=true  # Compiler switch to enable/disable the SetMode functionality of the FEE module. true: SetMode functionality supported / code present, false: SetMode functionality not supported / code not present. Note: This configuration setting has to be consistent with that of all underlying flash device drivers (configuration parameter FlsSetModeApi).
      boolean FeeVersionInfoApi: set at pre-compile, default-value=true  # Pre-processor switch to enable/disable the API to read out the module version information. true: Version info API enabled. false: Version info API disabled.
      integer FeeVirtualPageSize: 8..65535, set at pre-compile, default-value=32  # The size in bytes to which logical blocks shall be aligned.
      integer FeeDataBufferSize: 0..65535, origin=NXP, set at pre-compile, default-value=96  # Vendor specific: Size of the data buffer in bytes. The data buffer is used to buffer data when Fee is copying data from one cluster to another and when Fee is reading the block header information on startup. Size of the data buffer affects number of Fls_MainFunction cycles. Bigger data buffer improves performance of the Fee cluster management operations and speeds up the startup phase as Fee can read more data in one cycle of Fls_MainFunction Note: FeeDataBufferSize must be equal or greater than FEE_CLUSTER_OVERHEAD. Where FEE_CLUSTER_OVERHEAD is management overhead per logical cluster in bytes and can be calculated using the following formula: &nbsp;&nbsp;ceiling(&nbsp;16&nbsp;/&nbsp;FEE_VIRTUAL_PAGE_SIZE&nbsp;+&nbsp;2&nbsp;)&nbsp;*&nbsp;FEE_VIRTUAL_PAGE_SIZE
      boolean FeeBlockAlwaysAvailable: origin=NXP, set at pre-compile, default-value=false  # Vendor specific: According to the AUTOSAR requirements, when the write operation starts, corresponding block is marked as inconsistent. It is marked as consistent after successful write. It means that when write operation is interrupted (cancel, reset) application cannot access the block data anymore. Enabling this parameter allows to set the behavior against the AUTOSAR requirements. In this case, the last valid information is always provided. Valid information means: FEE_BLOCK_INVALID if the block was invalidated or the block is not present in the cluster at all. FEE_BLOCK_VALID in case the previous instance of the block exists and was not invalidated.
      boolean FeeLegacyMode: origin=NXP, set at pre-compile, default-value=false  # If this parameter is disabled, optimized immediate block handling is active. If enabled, the FEE driver is configured in the legacy mode.
      boolean FeeLegacyEraseMode: origin=NXP, set at pre-compile, default-value=false  # If enabled, the Fee_EraseImmediateBlock function invalidates the referred block if it has been already written. Otherwise, the block is left intact.
      boolean FeeSwapForeignBlocksEnabled: origin=NXP, set at pre-compile, default-value=false  # The recommendation is not to use this mode Enabled for the production phase as it increases the cluster swap overall timing. This mode may be useful for developement phase if Fee is used in 2 projects running on the same ECU and the integrator wants to be able to change configuration for the application project without changing it for the second project. If disabled,the Fee driver will swap only blocks existing in the current configuration. If enabled, the Fee driver will swap foreign blocks. This is a limited support when using 2 subprojects with different Fee configurations running on the same ECU(example:boot loader and applications projects).For example if this paramters is enabled and Fee is running in application 1 mode, it will swap blocks assigned to application 2, even if those blocks are not present in application 1 configuration.This allow to update the Fee configuration for application 2 without reconfiguring application 1. Nevertheless, this mode will result in a longer time for cluster swap.
      boolean FeeMarkEmptyBlocksInvalid: origin=NXP, set at pre-compile, default-value=false  # If the parameter is enabled, Fee will mark the never written blocks as INVALID, otherwise Fee will mark the never written blocks as INCONSISTENT. Having this define set as false is compatible with AUTOSAR 4.2.2 version. Previous AUTOSAR versions do not specify which status must be returned for empty blocks.
      enumeration FeeConfigAssignment: {APPLICATION, BOOTLOADER}, origin=NXP, set at pre-compile, default-value=APPLICATION  # Choose for which project this Fee configuration is used. BootLoader - Configuration is used only by the boot loader project Application - Configuration is used only by the application project
      integer FeeMaximumNumberBlocks: 1..65534, scope=ECU, origin=NXP, set at pre-compile, symbolic-name-value=true, default-value=1  # This must be configured to total number of boot loader, application blocks and also some buffer for blocks added in the future. This parameter will be used to statically allocate space for the block runtime information, so it should be configured to accommodate the total number of blocks running on the ECU in all project versions. The parameter is used to support Fee Swap Foreign Blocks Feature. Example of configuration: If application uses 2 blocks, boot loader 1 block and another 1 is shared between application and bootloader then this parameter must be configured to 2(only appl) + 1(only boot loader) + 1(shared) + X, where x is the maximum number of blocks we estimate it will be added in future versions.
    container CommonPublishedInformation  # CommonPublishedInformation Common container, aggregated by all modules. It contains published information about vendor and versions.
      integer ArReleaseMajorVersion: 4..4, origin=NXP, set at published-information, default-value=4  # AUTOSAR Major Version Vendor specific: Major version number of AUTOSAR specification on which the appropriate implementation is based on.
      integer ArReleaseMinorVersion: 2..2, origin=NXP, set at published-information, default-value=2  # AUTOSAR Minor Version Vendor specific: Minor version number of AUTOSAR specification on which the appropriate implementation is based on.
      integer ArReleaseRevisionVersion: 2..2, origin=NXP, set at published-information, default-value=2  # AUTOSAR Patch Version Vendor specific: Revision version number of AUTOSAR specification on which the appropriate implementation is based on.
      integer ModuleId: 21..21, origin=NXP, set at published-information, default-value=21  # Module ID Vendor specific: Module ID of this module from Module List.
      integer SwMajorVersion: 1..1, origin=NXP, set at published-information, default-value=1  # Software Major Version Vendor specific: Major version number of the vendor specific implementation of the module. The numbering is vendor specific.
      integer SwMinorVersion: 0..0, origin=NXP, set at published-information, default-value=0  # Software Minor Version Vendor specific: Minor version number of the vendor specific implementation of the module. The numbering is vendor specific.
      integer SwPatchVersion: 2..2, origin=NXP, set at published-information, default-value=2  # Software Patch Version Vendor specific: Patch level version number of the vendor specific implementation of the module. The numbering is vendor specific.
      string VendorApiInfix [0..1]: multiplicity set at published-information, origin=NXP, set at published-information  # Vendor Api Infix Vendor specific: In driver modules which can be instantiated several times on a single ECU, BSW00347 requires that the name of APIs is extended by the VendorId and a vendor specific name. This parameter is used to specify the vendor specific name. In total, the implementation specific name is generated as follows: <ModuleName>_>VendorId>_<VendorApiInfix>. E.g. assuming that the VendorId of the implementor is 123 and the implementer chose a VendorApiInfix of "v11r456" a API name Can_Write defined in the SWS will translate to Can_123_v11r456Write. This parameter is mandatory for all modules with upper multiplicity&nbsp;>&nbsp;1. It shall not be used for modules with upper multiplicity&nbsp;=&nbsp;1.
      integer VendorId: 43..43, origin=NXP, set at published-information, default-value=43  # Vendor ID Vendor specific: Vendor ID of the dedicated implementation of this module according to the AUTOSAR vendor list.
    container FeePublishedInformation  # Additional published parameters not covered by CommonPublishedInformation container. Note: That these parameters do not have any configuration class setting, since they are published information.
      integer FeeBlockOverhead: 0..65535, set at published-information, default-value=0  # Management overhead per logical block in bytes Note: The logical block management overhead depends on FeeVirtualPageSize and can be calculated using the following formula: &nbsp;&nbsp;ceiling(&nbsp;12&nbsp;/&nbsp;FEE_VIRTUAL_PAGE_SIZE&nbsp;+&nbsp;2&nbsp;)&nbsp;*&nbsp;FEE_VIRTUAL_PAGE_SIZE
      integer FeePageOverhead: 0..65535, set at published-information, default-value=0  # Management overhead per page in bytes Note: The page management overhead is 0 bytes
