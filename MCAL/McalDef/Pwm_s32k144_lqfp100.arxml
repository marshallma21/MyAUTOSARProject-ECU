AUTOSAR XML (schema 4-2-2)
package /TS_T40D2M10I2R0
  ecuc definition collection Pwm_EcuParameterDefinition: module=Pwm
  module definition Pwm: post-build-variant-support=true, refined-module-def=Pwm, variants post-build/pre-compile  # Configuration of Pwm (Pulse Width Modulation) module.
    container PwmConfigurationOfOptApiServices  # PwmConfigurationOfOptApiServices Container used for storing the configuration of all optional API's. Autosar Requirements: not specified.
      boolean PwmDeInitApi: set at pre-compile, default-value=true  # Adds / removes the service Pwm_DeInit() from the code.
      boolean PwmGetOutputState: set at pre-compile, default-value=false  # Adds / removes the service Pwm_GetOutputState () from the code. In the current implementation this API does NOT reflect the state of the Pwm output signal and the returned value is always PWM_LOW.
      boolean PwmSetDutyCycle: set at pre-compile, default-value=true  # Adds / removes the service Pwm_SetDutyCycle() from the code.
      boolean PwmSetOutputToIdle: set at pre-compile, default-value=true  # Adds / removes the service Pwm_SetOutputToIdle () from the code.
      boolean PwmSetPeriodAndDuty: set at pre-compile, default-value=true  # Adds / removes the service Pwm_SetPeriodAndDuty () from the code.
      boolean PwmVersionInfoApi: set at pre-compile, default-value=true  # Switch to indicate that the Pwm_GetVersionInfo is supported
      boolean PwmGetChannelStateApi: origin=NXP, set at pre-compile, default-value=false  # Switch to indicate that the Pwm_GetChannelState is supported
      boolean PwmForceOutputToZeroApi: origin=NXP, set at pre-compile, default-value=false  # Switch to indicate that the Pwm_ForceOutputToZero API is supported
      boolean PwmSetDutyCycle_NoUpdate: origin=NXP, set at pre-compile, default-value=false  # Adds / removes the service PwmSetDutyCycle_NoUpdate () from the code.
      boolean PwmSetPeriodAndDuty_NoUpdate: origin=NXP, set at pre-compile, default-value=false  # Adds / removes the service PwmSetPeriodAndDuty_NoUpdate () from the code.
      boolean PwmSetPhaseShift: origin=NXP, set at pre-compile, default-value=false  # Adds / removes the service Pwm_SetPhaseShift and from the code.
      boolean PwmSetPhaseShiftNoUpdate: origin=Freescale, set at pre-compile, default-value=false  # Adds / removes the service SetPhaseShift_NoUpdate from the code.
      boolean PwmEnableTrigger: origin=NXP, set at pre-compile, default-value=false  # Adds / removes the service Pwm_EnableTrigger from the code.
      boolean PwmDisableTrigger: origin=NXP, set at pre-compile, default-value=false  # Adds / removes the service Pwm_DisableTrigger from the code.
      boolean PwmSwResetCounter: origin=NXP, set at pre-compile, default-value=false  # Adds / removes the service Pwm_ResetCounter from the code.
    container PwmChannelConfigSet  # This container contains the Channel configuration parameter of the PWM driver.
      container PwmChannel [1..36]: multiplicity set at pre-compile  # Configuration of an individual PWM channel.
        integer PwmChannelId: 0..4294967295, set at pre-compile, symbolic-name-value=true, default-value=0  # Channel Id of the PWM channel. This value will be assigned to the symbolic name derived of the PwmChannel container short name.
        enumeration PwmHwIP: {FTM, FlexIO}, origin=NXP, set at pre-compile in variant pre-compile / post-build in variant post-build, default-value=FTM  # Hardware IP to be used for current PWM channel: FTM - FTM Hardware IP will be used. Please select an FTM configured channel from FTM channel combo below FlexIO - FlexIO Hardware IP will be used. Please select a FlexIO configured channel from FlexIO channel combo below
        boolean PwmPeriodInTicks: origin=NXP, post-build-variant-value=true, set at pre-compile in variant pre-compile / post-build in variant post-build, default-value=true  # PwmPeriodInTicks By default Period unit is measured in Seconds. Enable this check to set Default Period unit in Ticks.
        float PwmPeriodDefault: 0.0..65534.0, post-build-variant-value=true, set at pre-compile in variant pre-compile / post-build in variant post-build, default-value=1.25e-4  # Default period value used at initialization. Valid values: FlexIO channel: [0,255] FTM channel: [0,65534]
        enumeration PwmChannelClass [0..1]: {PWM_FIXED_PERIOD, PWM_VARIABLE_PERIOD, PWM_FIXED_PERIOD_SHIFTED}, multiplicity set at pre-compile in variant pre-compile / post-build in variant post-build, post-build-variant-multiplicity=true, post-build-variant-value=true, set at pre-compile in variant pre-compile / post-build in variant post-build, default-value=PWM_FIXED_PERIOD  # Class of PWM Channel. PWM_FIXED_PERIOD - Period for the all the channels of that module will not be changed. PWM_FIXED_PERIOD_SHIFTED - Period for the all the channels of that module will not be changed. PWM_VARIABLE_PERIOD - Period for all the channels of that module can be changed.
        enumeration PwmPolarity: {PWM_HIGH, PWM_LOW}, post-build-variant-value=true, set at pre-compile in variant pre-compile / post-build in variant post-build, default-value=PWM_HIGH  # Defines the starting polarity of each PWM channel.
        integer PwmDutycycleDefault: 0..32768, post-build-variant-value=true, set at pre-compile in variant pre-compile / post-build in variant post-build, default-value=16384  # Default value for duty cycle used for initialization. Valid value: [0,32768] 0 represents for 0% duty cycle 16384 (0x4000) represents for 50% duty cycle 32768 (0x8000) represents for 100% duty cycle
        enumeration PwmIdleState: {PWM_HIGH, PWM_LOW}, post-build-variant-value=true, set at pre-compile in variant pre-compile / post-build in variant post-build, default-value=PWM_LOW  # This parameter represents the state of the Pin when the output is set to Idle.
        function name PwmNotification [0..1]: multiplicity set at pre-compile in variant pre-compile / post-build in variant post-build, post-build-variant-multiplicity=true, post-build-variant-value=true, set at pre-compile in variant pre-compile / post-build in variant post-build, default-value=NULL  # User callback function NOTE: please use NULL or NULL_PTR w/o any quotes. If the used string is different from NULL or NULL_PTR it will be used as the configured function name.
        reference PwmFtmChannel [0..1]: multiplicity set at pre-compile in variant pre-compile / post-build in variant post-build, origin=NXP, post-build-variant-value=true, set at pre-compile in variant pre-compile / post-build in variant post-build, destination=PwmFtmChannels  # Select the Ftm channel on which the functionality of the current PWM channel will be implemented
        reference PwmFlexIOChannel [0..1]: multiplicity set at pre-compile in variant pre-compile / post-build in variant post-build, origin=NXP, set at pre-compile in variant pre-compile / post-build in variant post-build, destination=PwmFlexIOChannels  # Select the FlexIO channel on which the functionality of the current PWM channel will be implemented
        reference PwmMcuClockReferencePoint: scope=ECU, post-build-variant-value=true, set at pre-compile in variant pre-compile / post-build in variant post-build, destination=McuClockReferencePoint  # Reference to the FlexPwm and eTimer clock source configuration, which is set in the MCU driver configuration. Motor Control Clock configuration in AuxClock0En tab is the reference clock for FlexPWM, eTimer and CTU
      container PwmFtmModule [0..4]: multiplicity set at pre-compile  # Configuration of a Ftm module available on the platfom.
        enumeration FtmModule: {FTM_0, FTM_1, FTM_2, FTM_3}, origin=NXP, post-build-variant-value=true, set at pre-compile, default-value=FTM_0  # Select one of the 4 sub-modules available on the current Ftm module.
        enumeration PwmPrescaler: {PRESC_1, PRESC_2, PRESC_4, PRESC_8, PRESC_16, PRESC_32, PRESC_64, PRESC_128}, origin=NXP, post-build-variant-value=true, set at pre-compile in variant pre-compile / post-build in variant post-build, default-value=PRESC_1  # PwmPrescaler Autosar Requirements: not specified.
        enumeration PwmPrescaler_Alternate: {PRESC_1, PRESC_2, PRESC_4, PRESC_8, PRESC_16, PRESC_32, PRESC_64, PRESC_128}, origin=NXP, post-build-variant-value=true, set at pre-compile in variant pre-compile / post-build in variant post-build, default-value=PRESC_1  # PwmPrescaler - this parameter will be used by the Pwm_SetClockMode function. Autosar Requirements: not specified.
        enumeration PwmClockSelection: {PWM_SYSTEM_CLOCK, PWM_FIXED_FREQ_CLOCK, PWM_EXTERNAL_CLOCK, PWM_NO_CLOCK}, origin=NXP, set at pre-compile in variant pre-compile / post-build in variant post-build, default-value=PWM_SYSTEM_CLOCK  # FTM Module clock selection. PWM_NO_CLOCK -> No input clock is given to FTM. FTM count is not operational PWM_SYSTEM_CLOCK -> System clock is given to FTM. PWM_EXTERNAL_CLOCK -> An fixed frequnecy clock is given to FTM. PWM_FIXED_FREQ_CLOCK -> An external clock is given to FTM. Note clock selection and timer frequency are dependent on the value of the clock that is configured in MCU and referenced by /PwmMcuClockReferencePoint. Make sure that the corect reference is used for the configured clock.
        enumeration PwmChanEdgeAlignment: {PWM_EDGE_ALIGNED, PWM_CENTER_ALIGNED}, origin=NXP, post-build-variant-value=true, set at pre-compile in variant pre-compile / post-build in variant post-build, default-value=PWM_EDGE_ALIGNED  # This list will change the PWM generation mode for this Ftm sub module. This in a non-autosar feature
        boolean PwmUpdatedEndPeriod: origin=Custom, post-build-variant-value=true, set at pre-compile, default-value=true  # Switch for enabling update parameter at the end of the current period. Note: This function enabled if PwmDutycycleUpdatedEndperiod is set and PWM_CENTER_ALIGNED is set.
        boolean PwmUpdatedMiddlePeriod: origin=Custom, post-build-variant-value=true, set at pre-compile, default-value=false  # Switch for enabling update parameter at the middle of the current period. Note: This function enabled if PwmDutycycleUpdatedEndperiod is set and PWM_CENTER_ALIGNED is set.
        enumeration PwmReloadFrequency: {LDFQ_EACH1, LDFQ_EACH2, LDFQ_EACH3, LDFQ_EACH4, LDFQ_EACH5, LDFQ_EACH6, LDFQ_EACH7, LDFQ_EACH8, LDFQ_EACH9, LDFQ_EACH10, LDFQ_EACH11, LDFQ_EACH12, LDFQ_EACH13, LDFQ_EACH14, LDFQ_EACH15, LDFQ_EACH16, LDFQ_EACH17, LDFQ_EACH18, LDFQ_EACH19, LDFQ_EACH20, LDFQ_EACH21, LDFQ_EACH22, LDFQ_EACH23, LDFQ_EACH24, LDFQ_EACH25, LDFQ_EACH26, LDFQ_EACH27, LDFQ_EACH28, LDFQ_EACH29, LDFQ_EACH30, LDFQ_EACH31, LDFQ_EACH32}, origin=NXP, post-build-variant-value=true, set at pre-compile in variant pre-compile / post-build in variant post-build, default-value=LDFQ_EACH1  # Define the number of enabled reload opportunities should happen until an enabled reload opportunity becomes a reload point. Note: This function enabled if PwmDutycycleUpdatedEndperiod is set.
        integer PwmDeadTimeCount [0..1]: 0..1023, multiplicity set at pre-compile in variant pre-compile / post-build in variant post-build, origin=NXP, post-build-variant-value=true, set at pre-compile in variant pre-compile / post-build in variant post-build, default-value=0  # DeadTime Counter used to create a phase offset between the outpus of two consecutive Ftm channels used complementary modes. Complmentary channels behave as a single channel with two outputs which may have a deadtime between them. Note. For channels which are configured as independent this value has no effect.
        enumeration DeadTimePrescaler [0..1]: {PRESC_1, PRESC_4, PRESC_16}, multiplicity set at pre-compile in variant pre-compile / post-build in variant post-build, origin=NXP, post-build-variant-value=true, set at pre-compile in variant pre-compile / post-build in variant post-build, default-value=PRESC_1  # DeadTime counter prescaler.
        enumeration PwmBDMEnable: {CNT_STOPED_FLAG_SET, CNT_STOPED_OUTPUTS_SAFE, CNT_STOPED_OUTPUTS_FROZEN, CNT_ON_OUTPUTS_ON}, origin=NXP, post-build-variant-value=true, set at pre-compile in variant pre-compile / post-build in variant post-build, default-value=CNT_STOPED_FLAG_SET  # Selects the Debug mode.
        enumeration PwmFtmFaultFunctionality: {FLTCTRL_DISABLED, AUTOMATIC_FOR_EVEN_CHANNELS, AUTOMATIC_FOR_ALL_CHANNELS}, origin=NXP, post-build-variant-value=true, set at pre-compile in variant pre-compile / post-build in variant post-build, default-value=FLTCTRL_DISABLED  # Selects the fault control mode. FLTCTRL_DISABLED -> Fault control disabled for all channels. AUTOMATIC_FOR_EVEN_CHANNELS -> Fault control enabled for even channels (0, 2, 4..) with automatic fault clear. AUTOMATIC_FOR_ALL_CHANNELS -> Fault control enabled for all channels with automatic fault clear. Note: For any automatic fault clear modes, a Fault Notification function should be defined. In automatic modes, the hardware shall be configured into manual fault clearing and automatic fault clearing shall be implemented by software.
        container PwmFtmChannelFaultSettings  # Global Fault configuration. Autosar Requirements: not specified.
          integer PwmFilterValue: 0..15, origin=NXP, post-build-variant-value=true, set at pre-compile in variant pre-compile / post-build in variant post-build, default-value=0  # Value used for debouncing Fault inputs.
          boolean PwmDisableOutputOnFault{0..2}: origin=NXP, post-build-variant-value=true, set at pre-compile in variant pre-compile / post-build in variant post-build, default-value=false  # Disables the pwm output on detection of fault on fault channel {0..2}. Autosar Requirements: not specified.
          boolean PwmDisableOutputOnFault3: origin=NXP, post-build-variant-value=true, set at pre-compile in variant pre-compile / post-build in variant post-build, default-value=false  # Disables the pwm output on detection of fault on fault channel 3 Autosar Requirements: not specified.
          enumeration PwmFtmFaultOutputState: {SAFE_VALUES, TRISTATE}, origin=NXP, set at pre-compile in variant pre-compile / post-build in variant post-build, default-value=SAFE_VALUES  # Specifies the fault state for the PWM channel output during fault conditions. SAFE_VALUES: outputs will be placed into safe values when fault events in ongoing (defined by polarity) TRISTATE: outputs will be tri-stated when fault event is ongoing Autosar Requirements: not specified.
          container PwmFtmChannelFault0Settings  # Global Configuration for Fault 0. Autosar Requirements: not specified.
            boolean PwmFault0Polarity: origin=NXP, post-build-variant-value=true, set at pre-compile in variant pre-compile / post-build in variant post-build, default-value=false  # Sets polarity for Fault 0 Input Pin (Checking the box means fault will be active LOW, else fault will be active HIGH). Autosar Requirements: not specified.
            boolean PwmEnableFault0Filter: origin=NXP, post-build-variant-value=true, set at pre-compile in variant pre-compile / post-build in variant post-build, default-value=false  # Enables a debounce filter for Fault 0 Input pin. Autosar Requirements: not specified.
            function name PwmFault0Notification: origin=NXP, post-build-variant-value=true, set at pre-compile in variant pre-compile / post-build in variant post-build, default-value=NULL  # User callback function NOTE: please use NULL or NULL_PTR w/o any quotes. If the used string is different from NULL or NULL_PTR it will be used as the configured function name.
          container PwmFtmChannelFault1Settings  # Global Configuration for Fault 0. Autosar Requirements: not specified.
            boolean PwmFault1Polarity: origin=NXP, post-build-variant-value=true, set at pre-compile in variant pre-compile / post-build in variant post-build, default-value=false  # Sets polarity for Fault 1 Input Pin (Checking the box means fault will be active LOW, else fault will be active HIGH). Autosar Requirements: not specified.
            boolean PwmEnableFault1Filter: origin=NXP, post-build-variant-value=true, set at pre-compile in variant pre-compile / post-build in variant post-build, default-value=false  # Enables a debounce filter for Fault 1 Input pin. Autosar Requirements: not specified.
            function name PwmFault1Notification: origin=NXP, post-build-variant-value=true, set at pre-compile in variant pre-compile / post-build in variant post-build, default-value=NULL  # User callback function NOTE: please use NULL or NULL_PTR w/o any quotes. If the used string is different from NULL or NULL_PTR it will be used as the configured function name.
          container PwmFtmChannelFault2Settings  # Global Configuration for Fault 0. Autosar Requirements: not specified.
            boolean PwmFault2Polarity: origin=NXP, post-build-variant-value=true, set at pre-compile in variant pre-compile / post-build in variant post-build, default-value=false  # Sets polarity for Fault 2 Input Pin (Checking the box means fault will be active LOW, else fault will be active HIGH). Autosar Requirements: not specified.
            boolean PwmEnableFault2Filter: origin=NXP, post-build-variant-value=true, set at pre-compile in variant pre-compile / post-build in variant post-build, default-value=false  # Enables a debounce filter for Fault 2 Input pin. Autosar Requirements: not specified.
            function name PwmFault2Notification: origin=NXP, post-build-variant-value=true, set at pre-compile in variant pre-compile / post-build in variant post-build, default-value=NULL  # User callback function NOTE: please use NULL or NULL_PTR w/o any quotes. If the used string is different from NULL or NULL_PTR it will be used as the configured function name.
          container PwmFtmChannelFault3Settings  # Global Configuration for Fault 3. Autosar Requirements: not specified.
            boolean PwmFault3Polarity: origin=NXP, post-build-variant-value=true, set at pre-compile in variant pre-compile / post-build in variant post-build, default-value=false  # Sets polarity for Fault 1 Input Pin (Checking the box means fault will be active LOW, else fault will be active HIGH). Autosar Requirements: not specified.
            boolean PwmEnableFault3Filter: origin=NXP, post-build-variant-value=true, set at pre-compile in variant pre-compile / post-build in variant post-build, default-value=false  # Enables a debounce filter for Fault 3 Input pin. Autosar Requirements: not specified.
            function name PwmFault3Notification: origin=NXP, post-build-variant-value=true, set at pre-compile in variant pre-compile / post-build in variant post-build, default-value=NULL  # User callback function NOTE: please use NULL or NULL_PTR w/o any quotes. If the used string is different from NULL or NULL_PTR it will be used as the configured function name.
        container PwmExternalTriggerSettings  # Global Trigger configuration.
          boolean PwmEnableExternalTriggerChannel0: origin=NXP, post-build-variant-value=true, set at pre-compile in variant pre-compile / post-build in variant post-build, default-value=false  # Enables the generation of the channel trigger on Trigger channel 0.
          boolean PwmEnableExternalTriggerChannel1: origin=NXP, post-build-variant-value=true, set at pre-compile in variant pre-compile / post-build in variant post-build, default-value=false  # Enables the generation of the channel trigger on Trigger channel 1.
          boolean PwmEnableExternalTriggerChannel2: origin=NXP, post-build-variant-value=true, set at pre-compile in variant pre-compile / post-build in variant post-build, default-value=false  # Enables the generation of the channel trigger on Trigger channel 2.
          boolean PwmEnableExternalTriggerChannel3: origin=NXP, post-build-variant-value=true, set at pre-compile in variant pre-compile / post-build in variant post-build, default-value=false  # Enables the generation of the channel trigger on Trigger channel 3.
          boolean PwmEnableExternalTriggerChannel4: origin=NXP, post-build-variant-value=true, set at pre-compile in variant pre-compile / post-build in variant post-build, default-value=false  # Enables the generation of the channel trigger on Trigger channel 4.
          boolean PwmEnableExternalTriggerChannel5: origin=NXP, post-build-variant-value=true, set at pre-compile in variant pre-compile / post-build in variant post-build, default-value=false  # Enables the generation of the channel trigger on Trigger channel 5.
          boolean PwmEnableExternalTriggerChannel6: origin=NXP, post-build-variant-value=true, set at pre-compile in variant pre-compile / post-build in variant post-build, default-value=false  # Enables the generation of the channel trigger on Trigger channel 6.
          boolean PwmEnableExternalTriggerChannel7: origin=NXP, post-build-variant-value=true, set at pre-compile in variant pre-compile / post-build in variant post-build, default-value=false  # Enables the generation of the channel trigger on Trigger channel 7.
          boolean PwmEnableInitializationTrigger: origin=NXP, post-build-variant-value=true, set at pre-compile in variant pre-compile / post-build in variant post-build, default-value=false  # Enables the generation of the trigger when the FTM counter is equal to the CNTIN register.
        container PwmFtmChannels [1..8]: multiplicity set at pre-compile  # Configuration of an individual PWM FTM channel.
          enumeration PwmFtmChannelId: {FTM_0_CH_0, FTM_0_CH_1, FTM_0_CH_2, FTM_0_CH_3, FTM_0_CH_4, FTM_0_CH_5, FTM_0_CH_6, FTM_0_CH_7, FTM_1_CH_0, FTM_1_CH_1, FTM_1_CH_2, FTM_1_CH_3, FTM_1_CH_4, FTM_1_CH_5, FTM_1_CH_6, FTM_1_CH_7, FTM_2_CH_0, FTM_2_CH_1, FTM_2_CH_2, FTM_2_CH_3, FTM_2_CH_4, FTM_2_CH_5, FTM_2_CH_6, FTM_2_CH_7, FTM_3_CH_0, FTM_3_CH_1, FTM_3_CH_2, FTM_3_CH_3, FTM_3_CH_4, FTM_3_CH_5, FTM_3_CH_6, FTM_3_CH_7}, origin=NXP, post-build-variant-value=true, set at pre-compile, default-value=FTM_0_CH_0  # Channel Id of the Flex Timer channel of the current . This value will be assigned to the symbolic name derived of the PwmChannel container short name.
          enumeration ChannelEdgeSetup: {INDEPENDENT, PHASE_SHIFTED_SINGLE, COMBINED_SYNCED, COMBINED_COMPLEMENTARY, PHASE_SHIFTED_SYNCED, PHASE_SHIFTED_COMPLEMENTARY}, origin=NXP, post-build-variant-value=true, set at pre-compile in variant pre-compile / post-build in variant post-build, default-value=INDEPENDENT  # INDEPENDENT:Single PWM output will be generated using only one FTM HW Channel PHASE_SHIFTED_SINGLE:Single phase shifted PWM output will be generated using two FTM HW Channels. COMBINED_SYNCED:Two phase-synced PWM outputs will be generated using two FTM HW Channels. COMBINED_COMPLEMENTARY:Two phase-complementary PWM outputs will be generated using two FTM HW Channels; The deadtime insertion is applicable to ensures that no two complementary signals (channels (n)and (n+1)) drive the active state at the same time PHASE_SHIFTED_SYNCED:Two phase-shifted synchronous PWM outputs will be generated using two FTM HW Channels PHASE_SHIFTED_COMPLEMENTARY:Two phase-shifted complementary PWM outputs will be generated using two FTM HW Channels. The deadtime insertion is applicable to ensures that no two complementary signals (channels (n)and (n+1)) drive the active state at the same time. Autosar Requirements: not specified.
          integer PwmPhaseShift: 0..65533, origin=Freescale, set at pre-compile in variant pre-compile / post-build in variant post-build, default-value=0  # Phase shift value (in tick) for channel in PHASE_SHIFTED_SINGLE/PHASE_SHIFTED_SYNCED/PHASE_SHIFTED_COMPLEMENTARY
          boolean ChannelCombDeadTimeEn: origin=NXP, post-build-variant-value=true, set at pre-compile, default-value=false  # Switch for enabling / disabling DeadTime for COMBINED_COMPLEMENTARY/PHASE_SHIFTED_COMPLEMENTARY channels.
      container PwmFlexIOModule [0..1]: multiplicity set at pre-compile  # Configuration of a FlexIO module available on the platform.
        enumeration PwmFlexIOHardWareModule: {FlexIO_0}, origin=NXP, set at pre-compile, default-value=FlexIO_0  # Select the hardware FlexIO module.
        container PwmFlexIOChannels [1..4]: multiplicity set at pre-compile  # Configuration of a FlexIO channels available on the platform.
          enumeration PwmFlexIOChannelId: {Channel_0, Channel_1, Channel_2, Channel_3, Channel_4, Channel_5, Channel_6, Channel_7}, origin=NXP, set at pre-compile, default-value=Channel_0  # Select one of the FlexIO channels available on the platform.
          enumeration PwmFlexIOTimer: {Timer_0, Timer_1, Timer_2, Timer_3}, origin=NXP, set at pre-compile, default-value=Timer_0  # Select one of the FlexIO timer sources available on the platform.
    container PwmGeneral  # PwmGeneral Container used for storing the general configuration of Pwm.
      boolean PwmDevErrorDetect: set at pre-compile, default-value=true  # Switch for enabling / disabling the development error detection.
      boolean PwmDutycycleUpdatedEndperiod: set at pre-compile, default-value=true  # Switch for enabling the update of the duty cycle parameter at the end of the current period. LIMITATION: Curent implementation supports the update of the duty cycle parameter only at the end of the current period.
      boolean PwmNotificationSupported: set at pre-compile, default-value=true  # Switch to indicate that the notifications are supported.
      boolean PwmEnableDualClockMode: origin=NXP, set at pre-compile, default-value=false  # Adds / removes the services Pwm_SetClockMode() from the code.This function is called when the prescaler value needs to be change to maintain same period at different frequency. Note: NoteThis is an Implementation Specific Parameter.
      boolean PwmPeriodUpdatedEndperiod: set at pre-compile, default-value=true  # Switch for enabling the update of the period parameter at the end of the current period. LIMITATION: Curent implementation supports the update of the period parameter only at the end of the current period.
      boolean PwmLowPowerStatesSupport [0..1]: multiplicity set at pre-compile, set at pre-compile, default-value=false  # EN: If enabled, Hardware offer low power mode and Adds all power state management related APIs (PWM_SetPowerState, PWM_GetCurrentPowerState, PWM_GetTargetPowerState, PWM_PreparePowerState, PWM_Main_PowerTransitionManager), indicating if the HW offers low power state management.
      boolean PwmPowerStateAsynchTransitionMode [0..1]: multiplicity set at pre-compile, set at pre-compile, default-value=false  # Enables / disables support of the PWM Driver to the asynchronous power state transition.
      boolean PwmEnableUserModeSupport: origin=NXP, set at pre-compile, default-value=false  # When this parameter is enabled, the Pwm module will adapt to run from User Mode. Pwm driver does not perform any further actions when running in User Mode. Note: Implementation Specific Parameter.
      integer PwmIndex: 0..4294967295, set at pre-compile, default-value=0  # Specifies the InstanceId of this module instance. If only one instance is present it shall have the Id 0. LIMITATION: In the current implementation this parameter is not used.
      boolean PwmFaultSupport: origin=NXP, set at pre-compile, default-value=false  # This enables the fault functionality.
      boolean PwmFtmEnableExtTrigger: origin=NXP, set at pre-compile, default-value=false  # This enables external trigger generation.
      boolean PwmEnablePhaseShift: origin=NXP, set at pre-compile, default-value=false  # This enables Phase Shift feature.
      boolean EnableMaskingOperations: origin=Freescale, set at pre-compile, default-value=false  # Adds / removes the service Pwm_MaskOutputs() and Pwm_UnMaskOutputs from the code.
      boolean PwmMultiChannelSynch: origin=Freescale, set at pre-compile, default-value=false  # Enables/Disables the option to set the duty cycle synchronous for several channels. Note: NoteThis is an Implementation Specific Parameter. Enabling this feature will require enabling of either PwmSetDutyCycle_NoUpdate or PwmSetPeriodAndDuty_NoUpdate
      container PwmHwConfiguration [41..41]  # List of all HW channel resources for PWM module.
        enumeration PwmInterruptHwId: {PWM_FLEXIO_0_ISR, PWM_FTM_0_CH_0_ISR, PWM_FTM_0_CH_1_ISR, PWM_FTM_0_CH_2_ISR, PWM_FTM_0_CH_3_ISR, PWM_FTM_0_CH_4_ISR, PWM_FTM_0_CH_5_ISR, PWM_FTM_0_CH_6_ISR, PWM_FTM_0_CH_7_ISR, PWM_FTM_0_TOF_ISR, PWM_FTM_0_FAULT_ISR, PWM_FTM_1_CH_0_ISR, PWM_FTM_1_CH_1_ISR, PWM_FTM_1_CH_2_ISR, PWM_FTM_1_CH_3_ISR, PWM_FTM_1_CH_4_ISR, PWM_FTM_1_CH_5_ISR, PWM_FTM_1_CH_6_ISR, PWM_FTM_1_CH_7_ISR, PWM_FTM_1_TOF_ISR, PWM_FTM_1_FAULT_ISR, PWM_FTM_2_CH_0_ISR, PWM_FTM_2_CH_1_ISR, PWM_FTM_2_CH_2_ISR, PWM_FTM_2_CH_3_ISR, PWM_FTM_2_CH_4_ISR, PWM_FTM_2_CH_5_ISR, PWM_FTM_2_CH_6_ISR, PWM_FTM_2_CH_7_ISR, PWM_FTM_2_TOF_ISR, PWM_FTM_2_FAULT_ISR, PWM_FTM_3_CH_0_ISR, PWM_FTM_3_CH_1_ISR, PWM_FTM_3_CH_2_ISR, PWM_FTM_3_CH_3_ISR, PWM_FTM_3_CH_4_ISR, PWM_FTM_3_CH_5_ISR, PWM_FTM_3_CH_6_ISR, PWM_FTM_3_CH_7_ISR, PWM_FTM_3_TOF_ISR, PWM_FTM_3_FAULT_ISR}, origin=NXP, set at pre-compile, symbolic-name-value=true, default-value=PWM_FTM_0_CH_0_ISR  # ID of HW interrupt resources.
        boolean PwmInterruptEnable: origin=NXP, set at pre-compile, default-value=false  # Enable/Disable HW channels' Interrupt Sources.
        boolean PwmChannelIsUsed: origin=NXP, set at pre-compile, default-value=false  # This column configures HW channels which are going to be used. Note: No further needed configuration for this parameter if this resource is from FlexPwm.
      container PwmPowerStateConfig [0..*]: multiplicity set at pre-compile  # Each instance of this parameter defines a power state and the callback to be called when this power state is reached.
        integer PwmPowerState: 0..9223372036854775807, set at pre-compile, symbolic-name-value=true, default-value=0  # Each instance of this parameter describes a different power state supported by the PWM HW. It should be defined by the HW supplier and used by the PWMDriver to reference specific HW configurations which set the PWM HW module in the referenced power state.
        function name PwmPowerStateReadyCbkRef: set at pre-compile, default-value=NULL  # Each instance of this parameter contains a reference to a power mode callback defined in a CDD or IoHwAbs component.
    container CommonPublishedInformation  # Common container, aggregated by all modules. It contains published information about vendor and versions.
      integer ArReleaseMajorVersion: 4..4, origin=NXP, set at published-information, default-value=4  # Major version number of AUTOSAR specification on which the appropriate implementation is based on.
      integer ArReleaseMinorVersion: 2..2, origin=NXP, set at published-information, default-value=2  # Minor version number of AUTOSAR specification on which the appropriate implementation is based on.
      integer ArReleaseRevisionVersion: 2..2, origin=NXP, set at published-information, default-value=2  # Revision version number of AUTOSAR specification on which the appropriate implementation is based on.
      integer ModuleId: 121..121, origin=NXP, set at published-information, default-value=121  # Module ID of this module from Module List.
      integer SwMajorVersion: 1..1, origin=NXP, set at published-information, default-value=1  # Major version number of the vendor specific implementation of the module. The numbering is vendor specific.
      integer SwMinorVersion: 0..0, origin=NXP, set at published-information, default-value=0  # Minor version number of the vendor specific implementation of the module. The numbering is vendor specific.
      integer SwPatchVersion: 2..2, origin=NXP, set at published-information, default-value=2  # Patch level version number of the vendor specific implementation of the module. The numbering is vendor specific.
      string VendorApiInfix [0..1]: multiplicity set at published-information, origin=NXP, set at published-information  # In driver modules which can be instantiated several times on a single ECU, BSW00347 requires that the name of APIs is extended by the VendorId and a vendor specific name. This parameter is used to specify the vendor specific name. In total, the implementation specific name is generated as follows: <ModuleName>_>VendorId>_<VendorApiInfix>. E.g. assuming that the VendorId of the implementor is 123 and the implementer chose a VendorApiInfix of "v11r456" a api name Can_Write defined in the SWS will translate to Can_123_v11r456Write. This parameter is mandatory for all modules with upper multiplicity > 1. It shall not be used for modules with upper multiplicity =1.
      integer VendorId: 43..43, origin=NXP, set at published-information, default-value=43  # Vendor ID of the dedicated implementation of this module according to the AUTOSAR vendor list.
