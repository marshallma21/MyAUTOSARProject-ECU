AUTOSAR XML (schema 4-2-2)
package /TS_T40D2M10I2R0
  ecuc definition collection Port_EcuParameterDefinition: module=Port
  module definition Port: post-build-variant-support=true, refined-module-def=Port, variants post-build/pre-compile  # Configuration of the Port module.
    container PortConfigSet  # This container contains a configuration of the PORT driver.
      container NotUsedPortPin  # The init parameters values for the not used pins in the PORT configuration.
        enumeration PortPinMode: {GPIO, Disabled}, origin=NXP, post-build-variant-value=true, set at post-build in variant post-build / pre-compile in variant pre-compile, default-value=GPIO  # Selects if the unused port pins are configured as GPIOs or are disabled.
        enumeration PortPinDirection: {PORT_PIN_IN, PORT_PIN_OUT, PORT_PIN_HIGH_Z}, origin=NXP, post-build-variant-value=true, set at post-build in variant post-build / pre-compile in variant pre-compile, default-value=PORT_PIN_IN  # Selects the initial direction of the pin (IN or OUT or HIGH_Z). If the direction is not changeable, the value configured here is fixed. The pin direction can be set only for the GPIO pins. For the Alternative Function modes the OUT pin direction is hw selected. If the HIGH_Z and IN direction is needed too, it can be set at runtime. NOTE: To set the IN direction take care, please, that all the possible module inputs, possible as Alternative Functions for the pad mode, are hw connected together, if IN direction is enabled, to the pad. Set input pin to high-Z not available in S32K11X
        enumeration PortPinLevelValue: {PORT_PIN_LEVEL_HIGH, PORT_PIN_LEVEL_LOW}, origin=NXP, post-build-variant-value=true, set at post-build in variant post-build / pre-compile in variant pre-compile, default-value=PORT_PIN_LEVEL_LOW  # Port Pin Level value from Port pin list.
        enumeration PortPinDSE: {Low_Drive_Strength, High_Drive_Strength}, origin=NXP, post-build-variant-value=true, set at post-build in variant post-build / pre-compile in variant pre-compile, default-value=Low_Drive_Strength  # Selects the drive strenght length value for this pin.
        enumeration PortPinPE: {PullDisabled, PullEnabled}, origin=NXP, post-build-variant-value=true, set at post-build in variant post-build / pre-compile in variant pre-compile, default-value=PullDisabled  # Selects if the pull-up or pull-down resistors are enabled.
        enumeration PortPinPS: {PullDown, PullUp}, origin=NXP, post-build-variant-value=true, set at post-build in variant post-build / pre-compile in variant pre-compile, default-value=PullDown  # Selects between the pull-up and pull-down resistors. Only valid when PortPin PE is set to 'PullEnabled'.
      container PortContainer [1..*]: multiplicity set at pre-compile  # Container collecting the PortPins.
        integer PortNumberOfPortPins: 1..145, set at pre-compile, default-value=3  # The number of specified PortPins in this PortContainer.
        container PortPin [1..*]: multiplicity set at pre-compile  # Configuration of the individual port pins.
          boolean PortPinPFE: origin=NXP, post-build-variant-value=true, set at post-build in variant post-build / pre-compile in variant pre-compile, default-value=false  # Passive Filter Enable Passive filter configuration is valid in all digital pin muxing modes.
          boolean PortPinDirectionChangeable: post-build-variant-value=true, set at post-build in variant post-build / pre-compile in variant pre-compile, default-value=true  # Enable/Disable the changeability for the configured Pin. Checked box means the Direction Changeability is enabled. This is an implementation specific parameter. The changeable pin direction can be set only for the GPIO pins. For a mode different than GPIO, pin direction changeablity shall be disabled.
          boolean PortPinModeChangeable: post-build-variant-value=true, set at post-build in variant post-build / pre-compile in variant pre-compile, default-value=true  # Parameter to indicate if the mode of a port pin is changeable during runtime. True: Port Pin mode changeable allowed. False: Port Pin mode changeable not permitted
          integer PortPinId: 1..145, set at pre-compile, symbolic-name-value=true, default-value=2  # Pin Id of the port pin. This value will be assigned to the symbolic name derived from the port pin container short name.
          integer PortPinPcr: 0..144, origin=NXP, post-build-variant-value=true, set at post-build in variant post-build / pre-compile in variant pre-compile, default-value=0  # Used to specify the PCR (Port Configuration Register) for the configured pin.
          enumeration PortPinMode: {GPIO, ADC0_SE0_CMP0_IN0, ADC0_SE10_CMP0_IN5, ADC0_SE11_CMP0_IN4, ADC0_SE12, ADC0_SE13, ADC0_SE14, ADC0_SE15, ADC0_SE1_CMP0_IN1, ADC0_SE2, ADC0_SE3, ADC0_SE4_ADC1_SE14, ADC0_SE5_ADC1_SE15, ADC0_SE6, ADC0_SE7, ADC0_SE8, ADC0_SE9, ADC1_SE0, ADC1_SE10, ADC1_SE11, ADC1_SE12, ADC1_SE13, ADC1_SE14, ADC1_SE15, ADC1_SE1, ADC1_SE2, ADC1_SE3, ADC1_SE4, ADC1_SE5, ADC1_SE6, ADC1_SE7, ADC1_SE8_ADC0_SE8, ADC1_SE9_ADC0_SE9, CAN0_RX, CAN0_TX, CAN1_RX, CAN1_TX, CAN2_RX, CAN2_TX, CLKOUT, CMP0_IN2, CMP0_IN3, CMP0_IN6, CMP0_IN7, CMP0_OUT, CMP0_RRT, EWM_IN, EWM_OUT_b, EXTAL, FTM0_CH0, FTM0_CH1, FTM0_CH2, FTM0_CH3, FTM0_CH4, FTM0_CH5, FTM0_CH6, FTM0_CH7, FTM0_FLT0, FTM0_FLT1, FTM0_FLT2, FTM0_FLT3, FTM1_CH0, FTM1_CH1, FTM1_CH2, FTM1_CH3, FTM1_CH4, FTM1_CH5, FTM1_CH6, FTM1_CH7, FTM1_FLT0, FTM1_FLT1, FTM1_FLT2, FTM1_FLT3, FTM1_QD_PHA, FTM1_QD_PHB, FTM2_CH0, FTM2_CH1, FTM2_CH2, FTM2_CH3, FTM2_CH4, FTM2_CH5, FTM2_CH6, FTM2_CH7, FTM2_FLT0, FTM2_FLT1, FTM2_FLT2, FTM2_FLT3, FTM2_QD_PHA, FTM2_QD_PHB, FTM3_CH0, FTM3_CH1, FTM3_CH2, FTM3_CH3, FTM3_CH4, FTM3_CH5, FTM3_CH6, FTM3_CH7, FTM3_FLT0, FTM3_FLT1, FTM3_FLT2, FTM3_FLT3, FXIO_D0, FXIO_D1, FXIO_D2, FXIO_D3, FXIO_D4, FXIO_D5, FXIO_D6, FXIO_D7, JTAG_TCLK_SWD_CLK, JTAG_TDI, JTAG_TDO, JTAG_TMS_SWD_DIO, LPI2C0_HREQ, LPI2C0_SCLS, LPI2C0_SCL, LPI2C0_SDAS, LPI2C0_SDA, LPSPI0_PCS0, LPSPI0_PCS1, LPSPI0_PCS2, LPSPI0_PCS3, LPSPI0_SCK, LPSPI0_SIN, LPSPI0_SOUT, LPSPI1_PCS0, LPSPI1_PCS1, LPSPI1_PCS2, LPSPI1_PCS3, LPSPI1_SCK, LPSPI1_SIN, LPSPI1_SOUT, LPSPI2_PCS0, LPSPI2_PCS1, LPSPI2_PCS2, LPSPI2_PCS3, LPSPI2_SCK, LPSPI2_SIN, LPSPI2_SOUT, LPTMR0_ALT1, LPTMR0_ALT2, LPTMR0_ALT3, LPUART0_CTS, LPUART0_RTS, LPUART0_RX, LPUART0_TX, LPUART1_CTS, LPUART1_RTS, LPUART1_RX, LPUART1_TX, LPUART2_CTS, LPUART2_RTS, LPUART2_RX, LPUART2_TX, NMI_b, RESET_b, RTC_CLKIN, RTC_CLKOUT, TCLK0, TCLK1, TCLK2, TRGMUX_IN0, TRGMUX_IN10, TRGMUX_IN11, TRGMUX_IN1, TRGMUX_IN2, TRGMUX_IN3, TRGMUX_IN4, TRGMUX_IN5, TRGMUX_IN6, TRGMUX_IN7, TRGMUX_IN8, TRGMUX_IN9, TRGMUX_OUT0, TRGMUX_OUT1, TRGMUX_OUT2, TRGMUX_OUT3, TRGMUX_OUT4, TRGMUX_OUT5, TRGMUX_OUT6, TRGMUX_OUT7, XTAL}, post-build-variant-value=true, set at post-build in variant post-build / pre-compile in variant pre-compile, default-value=GPIO  # Selects the PORT pin mode from the modes list. One or more modes may be valid for a pin. This way it is possible to select between multiple modes.( e.g. DIO (GPIO option) or ICU (eTimer option)).
          enumeration PortPinDSE: {Low_drive_strength, High_drive_strength}, origin=NXP, post-build-variant-value=true, set at post-build in variant post-build / pre-compile in variant pre-compile, default-value=Low_drive_strength  # Selects the drive strenght length value for this pin.
          enumeration PortPinPE: {PullDisabled, PullEnabled}, origin=NXP, post-build-variant-value=true, set at post-build in variant post-build / pre-compile in variant pre-compile, default-value=PullDisabled  # Selects if the pull-up or pull-down resistors are enabled.
          enumeration PortPinPS: {PullDown, PullUp}, origin=NXP, post-build-variant-value=true, set at post-build in variant post-build / pre-compile in variant pre-compile, default-value=PullDown  # Selects between the pull-up and pull-down resistors. Only valid when PortPin PE is set to 'PullEnabled'.
          enumeration PortPinDirection: {PORT_PIN_IN, PORT_PIN_OUT, PORT_PIN_HIGH_Z}, post-build-variant-value=true, set at post-build in variant post-build / pre-compile in variant pre-compile, default-value=PORT_PIN_IN  # Selects the direction of the pin (IN, OUT, HIGH_Z) that will be configured by Port_Init() function if the pin is configured as GPIO. If the direction is not changeable, the value configured here is fixed. For the Alternative Function modes (PortPinMode is different than GPIO), the setting in this enumeration control is kept in the port configuration structure and it is used when Port_SetPinMode() is called at runtime to change the mode of the pin to GPIO. Set input pin to high-Z not available in S32K11X
          enumeration PortPinInitialMode: {PORT_GPIO_MODE, PORT_ALT1_FUNC_MODE, PORT_ALT2_FUNC_MODE, PORT_ALT3_FUNC_MODE, PORT_ALT4_FUNC_MODE, PORT_ALT5_FUNC_MODE, PORT_ALT6_FUNC_MODE, PORT_ALT7_FUNC_MODE}, post-build-variant-value=true, set at post-build in variant post-build / pre-compile in variant pre-compile, default-value=PORT_GPIO_MODE  # Port pin mode from mode list for use with Port_Init() function. NOTE: This parameter is not used in the current implementation and is retained as per std AUTOSAR_EcucParamDef.arxml file.
          enumeration PortPinLevelValue: {PORT_PIN_LEVEL_HIGH, PORT_PIN_LEVEL_LOW, PORT_PIN_LEVEL_NOTCHANGED}, post-build-variant-value=true, set at post-build in variant post-build / pre-compile in variant pre-compile, default-value=PORT_PIN_LEVEL_LOW  # Port Pin Level value from Port pin list.
      container UnTouchedPortPin [0..*]: multiplicity set at pre-compile  # List containing Pins that will not be touched by Port_Init() function.
        integer PortPinPcr: 0..144, origin=NXP, post-build-variant-value=true, set at post-build in variant post-build / pre-compile in variant pre-compile, default-value=0  # Used to specify the PCR (Port Configuration Register) for the configured pin.
      container DigitalFilter [0..*]: multiplicity set at pre-compile in variant pre-compile / post-build in variant post-build, post-build-variant-multiplicity=true  # Configuration of a Digital Filter module available on the platfom.
        string DigitalFilterPort: origin=NXP, post-build-variant-value=true, set at pre-compile in variant pre-compile / post-build in variant post-build, default-value=PORT_A  # Selects one of the PORTs available on the platform.
        enumeration DigitalFilterClock: {BUS_CLOCK, LPO_CLOCK}, origin=NXP, post-build-variant-value=true, set at post-build in variant post-build / pre-compile in variant pre-compile, default-value=BUS_CLOCK  # Configures the clock source for the digital input filters.
        integer DigitalFilterWidth: 0..31, origin=NXP, post-build-variant-value=true, set at pre-compile in variant pre-compile / post-build in variant post-build, default-value=0  # Configures the maximum size of the glitches, in clock cycles, that the digital filter absorbs for the enabled digital filters. Glitches that are longer than this register setting will pass through the digital filter, and glitches that are equal to or less than this register setting are filtered.
        container DigitalFilterChannel [0..*]: multiplicity set at pre-compile in variant pre-compile / post-build in variant post-build  # Configuration of a Digital Filter channel available on the platfom.
          integer DigitalFilterChannelIndex: 0..31, origin=NXP, post-build-variant-value=true, set at pre-compile in variant pre-compile / post-build in variant post-build, default-value=0  # Selects the channel in the port for which Digital Filter will be enabled.
    container PortGeneral  # Module wide configuration parameters of the PORT driver.
      boolean PortDevErrorDetect: set at pre-compile, default-value=true  # Switches the Development Error Detection and Notification ON or OFF.
      boolean PortSetPinDirectionApi: set at pre-compile, default-value=true  # Pre-processor switch to enable/disable the use of the function Port_SetPinDirection().
      boolean PortSet2PinsDirectionApi: origin=NXP, set at pre-compile, default-value=false  # Pre-processor switch to enable/disable the use of the function Port_Set2PinsDirection().
      boolean PortSetPinModeApi: set at pre-compile, default-value=true  # The function for changing the pin modes is not supported by the safety implementation.
      boolean PortVersionInfoApi: set at pre-compile, default-value=true  # Pre-processor switch to enable/disable the API to read out the modules version information.
      boolean PortSetPinModeDoesNotTouchGpioLevel: origin=NXP, set at pre-compile, default-value=false  # Pre-processor switch. When not checked, the function Port_SetPinMode() will set the output level of the pin to the value configured in the PortPinLevelValue combo when called at run time to change mode of a pin from alternate function to GPIO. When checked, the function Port_SetPinMode() will not touch the output level of the pin when called at run time to change mode of a pin from alternate function to GPIO.
      boolean PortEnableUserModeSupport: origin=NXP, set at pre-compile, default-value=false  # This parameter is added in Port configuration in order to keep a consistent design over the entire set of MCAL drivers. It cannot be configured by the user and is always set to 'false'. There are no registers used by the driver which require special measures in order to be accessed from user mode, so Port driver can be run from either user or supervisor mode.
    container CommonPublishedInformation  # Common container, aggregated by all modules. It contains published information about vendor and versions.
      integer ArReleaseMajorVersion: 4..4, origin=NXP, set at published-information, default-value=4  # Major version number of AUTOSAR specification on which the appropriate implementation is based on.
      integer ArReleaseMinorVersion: 2..2, origin=NXP, set at published-information, default-value=2  # Minor version number of AUTOSAR specification on which the appropriate implementation is based on.
      integer ArReleaseRevisionVersion: 2..2, origin=NXP, set at published-information, default-value=2  # Revision version number of AUTOSAR specification on which the appropriate implementation is based on.
      integer ModuleId: 124..124, origin=NXP, set at published-information, default-value=124  # Module ID of this module from Module List.
      integer SwMajorVersion: 1..1, origin=NXP, set at published-information, default-value=1  # Major version number of the vendor specific implementation of the module. The numbering is vendor specific.
      integer SwMinorVersion: 0..0, origin=NXP, set at published-information, default-value=0  # Minor version number of the vendor specific implementation of the module. The numbering is vendor specific.
      integer SwPatchVersion: 2..2, origin=NXP, set at published-information, default-value=2  # Patch level version number of the vendor specific implementation of the module. The numbering is vendor specific.
      string VendorApiInfix [0..1]: multiplicity set at published-information, origin=NXP, set at published-information  # In driver modules which can be instantiated several times on a single ECU, BSW00347 requires that the name of APIs is extended by the VendorId and a vendor specific name. This parameter is used to specify the vendor specific name. In total, the implementation specific name is generated as follows: <ModuleName>_>VendorId>_<VendorApiInfix>. E.g. assuming that the VendorId of the implementor is 123 and the implementer chose a VendorApiInfix of "v11r456" a api name Can_Write defined in the SWS will translate to Can_123_v11r456Write. This parameter is mandatory for all modules with upper multiplicity > 1. It shall not be used for modules with upper multiplicity =1.
      integer VendorId: 43..43, origin=NXP, set at published-information, default-value=43  # Vendor ID of the dedicated implementation of this module according to the AUTOSAR vendor list.
