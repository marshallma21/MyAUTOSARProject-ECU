AUTOSAR XML (schema 4-3-0)
package /TS_T40D2M10I2R0
  ecuc definition collection Icu_EcuParameterDefinition: module=Icu
  module definition Icu: post-build-variant-support=true, refined-module-def=Icu, variants post-build/pre-compile  # Configuration of the Icu (Input Capture Unit) module.
    container IcuConfigSet  # This container is the base for a multiple configuration set
      integer IcuMaxChannel: 1..126, set at post-build in variant post-build / pre-compile in variant pre-compile, derivation=informal-formula=verbatim=l-5=number of configured icu channels, default-value=3  # The value for the IcuMaxChannel must match with the number of IcuChannel configured For calculating the correct value use the CALC button. Note: Total number of configured channels should be same across all IcuConfigSets.
      container IcuChannel [1..*]: multiplicity set at pre-compile  # Configuration of an individual ICU channel.
        integer IcuChannelId: 0..125, scope=ECU, set at pre-compile, symbolic-name-value=true, default-value=1  # Channel Id of the ICU channel. This value will be assigned to the symbolic name derived of the IcuChannel container short name.
        enumeration IcuHwIP: {FTM, PORT, LPIT, LPTMR}, origin=NXP, post-build-variant-value=true, set at pre-compile in variant pre-compile / post-build in variant post-build, default-value=FTM  # Selects the physical HwChannelId Channel.
        boolean IcuDMAChannelEnable: origin=NXP, set at pre-compile in variant pre-compile / post-build in variant post-build, default-value=false  # IcuDMAChannelEnable indicates if the corresponding channel will use DMA for measurement
        enumeration IcuDefaultStartEdge: {ICU_BOTH_EDGES, ICU_FALLING_EDGE, ICU_RISING_EDGE}, post-build-variant-value=true, set at pre-compile in variant pre-compile / post-build in variant post-build, default-value=ICU_RISING_EDGE  # Configures the default-activation-edge which shall be used for this channel if there was no activation-edge configured by the call of service Icu_SetActivationCondition(). In case the Measurement Mode is "IcuSignalMeasurement" and the properties "DutyCycle" or "Period" are set, the edge configured here is used as Default Period Start Edge. Implementation Type: Icu_ActivationType
        enumeration IcuMeasurementMode: {ICU_MODE_EDGE_COUNTER, ICU_MODE_SIGNAL_EDGE_DETECT, ICU_MODE_SIGNAL_MEASUREMENT, ICU_MODE_TIMESTAMP}, post-build-variant-value=true, set at pre-compile in variant pre-compile / post-build in variant post-build, default-value=ICU_MODE_SIGNAL_EDGE_DETECT  # Configures the measurement mode of this channel. User should enable optional parameters with respect to the selected IcuMeasurementMode. Implementation Type: Icu_MeasurementModeType
        function name IcuOverflowNotification: origin=NXP, post-build-variant-value=true, set at pre-compile in variant pre-compile / post-build in variant post-build, default-value=NULL_PTR  # Icu Overflow Notification Handler In order to activate this field you have to: enable IcuOverflowNotificationApi, choose one of the modes: ICU_MODE_EDGE_COUNTER, ICU_MODE_SIGNAL_MEASUREMENT, ICU_MODE_TIMESTAMP to enable overflow detection on the internal counter Note: Due to hardware implementattion, the Icu Overflow Notification is not syncronous with the event for ICU_MODE_SIGNAL_MEASUREMENT and ICU_MODE_TIMESTAMP modes. The notification will be triggered when measurement completes (for ICU_MODE_SIGNAL_MEASUREMENT) or the next timestamp event occurs (for ICU_MODE_TIMESTAMP).
        boolean IcuLockableChannel: origin=NXP, post-build-variant-value=true, set at pre-compile in variant pre-compile / post-build in variant post-build, default-value=false  # IcuLockableChannel indicates if the corresponding channel shall be the object of the configuration locking mechanism.
        boolean IcuWakeupCapability: post-build-variant-value=true, set at pre-compile in variant pre-compile / post-build in variant post-build, default-value=false  # Information about the wakeup-capability of this channel. true: Channel is wakeup capable. false: Channel is not wakeup capable.
        reference IcuFtmChannelRef [0..1]: multiplicity set at pre-compile in variant pre-compile / post-build in variant post-build, origin=NXP, post-build-variant-value=true, set at pre-compile in variant pre-compile / post-build in variant post-build, destination=IcuFtmChannels  # Select the FTM channel on which the functionality of the current ICU channel will be implemented
        reference IcuPortChannelRef [0..1]: multiplicity set at pre-compile in variant pre-compile / post-build in variant post-build, origin=NXP, post-build-variant-value=true, set at pre-compile in variant pre-compile / post-build in variant post-build, destination=IcuPortChannels  # Select the PORT channel on which the functionality of the current ICU channel will be implemented
        reference IcuLpitChannelRef [0..1]: multiplicity set at pre-compile in variant pre-compile / post-build in variant post-build, origin=NXP, post-build-variant-value=true, set at pre-compile in variant pre-compile / post-build in variant post-build, destination=IcuLpitChannels  # Select the LPIT channel on which the functionality of the current ICU channel will be implemented
        reference IcuLptmrChannelRef [0..1]: multiplicity set at pre-compile in variant pre-compile / post-build in variant post-build, origin=NXP, post-build-variant-value=true, set at pre-compile in variant pre-compile / post-build in variant post-build, destination=IcuLptmrChannels  # Select the LPTMR channel on which the functionality of the current ICU channel will be implemented
        choice reference IcuDMAChannelRef [0..1]: multiplicity set at pre-compile in variant pre-compile / post-build in variant post-build, origin=NXP, post-build-variant-value=true, set at pre-compile in variant pre-compile / post-build in variant post-build, destination=DMAChannel  # Icu DMA Channel Reference Reference to the DMA Channel configure for the Request
        container IcuSignalEdgeDetection [0..1]: multiplicity set at pre-compile  # This container contains the configuration (parameters) in case the measurement mode is "IcuSignalEdgeDetection"
          function name IcuSignalNotification [0..1]: multiplicity set at pre-compile in variant pre-compile / post-build in variant post-build, post-build-variant-multiplicity=true, post-build-variant-value=true, set at pre-compile in variant pre-compile / post-build in variant post-build, default-value=NULL_PTR  # Notification function for signal notification.
        container IcuSignalMeasurement [0..1]: multiplicity set at pre-compile  # This container contains the configuration (parameters) in case the measurement mode is "IcuSignalMeasurement"
          enumeration IcuSignalMeasurementProperty: {ICU_DUTY_CYCLE, ICU_HIGH_TIME, ICU_LOW_TIME, ICU_PERIOD_TIME}, post-build-variant-value=true, set at pre-compile in variant pre-compile / post-build in variant post-build, default-value=ICU_DUTY_CYCLE  # Configures the property that could be measured in case the mode is "IcuSignalMeasurement". This property can not be changed during runtime. Followings are measurement mode ICU_DUTY_CYCLE ICU_HIGH_TIME ICU_LOW_TIME ICU_PERIOD_TIME Implementation Type: Icu_SignalMeasurementPropertyType
        container IcuTimestampMeasurement [0..1]: multiplicity set at pre-compile  # This container contains the configuration (parameters) in case the measurement mode is "IcuTimestamp"
          enumeration IcuTimestampMeasurementProperty: {ICU_CIRCULAR_BUFFER, ICU_LINEAR_BUFFER}, post-build-variant-value=true, set at pre-compile in variant pre-compile / post-build in variant post-build, default-value=ICU_LINEAR_BUFFER  # Configures the handling of the buffer in case the mode is "Timestamp" Following type of buffer inplemented in current implementation. ICU_CIRCULAR_BUFFER. ICU_LINEAR_BUFFER. Implementation Type: Icu_TimestampBufferType
          function name IcuTimestampNotification [0..1]: multiplicity set at pre-compile in variant pre-compile / post-build in variant post-build, post-build-variant-multiplicity=true, post-build-variant-value=true, set at pre-compile in variant pre-compile / post-build in variant post-build, default-value=NULL_PTR  # Notification function if the number of requested timestamps(Notification interval > 0) are acquired.
        container IcuWakeup [0..1]: multiplicity set at pre-compile  # This container contains the configuration (parameters) needed to configure a wakeup capable channel
          symbolic name reference IcuChannelWakeupInfo [0..1]: multiplicity set at pre-compile in variant pre-compile / post-build in variant post-build, post-build-variant-multiplicity=true, post-build-variant-value=true, set at pre-compile in variant pre-compile / post-build in variant post-build, destination=EcuMWakeupSource  # If the wakeup-capability is true the wakeup source referenced is transmitted to the ECU State Manager (EcuM) . Implementation Type: reference to EcuM_WakeupSourceType
      container IcuFtm [0..4]: multiplicity set at pre-compile  # Configuration of a Ftm module available on the platfom.
        enumeration IcuFtmModule: {FTM_0, FTM_1, FTM_2, FTM_3}, origin=NXP, post-build-variant-value=true, set at pre-compile in variant pre-compile / post-build in variant post-build, default-value=FTM_0  # Select the physical Ftm Module.
        enumeration Icu_FlexTimer_Prescaler: {ICU_FTM_PRESCALER_DIVIDE_1, ICU_FTM_PRESCALER_DIVIDE_2, ICU_FTM_PRESCALER_DIVIDE_4, ICU_FTM_PRESCALER_DIVIDE_8, ICU_FTM_PRESCALER_DIVIDE_16, ICU_FTM_PRESCALER_DIVIDE_32, ICU_FTM_PRESCALER_DIVIDE_64, ICU_FTM_PRESCALER_DIVIDE_128}, origin=NXP, post-build-variant-value=true, set at pre-compile in variant pre-compile / post-build in variant post-build, default-value=ICU_FTM_PRESCALER_DIVIDE_128  # If an FTM channel from module 1 is being used, this configures the prescaler value for the specific channel.
        enumeration Icu_FlexTimer_Prescaler_Alternate: {ICU_FTM_PRESCALER_DIVIDE_1, ICU_FTM_PRESCALER_DIVIDE_2, ICU_FTM_PRESCALER_DIVIDE_4, ICU_FTM_PRESCALER_DIVIDE_8, ICU_FTM_PRESCALER_DIVIDE_16, ICU_FTM_PRESCALER_DIVIDE_32, ICU_FTM_PRESCALER_DIVIDE_64, ICU_FTM_PRESCALER_DIVIDE_128}, origin=NXP, post-build-variant-value=true, set at pre-compile in variant pre-compile / post-build in variant post-build, default-value=ICU_FTM_PRESCALER_DIVIDE_128  # If an FTM channel from module 0 is being used, this configures the alternate prescaler value for the specific channel. This can be set when calling Icu_SetClockMode(ICU_ALTERNATE_CLOCK_MODE)
        enumeration Icu_FlexTimer_ClockSource: {ICU_FTM_SYSTEM_CLOCK, ICU_FTM_EXTERNAL_CLOCK, ICU_FTM_FIXED_FREQUENCY_CLOCK}, origin=NXP, post-build-variant-value=true, set at pre-compile in variant pre-compile / post-build in variant post-build, default-value=ICU_FTM_SYSTEM_CLOCK  # Input Filter Sample Count (FILT_CNT): Number of consecutive samples that must agree prior to the input filter accepting an input transition. Note: This is an Implementation Specific Parameter.
        container IcuFtmChannels [1..8]: multiplicity set at pre-compile  # List of Ftm channels available on the platform.
          enumeration IcuFtmChannel: {CH_0, CH_1, CH_2, CH_3, CH_4, CH_5, CH_6, CH_7}, origin=NXP, post-build-variant-value=true, set at pre-compile in variant pre-compile / post-build in variant post-build, default-value=CH_0  # Selects one of the Ftm channels available on the platform.
          integer Icu_FlexTimerFilter: 0..15, origin=NXP, post-build-variant-value=true, set at pre-compile in variant pre-compile / post-build in variant post-build, default-value=0  # Input Capture Filter Control: Selects the filter value for the channel input. The filter is disabled when the value is zero. Note: This is an Implementation Specific Parameter.
          boolean IcuFreezeEnable: origin=NXP, post-build-variant-value=true, set at pre-compile in variant pre-compile / post-build in variant post-build, default-value=false  # Vendor specific: Select to set hardware freeze enable during debug mode. On FlexTimer channels the freeze option must be the same for all channels belonging to the same module.
      container IcuPort [0..5]: multiplicity set at pre-compile  # Configuration of a Port module available on the platfom.
        enumeration IcuPortModule: {PORT_0, PORT_1, PORT_2, PORT_3, PORT_4}, origin=NXP, post-build-variant-value=true, set at pre-compile in variant pre-compile / post-build in variant post-build, default-value=PORT_0  # Select the physical Ftm Module.
        container IcuPortChannels [1..18]: multiplicity set at pre-compile  # List of Port Channels on flatform.
          enumeration IcuPortChannel: {CH_0, CH_1, CH_2, CH_3, CH_4, CH_5, CH_6, CH_7, CH_8, CH_9, CH_10, CH_11, CH_12, CH_13, CH_14, CH_15, CH_16, CH_17}, origin=NXP, post-build-variant-value=true, set at pre-compile in variant pre-compile / post-build in variant post-build, default-value=CH_0  # Selects one of the Port channels available on the platform.
      container IcuLpit [0..1]: multiplicity set at pre-compile  # Configuration of a Lpit module available on the platfom.
        enumeration IcuLpitModule: {LPIT_0}, origin=NXP, post-build-variant-value=true, set at pre-compile in variant pre-compile / post-build in variant post-build, default-value=LPIT_0  # Select the physical Lpit Module.
        boolean IcuFreezeEnable: origin=NXP, post-build-variant-value=true, set at pre-compile in variant pre-compile / post-build in variant post-build, default-value=false  # Vendor specific: Select to set hardware freeze enable during debug mode. On FlexTimer channels the freeze option must be the same for all channels belonging to the same module.
        container IcuLpitChannels [1..4]: multiplicity set at pre-compile  # List of Lpit Channels on flatform.
          enumeration IcuLpitChannel: {CH_0, CH_1, CH_2, CH_3}, origin=NXP, post-build-variant-value=true, set at pre-compile in variant pre-compile / post-build in variant post-build, default-value=CH_0  # Selects one of the Lpit channels available on the platform.
          enumeration IcuLpitTriggerSource: {INTERNAL_TRIGGER, EXTERNAL_TRIGGER}, origin=NXP, post-build-variant-value=true, set at pre-compile in variant pre-compile / post-build in variant post-build, default-value=INTERNAL_TRIGGER  # Selects the internal and external trigger sources . INTERNAL_TRIGGER EXTERNAL_TRIGGER
          enumeration IcuLpitTriggerSelect: {ICU_LPIT_TRG_CH0, ICU_LPIT_TRG_CH1, ICU_LPIT_TRG_CH2, ICU_LPIT_TRG_CH3}, origin=NXP, post-build-variant-value=true, set at pre-compile in variant pre-compile / post-build in variant post-build, default-value=ICU_LPIT_TRG_CH0  # Select one trigger from the set of internal or external triggers selected by TRG_SRC. ICU_LPIT_TRG_CH0 ICU_LPIT_TRG_CH1 ICU_LPIT_TRG_CH2 ICU_LPIT_TRG_CH3
      container IcuLptmr [0..1]: multiplicity set at pre-compile  # Configuration of a Lptmr module available on the platfom.
        enumeration IcuLptmrModule: {LPTMR_0}, origin=NXP, post-build-variant-value=true, set at pre-compile in variant pre-compile / post-build in variant post-build, default-value=LPTMR_0  # Select the physical Lptmr Module.
        boolean PrescalerEnable: origin=NXP, post-build-variant-value=true, set at pre-compile in variant pre-compile / post-build in variant post-build, default-value=true  # When PBYP is set, the selected prescaler clock in Time Counter mode or selected input source in Pulse Counter mode directly clocks the CNR.
        enumeration IcuLptmrPrescaler: {ICU_LPTMR_GLITCH_FILTER_2, ICU_LPTMR_GLITCH_FILTER_4, ICU_LPTMR_GLITCH_FILTER_8, ICU_LPTMR_GLITCH_FILTER_16, ICU_LPTMR_GLITCH_FILTER_32, ICU_LPTMR_GLITCH_FILTER_64, ICU_LPTMR_GLITCH_FILTER_128, ICU_LPTMR_GLITCH_FILTER_256, ICU_LPTMR_GLITCH_FILTER_512, ICU_LPTMR_GLITCH_FILTER_1024, ICU_LPTMR_GLITCH_FILTER_2048, ICU_LPTMR_GLITCH_FILTER_4096, ICU_LPTMR_GLITCH_FILTER_8192, ICU_LPTMR_GLITCH_FILTER_16384, ICU_LPTMR_GLITCH_FILTER_32768}, origin=NXP, post-build-variant-value=true, set at pre-compile in variant pre-compile / post-build in variant post-build, default-value=ICU_LPTMR_GLITCH_FILTER_2  # Vendor specific: The ICU module specific Glitch filter value. Configures the Glitch filter in Pulse Counter mode. 1 - Glitch filter recognizes change on input pin after 2 rising clock edges 2 - Glitch filter recognizes change on input pin after 4 rising clock edges 3 - Glitch filter recognizes change on input pin after 8 rising clock edges 4 - Glitch filter recognizes change on input pin after 16 rising clock edges 5 - Glitch filter recognizes change on input pin after 32 rising clock edges 6 - Glitch filter recognizes change on input pin after 64 rising clock edges 7 - Glitch filter recognizes change on input pin after 128 rising clock edges 8 - Glitch filter recognizes change on input pin after 256 rising clock edges 9 - Glitch filter recognizes change on input pin after 512 rising clock edges 10 - Glitch filter recognizes change on input pin after 1024 rising clock edges 11 - Glitch filter recognizes change on input pin after 2048 rising clock edges 12 - Glitch filter recognizes change on input pin after 4096 rising clock edges 13 - Glitch filter recognizes change on input pin after 8192 rising clock edges 14 - Glitch filter recognizes change on input pin after 16384 rising clock edges 15 - Glitch filter recognizes change on input pin after 32768 rising clock edges
        enumeration IcuLptmrChannelClkSrc: {SIRCDIV2_CLK, LPO1K_CLK, RTC_CLK, PCC_LPTMR0}, origin=NXP, post-build-variant-value=true, set at pre-compile in variant pre-compile / post-build in variant post-build, default-value=SIRCDIV2_CLK  # Vendor specific: The ICU module specific clock input for the timer unit can statically be configured and allows to select different clock sources per module. Select the clock source for the FlexTimer module for this platform. SIRCDIV2_CLK LPO1K_CLK RTC_CLK PCC_LPTMR0
        enumeration IcuLptmrPinSelect: {TRGMUX_OUTPUT, ALT1, ALT2, ALT3}, origin=NXP, post-build-variant-value=true, set at pre-compile in variant pre-compile / post-build in variant post-build, default-value=ALT1  # Configures the input source to be used in Pulse Counter mode. ALT1 ALT2 ALT3
        container IcuLptmrChannels  # List of Lptmr Channels on flatform.
          enumeration IcuLptmrChannel: {CH_0}, origin=NXP, post-build-variant-value=true, set at pre-compile in variant pre-compile / post-build in variant post-build, default-value=CH_0  # Selects one of the Lptmr channels available on the platform.
      container IcuHwInterruptConfigList [126..126]  # List of HW interrupts available for the entire platform.
        enumeration IcuIsrHwId: {FTM_0_CH_0, FTM_0_CH_1, FTM_0_CH_2, FTM_0_CH_3, FTM_0_CH_4, FTM_0_CH_5, FTM_0_CH_6, FTM_0_CH_7, FTM_1_CH_0, FTM_1_CH_1, FTM_1_CH_2, FTM_1_CH_3, FTM_1_CH_4, FTM_1_CH_5, FTM_1_CH_6, FTM_1_CH_7, FTM_2_CH_0, FTM_2_CH_1, FTM_2_CH_2, FTM_2_CH_3, FTM_2_CH_4, FTM_2_CH_5, FTM_2_CH_6, FTM_2_CH_7, FTM_3_CH_0, FTM_3_CH_1, FTM_3_CH_2, FTM_3_CH_3, FTM_3_CH_4, FTM_3_CH_5, FTM_3_CH_6, FTM_3_CH_7, PORT_0_CH_0, PORT_0_CH_1, PORT_0_CH_2, PORT_0_CH_3, PORT_0_CH_4, PORT_0_CH_5, PORT_0_CH_6, PORT_0_CH_7, PORT_0_CH_8, PORT_0_CH_9, PORT_0_CH_10, PORT_0_CH_11, PORT_0_CH_12, PORT_0_CH_13, PORT_0_CH_14, PORT_0_CH_15, PORT_0_CH_16, PORT_0_CH_17, PORT_1_CH_0, PORT_1_CH_1, PORT_1_CH_2, PORT_1_CH_3, PORT_1_CH_4, PORT_1_CH_5, PORT_1_CH_6, PORT_1_CH_7, PORT_1_CH_8, PORT_1_CH_9, PORT_1_CH_10, PORT_1_CH_11, PORT_1_CH_12, PORT_1_CH_13, PORT_1_CH_14, PORT_1_CH_15, PORT_1_CH_16, PORT_1_CH_17, PORT_2_CH_0, PORT_2_CH_1, PORT_2_CH_2, PORT_2_CH_3, PORT_2_CH_4, PORT_2_CH_5, PORT_2_CH_6, PORT_2_CH_7, PORT_2_CH_8, PORT_2_CH_9, PORT_2_CH_10, PORT_2_CH_11, PORT_2_CH_12, PORT_2_CH_13, PORT_2_CH_14, PORT_2_CH_15, PORT_2_CH_16, PORT_2_CH_17, PORT_3_CH_0, PORT_3_CH_1, PORT_3_CH_2, PORT_3_CH_3, PORT_3_CH_4, PORT_3_CH_5, PORT_3_CH_6, PORT_3_CH_7, PORT_3_CH_8, PORT_3_CH_9, PORT_3_CH_10, PORT_3_CH_11, PORT_3_CH_12, PORT_3_CH_13, PORT_3_CH_14, PORT_3_CH_15, PORT_3_CH_16, PORT_3_CH_17, PORT_4_CH_0, PORT_4_CH_1, PORT_4_CH_2, PORT_4_CH_3, PORT_4_CH_4, PORT_4_CH_5, PORT_4_CH_6, PORT_4_CH_7, PORT_4_CH_8, PORT_4_CH_9, PORT_4_CH_10, PORT_4_CH_11, PORT_4_CH_12, PORT_4_CH_13, PORT_4_CH_14, PORT_4_CH_15, PORT_4_CH_16, LPIT_0_CH_0, LPIT_0_CH_1, LPIT_0_CH_2, LPIT_0_CH_3, LPTMR_0_CH_0}, origin=NXP, set at pre-compile, symbolic-name-value=true, default-value=FTM_0_CH_1  # Id of the HW interrupt service routine available platform wide and usable by ICU module.
        boolean IcuIsrEnable: origin=NXP, set at pre-compile, default-value=false  # Status of the HW Interrupt (true - Interrupt shall be enable platform wide; false - Interrupt shall be disabled platform wide.
    container IcuGeneral  # Configuration of general ICU parameters.
      boolean IcuDevErrorDetect: set at pre-compile, default-value=true  # Switches the Development Error Detection and Notification on or off. true: Enabled. false: Disabled.
      integer IcuIndex: 0..255, set at pre-compile, default-value=0  # Specifies the InstanceId of this module instance. If only one instance is present it shall have the Id 0. Note: .
      boolean IcuReportWakeupSource: set at pre-compile, default-value=true  # Switch for enabling Wakeup source reporting. true: Report Wakeup source. false: Do not report Wakeup source.
      boolean IcuEnableUserModeSupport: origin=NXP, set at pre-compile, default-value=false  # There is no retriction when running from user mode for all ICU IPs. Therefore no further actions are needed in ICU driver for more information, please see chapter 5.7 User Mode Support in IM
    container IcuNonAUTOSAR  # Enabling the settings of this section will configure the driver in a mode not compliant with AUTOSAR requirements.
      boolean IcuEnableDualClockMode: origin=NXP, set at pre-compile, default-value=false  # Enables prescaler settings at mode transition. true: Enabled. false: Disabled. Note: This feature is not required by Autosar.
      boolean IcuOverflowNotificationApi: origin=NXP, set at pre-compile, default-value=false  # Add / removes Overflow Notification functionality. Enabling IcuOverflowNotificationApi overflow events will not be treated as errors and a Notification Handler can be provided. If this optional API is not enabled, overflow events will trigger DET Report Error. Note: Due to hardware implementattion, the Icu Overflow Notification is not syncronous with the event for ICU_MODE_SIGNAL_MEASUREMENT and ICU_MODE_TIMESTAMP modes. The notification will be triggered when measurement completes (for ICU_MODE_SIGNAL_MEASUREMENT) or the next timestamp event occurs (for ICU_MODE_TIMESTAMP).
      boolean IcuGetInputLevelApi: origin=NXP, set at pre-compile, default-value=false  # Add / removes Icu_GetInputLevel API from the code. This function returns Input pin state. Note: This feature is not required by Autosar.
      boolean IcuLptmrStandbyWakeupSupport: origin=NXP, set at pre-compile, default-value=false  # Icu_Init() will not clear the IRQ flags (LPTMR) if it is already set during init. Note: This feature is not required by Autosar and might overule standard.
      enumeration IcuRegisterLockingMode: {NO_REGISTER_LOCKING}, origin=NXP, set at pre-compile in variant pre-compile / post-build in variant post-build, default-value=NO_REGISTER_LOCKING  # IcuRegisterLockingMode can take following values: NoRegisterLocking: no register locking is applicable UserModeSoftLocking: each function writing to hardware registers is responsible for maintaining the register soft locking mechanism; no additional actions needed in the configuration locking mechanism; the register locking management is available in user mode. SupervisorModeSoftLocking: the functions writing the hardware registers use register writes without locking; the configuration locking/unlocking functions are responsible for applying/releasing the register soft locking in supervisor mode only.
      boolean IcuGetCaptureRegisterValueApi: origin=NXP, set at pre-compile, default-value=false  # Adds / removes service Icu_GetCaptureRegisterValue from the code. This function returns value of Capture register for the mesurement channel or timestamp mode channel which is called by the user. It's enabled when IcuTimestampApi or IcuSignalMeasurementApi is true.
    container IcuOptionalApis  # This container contains all configuration switches for configuring optional API services of the ICU driver.
      boolean IcuDeInitApi: set at pre-compile, default-value=true  # Adds / removes the service Icu_DeInit() from the code. true: Icu_DeInit() can be used. false: Icu_DeInit() can not be used.
      boolean IcuDisableWakeupApi: set at pre-compile, default-value=true  # Adds / removes the service Icu_DisableWakeup() from the code. true: Icu_DisableWakeup() can be used. false: Icu_DisableWakeup() can not be used.
      boolean IcuEdgeCountApi: set at pre-compile, default-value=true  # Adds / removes all services related to the edge counting functionality as listed below, from the code: Icu_ResetEdgeCount(), Icu_EnableEdgeCount(), Icu_DisableEdgeCount(), Icu_GetEdgeNumbers(). true: The services listed above can be used. false: The services listed above can not be used.
      boolean IcuEnableWakeupApi: set at pre-compile, default-value=true  # Adds / removes the service Icu_EnableWakeup() from the code. true: Icu_EnableWakeup() can be used. false: Icu_EnableWakeup() can not be used.
      boolean IcuGetDutyCycleValuesApi: set at pre-compile, default-value=true  # Adds / removes the service Icu_GetDutyCycleValues() from the code. true: Icu_GetDutyCycleValues() can be used. false: Icu_GetDutyCycleValues() can not be used. Note: If IcuSignalMeasurementApi == OFF this switch is shall also be set to OFF.
      boolean IcuGetInputStateApi: set at pre-compile, default-value=true  # Adds / removes the service Icu_GetInputState() from the code. true: Icu_GetInputState() can be used. false: Icu_GetInputState() can not be used.
      boolean IcuGetTimeElapsedApi: set at pre-compile, default-value=true  # Adds / removes the service Icu_GetTimeElapsed() from the code. true: Icu_GetTimeElapsed() can be used. false: Icu_GetTimeElapsed() can not be used. Note: If IcuSignalMeasurementApi == OFF this switch is shall also be set to OFF.
      boolean IcuGetVersionInfoApi: set at pre-compile, default-value=true  # Adds / removes the service Icu_GetVersionInfo() from the code. true: Icu_GetVersionInfo() can be used. false: Icu_GetVersionInfo() can not be used.
      boolean IcuSetModeApi: set at pre-compile, default-value=true  # Adds / removes the service Icu_SetMode() from the code. true: Icu_SetMode() can be used. false: Icu_SetMode() can not be used.
      boolean IcuSignalMeasurementApi: set at pre-compile, default-value=true  # Adds / removes the services Icu_StartSignalMeasurement() and Icu_StopSignalMeasurement() from the code. true: Icu_StartSignalMeasurement() and Icu_StopSignalMeasurement() can be used. false: Icu_StartSignalMeasurement() and Icu_StopSignalMeasurement() can not be used.
      boolean IcuTimestampApi: set at pre-compile, default-value=true  # Adds / removes all services related to the timestamping functionality as listed below from the code: Icu_StartTimestamp(), Icu_StopTimestamp(), Icu_GetTimestampIndex(). true: The services listed above can be used. false: The services listed above can not be used.
      boolean IcuWakeupFunctionalityApi: set at pre-compile, default-value=true  # Adds / removes the service Icu_CheckWakeup() from the code. true: Icu_CheckWakeup() can be used. false: Icu_CheckWakeup() can not be used.
      boolean IcuEdgeDetectApi: set at pre-compile, default-value=true  # Adds / removes the services Icu_EnableEdgeDetection() and Icu_DisableEdgeDetection() from the code. true: Icu_EnableEdgeDetection() and Icu_DisableEdgeDetection() can be used. false: Icu_EnableEdgeDetection() and Icu_DisableEdgeDetection() can not be used.
    container CommonPublishedInformation  # Common container, aggregated by all modules. It contains published information about vendor and versions.
      integer ArReleaseMajorVersion: 4..4, origin=NXP, set at published-information, default-value=4  # Major version number of AUTOSAR specification on which the appropriate implementation is based on.
      integer ArReleaseMinorVersion: 2..2, origin=NXP, set at published-information, default-value=2  # Minor version number of AUTOSAR specification on which the appropriate implementation is based on.
      integer ArReleaseRevisionVersion: 2..2, origin=NXP, set at published-information, default-value=2  # Revision version number of AUTOSAR specification on which the appropriate implementation is based on.
      integer ModuleId: 122..122, origin=NXP, set at published-information, default-value=122  # Module ID of this module from Module List.
      integer SwMajorVersion: 1..1, origin=NXP, set at published-information, default-value=1  # Major version number of the vendor specific implementation of the module. The numbering is vendor specific.
      integer SwMinorVersion: 0..0, origin=NXP, set at published-information, default-value=0  # Minor version number of the vendor specific implementation of the module. The numbering is vendor specific.
      integer SwPatchVersion: 2..2, origin=NXP, set at published-information, default-value=2  # Patch level version number of the vendor specific implementation of the module. The numbering is vendor specific.
      string VendorApiInfix [0..1]: multiplicity set at published-information, origin=NXP, set at published-information  # In driver modules which can be instantiated several times on a single ECU, BSW00347 requires that the name of APIs is extended by the VendorId and a vendor specific name. This parameter is used to specify the vendor specific name. In total, the implementation specific name is generated as follows: <ModuleName>_>VendorId>_<VendorApiInfix>. E.g. assuming that the VendorId of the implementor is 123 and the implementer chose a VendorApiInfix of "v11r456" a api name Can_Write defined in the SWS will translate to Can_123_v11r456Write. This parameter is mandatory for all modules with upper multiplicity > 1. It shall not be used for modules with upper multiplicity =1.
      integer VendorId: 43..43, origin=NXP, set at published-information, default-value=43  # Vendor ID of the dedicated implementation of this module according to the AUTOSAR vendor list.
