AUTOSAR XML (schema 4-3-0)
package /TS_T40D2M10I2R0
  ecuc definition collection Spi_AUTOSARParameterDefinition: module=Spi
  ecuc definition collection Spi_EcuParameterDefinition: module=Spi
  module definition Spi: post-build-variant-support=true, refined-module-def=Spi, variants link-time/pre-compile/post-build  # Configuration of the Spi (Serial Peripheral Interface) module.
    container SpiDemEventParameterRefs [0..1]: multiplicity set at pre-compile  # Container for the references to DemEventParameter elements which shall be invoked using the API Dem_ReportErrorStatus API in case the corresponding error occurs. The EventId is taken from the referenced DemEventParameter's DemEventId value. The standardized errors are provided in the container and can be extended by vendor specific error references.
      symbolic name reference SPI_E_HARDWARE_ERROR [0..1]: multiplicity set at pre-compile, set at pre-compile, destination=DemEventParameter  # Reference to configured DEM event to report "Hardware failure". If the reference is not configured the error shall not be reported.
    container SpiDriver  # This container contains the configuration parameters and sub containers of the AUTOSAR Spi module.
      integer SpiMaxChannel [0..1]: 0..255, multiplicity set at link in variant link-time / pre-compile in variant pre-compile / post-build in variant post-build, post-build-variant-multiplicity=true, post-build-variant-value=true, set at link in variant link-time / pre-compile in variant pre-compile / post-build in variant post-build, default-value=0  # This parameter contains the number of Channels configured. It will be gathered by tools during the configuration stage. NoteThis parameter is not used, instead max channel value is derived from number of channels configured.
      integer SpiMaxJob [0..1]: 0..65535, multiplicity set at link in variant link-time / pre-compile in variant pre-compile / post-build in variant post-build, post-build-variant-multiplicity=true, post-build-variant-value=true, set at link in variant link-time / pre-compile in variant pre-compile / post-build in variant post-build, default-value=0  # This parameter contains the number of Jobs configured. It will be gathered by tools during the configuration stage. NoteThis parameter is not used, instead max jobs value is derived from number of jobs configured.
      integer SpiMaxSequence [0..1]: 0..255, multiplicity set at link in variant link-time / pre-compile in variant pre-compile / post-build in variant post-build, post-build-variant-multiplicity=true, post-build-variant-value=true, set at link in variant link-time / pre-compile in variant pre-compile / post-build in variant post-build, default-value=0  # This parameter contains the number of Sequences configured. It will be gathered by tools during the configuration stage. NoteThis parameter is not used, instead max Sequences value is derived from number of sequences configured.
      container SpiChannel [1..*]: multiplicity set at pre-compile  # All data needed to configure one SPI-channel.
        integer SpiChannelId: 0..255, set at pre-compile, symbolic-name-value=true, default-value=0  # SPI Channel ID, used as parameter in SPI API functions.
        enumeration SpiChannelType: {EB, IB}, post-build-variant-value=true, set at link in variant link-time / pre-compile in variant pre-compile / post-build in variant post-build, default-value=IB  # Buffer usage with EB/IB channel. NoteThis parameter is dependant on SpiChannelBuffersAllowed parameter. When SpiChannelBuffersAllowed = 0; SpiChannelType should be IB When SpiChannelBuffersAllowed = 1; SpiChannelType should be EB When SpiChannelBuffersAllowed = 2; SpiChannelType can be IB or EB
        integer SpiDataWidth: 8..32, post-build-variant-value=true, set at link in variant link-time / pre-compile in variant pre-compile / post-build in variant post-build, default-value=8  # This parameter is the width of a transmitted data unit. NoteThe hardware supports data width from 8 to 32 bit.The unit is in bits. When SpiChannelBuffersAllowed = 0; SpiChannelType should be IB When SpiChannelBuffersAllowed = 1; SpiChannelType should be EB When SpiChannelBuffersAllowed = 2; SpiChannelType can be IB or EB
        integer SpiDefaultData [0..1]: 0..4294967295, multiplicity set at link in variant link-time / pre-compile in variant pre-compile / post-build in variant post-build, post-build-variant-multiplicity=true, post-build-variant-value=true, set at link in variant link-time / pre-compile in variant pre-compile / post-build in variant post-build, default-value=1  # The default data to be transmitted when (for internal buffer or external buffer) the pointer passed to Spi_WriteIB (for internal buffer) or to Spi_SetupEB (for external buffer) is NULL.
        integer SpiEbMaxLength: 0..65535, post-build-variant-value=true, set at link in variant link-time / pre-compile in variant pre-compile / post-build in variant post-build, default-value=1  # This parameter contains the maximum size (number of data elements) of data buffers in case of EB Channels and only.
        integer SpiIbNBuffers: 0..65535, post-build-variant-value=true, set at link in variant link-time / pre-compile in variant pre-compile / post-build in variant post-build, default-value=1  # This parameter contains the maximum number of data buffers in case of IB Channels and only. In case of channel's Spi_DataWidth is 16, this parameter reffers to the number of bytes allocated to the buffers and MUST be even.
        enumeration SpiTransferStart: {LSB, MSB}, post-build-variant-value=true, set at link in variant link-time / pre-compile in variant pre-compile / post-build in variant post-build, default-value=MSB  # This parameter defines the first starting bit for transmission.
      container SpiExternalDevice [1..*]: multiplicity set at pre-compile  # The communication settings of an external device. Closely linked to SpiJob.
        boolean SpiSlaveMode: origin=NXP, post-build-variant-value=true, set at link in variant link-time / pre-compile in variant pre-compile / post-build in variant post-build, default-value=false  # Logical SpiHWunit to physical LPSPI_[0|1|2|3|4|5] assignment. It depends on the number of units present in the chip version. NoteThis is an implementation specific parameter.
        float SpiBaudrate: 4.0..2.8E7, post-build-variant-value=true, set at link in variant link-time / pre-compile in variant pre-compile / post-build in variant post-build, default-value=100000  # This parameter is the communication baudrate - This parameter allows using a range of values, from the point of view of configuration tools, from Hz up to MHz. This field is used only in MASTER mode. NoteThe precision of this value depends SPI clock source configuration. If the driver cannot generate correct of the value, approximate value will be used.
        float SpiBaudrateAlternate: 4.0..4.0E7, origin=NXP, post-build-variant-value=true, set at link in variant link-time / pre-compile in variant pre-compile / post-build in variant post-build, default-value=100000  # This parameter is the communication baudrate - This parameter allows using a range of values, from the point of view of configuration tools, from Hz up to MHz.
        string SpiCsIdentifier: set at pre-compile, symbolic-name-value=true, default-value=PCS0  # This parameter is the symbolic name to identify the Chip Select (CS) allocated to this Job.
        enumeration SpiCsPolarity: {HIGH, LOW}, post-build-variant-value=true, set at link in variant link-time / pre-compile in variant pre-compile / post-build in variant post-build, default-value=HIGH  # This parameter defines the active polarity of Chip Select.
        enumeration SpiCsSelection [0..1]: {CS_VIA_PERIPHERAL_ENGINE, CS_VIA_GPIO}, multiplicity set at link in variant link-time / pre-compile in variant pre-compile / post-build in variant post-build, post-build-variant-multiplicity=true, post-build-variant-value=true, set at link in variant link-time / pre-compile in variant pre-compile / post-build in variant post-build, default-value=CS_VIA_PERIPHERAL_ENGINE  # When the Chip select handling is enabled (see SpiEnableCs), then this parameter specifies if the chip select is handled automatically by Pe-ripheral HW engine or via general purpose IO by Spi driver.
        enumeration SpiDataShiftEdge: {LEADING, TRAILING}, post-build-variant-value=true, set at link in variant link-time / pre-compile in variant pre-compile / post-build in variant post-build, default-value=LEADING  # This parameter defines the SPI data shift edge.
        boolean SpiEnableCs: post-build-variant-value=true, set at link in variant link-time / pre-compile in variant pre-compile / post-build in variant post-build, default-value=true  # This parameter enables or not the Chip Select handling functions. This parameter is closely linked to Job.If This parameter is True,then chip select is asserted and if False No chip select is asserted.
        enumeration SpiHwUnit: {CSIB0, CSIB1, CSIB2, CSIB3, CSIB4}, post-build-variant-value=true, set at link in variant link-time / pre-compile in variant pre-compile / post-build in variant post-build, default-value=CSIB0  # This parameter is the symbolic name to identify the HW SPI Hardware microcontroller peripheral allocated to this Job. CSIBn references the n-th logical unit configured in SpiPhyUnit container. For example: CSIB0 references the first logical unit (not the first LPSPI_0 HW unit).
        enumeration SpiShiftClockIdleLevel: {HIGH, LOW}, post-build-variant-value=true, set at link in variant link-time / pre-compile in variant pre-compile / post-build in variant post-build, default-value=HIGH  # This parameter defines the SPI shift clock idle level.
        float SpiTimeClk2Cs: 0.0..1.0E-4, post-build-variant-value=true, set at link in variant link-time / pre-compile in variant pre-compile / post-build in variant post-build, default-value=0.000001  # Timing between clock and chip select in seconds (tLag : SCK to PCS Delay) - This parameter allows to use a range of values from 0 up to 0.0001 Sec. the real configuration-value used in software BSW-SPI is calculated out of this by the generator-tools. If use continuous transfer(PCS signals remain asserted between transfers), tLag will insert between transfers.
        float SpiTimeCs2Clk: 0.0..0.01, origin=NXP, post-build-variant-value=true, set at link in variant link-time / pre-compile in variant pre-compile / post-build in variant post-build, default-value=0.000001  # Timing between chip select and clock in seconds (tLead : PCS to SCK Delay) - This parameter allows to use a range of values from 0 up to 0.01 Sec. If use continuous transfer(PCS signals remain asserted between transfers), tLead will insert between transfers. NoteThis is an implementation specific parameter.
        float SpiTimeCs2Cs: 0.0..0.01, origin=NXP, post-build-variant-value=true, set at link in variant link-time / pre-compile in variant pre-compile / post-build in variant post-build, default-value=0.000001  # Timing between chip select assertions in seconds (tDT : Delay Between Transfers) - This parameter allows to use a range of values from 0 up to 0.01 Sec. If use continuous transfer(PCS signals remain asserted between transfers), tDT is not inserted between the transfers. NoteThis is an implementation parameter.
        enumeration SpiCsContinous: {TRUE, FALSE}, origin=NXP, post-build-variant-value=true, set at link in variant link-time / pre-compile in variant pre-compile / post-build in variant post-build, default-value=TRUE  # This field determines to keep chip select asserted between frame transfers. NoteThis is an implementation parameter.
        enumeration SpiByteSwap: {TRUE, FALSE}, origin=NXP, post-build-variant-value=true, set at link in variant link-time / pre-compile in variant pre-compile / post-build in variant post-build, default-value=FALSE  # Enables byte swap on each 32-bit word when transmitting and receiving data. Can be useful when interfacing to devices that organize data as big endean
        enumeration SpiPinConfig: {SIN_INPUT_SOUT_OUTPUT, SIN_INPUT_OUTPUT, SOUT_INPUT_OUTPUT, SOUT_INPUT_SIN_OUTPUT}, origin=NXP, set at link in variant link-time / pre-compile in variant pre-compile / post-build in variant post-build, default-value=SIN_INPUT_SOUT_OUTPUT  # Configures which pins are used for input and output data during 1-bit transfers. If performing 2-bit or 4-bit transfers, the Pin Configuration field must be 00 - SIN_INPUT_SOUT_OUTPUT : SIN is used for input data and SOUT is used for output data. - SIN_INPUT_OUTPUT : SIN is used for both input and output data. - SOUT_INPUT_OUTPUT : SOUT is used for both input and output data. - SOUT_INPUT_SIN_OUTPUT : SOUT is used for input data and SIN is used for output data.
      container SpiJob [1..*]: multiplicity set at pre-compile  # All data needed to configure one SPI-Job, amongst others the connection between the internal SPI unit and the special settings for an external device is done.
        enumeration SpiHwUnitSynchronous [0..1]: {ASYNCHRONOUS, SYNCHRONOUS}, multiplicity set at link in variant link-time / pre-compile in variant pre-compile / post-build in variant post-build, post-build-variant-multiplicity=true, post-build-variant-value=true, set at link in variant link-time / pre-compile in variant pre-compile / post-build in variant post-build, default-value=ASYNCHRONOUS  # If SpiHwUnitSynchronous is set to "SYNCHRONOUS", the SpiJob uses its containing SpiDriver in a synchronous manner. If it is set to "ASYNCHRONOUS", it uses the driver in an asynchronous way. If the parameter is not set, the SpiJob uses the driver also in an asynchronous way. Note:The SpiHwUnitSynchronous parameter is defined at Job level in Autosar. It should be defined at HwUnit level. This paramater is added for AutoSAR compatibility purpose and this parameter is not used.The parameter SpiPhyUnitSync located in SpiPhyUnit tab is used for the same purpose
        function name SpiJobEndNotification [0..1]: multiplicity set at link in variant link-time / pre-compile in variant pre-compile / post-build in variant post-build, post-build-variant-multiplicity=true, post-build-variant-value=true, set at link in variant link-time / pre-compile in variant pre-compile / post-build in variant post-build, default-value=NULL_PTR  # This parameter is a reference to a notification function.
        function name SpiJobStartNotification [0..1]: multiplicity set at link in variant link-time / pre-compile in variant pre-compile / post-build in variant post-build, origin=NXP, post-build-variant-multiplicity=true, post-build-variant-value=true, set at link in variant link-time / pre-compile in variant pre-compile / post-build in variant post-build, default-value=NULL_PTR  # This parameter is a reference to a notification function.
        integer SpiJobId: 0..65535, set at pre-compile, symbolic-name-value=true, default-value=0  # SPI Job ID, used as parameter in SPI API functions.
        integer SpiJobPriority: 0..3, post-build-variant-value=true, set at link in variant link-time / pre-compile in variant pre-compile / post-build in variant post-build, default-value=0  # Priority set accordingly to SPI093: 0, lowest, 3, highest priority
        reference SpiDeviceAssignment: set at pre-compile, destination=SpiExternalDevice  # Reference to the external device used by this job.
        container SpiChannelList [1..*]: multiplicity set at pre-compile  # References to SPI channels and their order within the Job.
          integer SpiChannelIndex: 0..255, post-build-variant-value=true, set at link in variant link-time / pre-compile in variant pre-compile / post-build in variant post-build, default-value=0  # This parameter specifies the order of Channels within the Job.
          reference SpiChannelAssignment: post-build-variant-value=true, set at link in variant link-time / pre-compile in variant pre-compile / post-build in variant post-build, destination=SpiChannel  # A job references several channels.
      container SpiSequence [1..*]: multiplicity set at pre-compile  # All data needed to configure one SPI-sequence.
        boolean SpiInterruptibleSequence: post-build-variant-value=true, set at link in variant link-time / pre-compile in variant pre-compile / post-build in variant post-build, default-value=false  # This parameter allows or not this Sequence to be suspended by another one.
        function name SpiSeqEndNotification [0..1]: multiplicity set at link in variant link-time / pre-compile in variant pre-compile / post-build in variant post-build, post-build-variant-multiplicity=true, post-build-variant-value=true, set at link in variant link-time / pre-compile in variant pre-compile / post-build in variant post-build, default-value=NULL_PTR  # This parameter is a reference to a notification function.
        integer SpiSequenceId: 0..255, scope=ECU, set at pre-compile, symbolic-name-value=true, default-value=0  # Sequence ID of configured SPI Sequence.
        reference SpiJobAssignment [1..*]: multiplicity set at link in variant link-time / pre-compile in variant pre-compile / post-build in variant post-build, post-build-variant-multiplicity=true, post-build-variant-value=true, set at link in variant link-time / pre-compile in variant pre-compile / post-build in variant post-build, destination=SpiJob  # A sequence references several jobs, which are executed during a communication sequence.
    container SpiGeneral  # General configuration settings for SPI-Handler.
      boolean SpiCancelApi: set at pre-compile, default-value=true  # Switches the Spi_Cancel function ON or OFF.
      integer SpiChannelBuffersAllowed: 0..2, set at pre-compile, default-value=0  # Selects the SPI Handler/Driver Channel Buffers usage allowed and delivered. Note 0 - Only Internal Buffers (IB) are allowed 1 - Only External buffers (EB) are allowed 2 - Both Internal (IB) and External (EB) buffers are allowed
      boolean SpiDevErrorDetect: set at pre-compile, default-value=true  # Switches the Development Error Detection and Notification ON or OFF.
      boolean SpiHwStatusApi: set at pre-compile, default-value=true  # Switches the Spi_GetHWUnitStatus function ON or OFF.
      boolean SpiInterruptibleSeqAllowed: set at pre-compile, default-value=false  # Switches the Interruptible Sequences handling functionality ON or OFF.
      integer SpiLevelDelivered: 0..2, set at pre-compile, default-value=2  # Selects the SPI Handler/Driver level of scalable functionality that is available and delivered. Note Level 0 Only Simple Synchronous Behavior Level 1 Basic Asynchronous Behaviour Level 2 Enhanced Behaviour
      float SpiMainFunctionPeriod [0..1]: 1.0E-7..1.0, multiplicity set at pre-compile, set at pre-compile, default-value=0.01  # This parameter defines the cycle time of the function Spi_MainFunction_Handling in seconds. The parameter is not used by the driver it self, but it is used by upper layer.
      boolean SpiSupportConcurrentSyncTransmit: set at pre-compile, default-value=false  # Specifies whether concurrent Spi_SyncTransmit() calls for different se-quences shall be configurable.
      string SpiUserCallbackHeaderFile [0..*]: multiplicity set at pre-compile, set at pre-compile  # Header file name which will be included by the Spi. The value of this parameter shall be used as h-char-sequence or q-char-sequence according to ISO C90 section 6.10.2 "source file inclusion". The parameter value MUST NOT represent a path, since ISO C90 does not specify how such a path is treated (i.e., this is implementation defined (and additionally depends on the operating system and the underlying file system)).
      boolean SpiVersionInfoApi: set at pre-compile, default-value=true  # Switches the Spi_GetVersionInfo function ON or OFF.
      boolean SpiGlobalDmaEnable: origin=NXP, set at pre-compile, default-value=false  # If checked, it allows using the DMA module during the transfer. For each LPSPI unit a transfering method can be configured: FIFO or DMA. If not checked, all LPSPI units will use FIFO transfering mode. NoteThis is an implementation parameter.
      integer SpiTransmitTimeout: 1..900000, origin=NXP, set at pre-compile, default-value=50000  # Timeout value (microseconds) used to wait for TX/RX transmission to complete one frame. NoteThis is an implementation parameter. The transmission will be unsuccessful if the Chip cannot completly transfer one frame during this timeout. The precision of this value is quite low, it must be greater than the time needed to completly transmit one frame.
      boolean SpiOptimizeOneJobSequences: origin=NXP, set at pre-compile, default-value=false  # Activates the SPI transmission optimization for the sequences having only one job. At his moment, the optimization is in place only for synchronous transmissions. This option requires additional RAM for two internal buffers (for sequences having only one job, and for their linked channels), in order to cache configuration information to be used during transmission initialization. During Spi_Init() a caching action is performed on all sequences having only one job. NoteThis is an implementation parameter.
      integer SpiOptimizedSeqNumber: 0..64, origin=NXP, set at pre-compile, default-value=0  # The maximum number of expected sequences with one job, targeted for optimization. If, for a given configuration, the number of sequences having only one job exceeds this value, only first 'SpiOptimizedSeqNumber' sequences will operate in optimized transmission mode. NoteA value of 0 will define the buffer size for fitting all optimize-able sequences.
      integer SpiOptimizedChannelsNumber: 0..64, origin=NXP, set at pre-compile, default-value=0  # The maximum number of channels in expected sequences with one job, targeted for optimization. If, for a given configuration, the number of channels in sequences having only one job exceeds this value, the sequences will be optimized only in the limit of 'SpiOptimizedChannelsNumber' consumption. NoteA value of 0 will define the buffer size for fitting all optimize-able sequences.
      reference SpiCPUClockRef: origin=NXP, set at pre-compile, destination=McuClockReferencePoint  # Reference to the CPU clock source configuration, which is set into the MCU driver configuration. This CPU clock source is used for configure Timeout value (in microseconds) in SpiTransmitTimeout used to wait for TX/RX transmission to complete one frame
      container SpiPhyUnit [1..*]: multiplicity set at pre-compile  # Logical to Physical SPI Bus mapping. NoteThis is an implementation specific container.
        enumeration SpiPhyUnitMapping: {LPSPI_0, LPSPI_1, LPSPI_2, FLEXIOSPI_0, FLEXIOSPI_1}, origin=NXP, set at pre-compile, default-value=LPSPI_1  # Logical SpiHWunit to physical LPSPI_[0|1|2|3] assignment. It depends on the number of units present in the chip version. NoteThis is an implementation specific parameter.
        enumeration SpiPhyUnitMode: {SPI_MASTER, SPI_SLAVE}, origin=NXP, set at pre-compile, default-value=SPI_MASTER  # Select between SPI_MASTER and SPI_SLAVE modes. NoteThis is an implementation specific parameter.
        boolean SpiPhyUnitSync: origin=NXP, post-build-variant-value=true, set at link in variant link-time / pre-compile in variant pre-compile / post-build in variant post-build, default-value=true  # Specific if this HwUnit can only do sync transfers. If true then this hardware unit is dedicated for Synchronous transfers only. If false then this hardware unit is dedicated for Asynchronous transfers only. False is applicable only if SpiGeneral/SpiLevelDelivered is either 1 or 2 and true is applicable only if SpiGeneral/SpiLevelDelivered is 0 or 2. NoteThis is an implementation specific parameter.
        enumeration SpiPhyUnitAsyncMethod: {PIO_FIFO, DMA}, origin=NXP, post-build-variant-value=true, set at link in variant link-time / pre-compile in variant pre-compile / post-build in variant post-build, default-value=PIO_FIFO  # Transfer method of the periperal: DMA,PIO with FIFO. NoteThis is an implementation parameter.
        enumeration SpiFlexioTxPinSelect: {PIN_0, PIN_1, PIN_2, PIN_3, PIN_4, PIN_5, PIN_6, PIN_7, NULL}, origin=NXP, set at pre-compile, default-value=NULL  # FLEXIO Logical Channel PIN. This selects 1 PIN to setup as Serial Data Output channel This parameter is required only if SpiFlexIOsupport is selected. NoteThis is an implementation specific parameter.
        enumeration SpiFlexioRxPinSelect: {PIN_0, PIN_1, PIN_2, PIN_3, PIN_4, PIN_5, PIN_6, PIN_7, NULL}, origin=NXP, set at pre-compile, default-value=NULL  # FLEXIO Logical Channel. This selects 1 PIN to setup as Serial Data Input channel This parameter is required only if SpiFlexIOsupport is selected. NoteThis is an implementation specific parameter.
        enumeration SpiFlexioClkPinSelect: {PIN_0, PIN_1, PIN_2, PIN_3, PIN_4, PIN_5, PIN_6, PIN_7, NULL}, origin=NXP, set at pre-compile, default-value=NULL  # FLEXIO Logical Channel: This selects 1 PIN to setup as Serial clock channel This parameter is required only if SpiFlexIOsupport is selected. NoteThis is an implementation specific parameter.
        enumeration SpiFlexioCsPinSelect: {PIN_0, PIN_1, PIN_2, PIN_3, PIN_4, PIN_5, PIN_6, PIN_7, NULL}, origin=NXP, set at pre-compile, default-value=NULL  # FLEXIO Logical Channel: This selects 1 PIN to setup as Peripheral Chip Select channel This parameter is required only if SpiFlexIOsupport is selected. NoteThis is an implementation specific parameter.
        enumeration SpiFlexioClkPinSelectSlave: {PIN_0, PIN_1, PIN_2, PIN_3, PIN_4, PIN_5, PIN_6, PIN_7, NULL}, origin=NXP, set at pre-compile, default-value=NULL  # FLEXIO Logical Channel: This selects 1 PIN to setup as Serial clock channel in SLAVE mode This parameter is required only if SpiFlexIOsupport is selected. NoteThis is an implementation specific parameter.
        enumeration SpiFlexioCsPinSelectSlave: {PIN_0, PIN_1, PIN_2, PIN_3, PIN_4, PIN_5, PIN_6, PIN_7, NULL}, origin=NXP, set at pre-compile, default-value=NULL  # FLEXIO Logical Channel: This selects 1 PIN to setup as Peripheral Chip Select channel in SLAVE mode This parameter is required only if SpiFlexIOsupport is selected. NoteThis is an implementation specific parameter.
        reference SpiPhyUnitClockRef: origin=NXP, post-build-variant-value=true, set at link in variant link-time / pre-compile in variant pre-compile / post-build in variant post-build, destination=McuClockReferencePoint  # Reference to the SPI clock source configuration, which is set into the MCU driver configuration. This clock source is used for configure SPI baudrate.
        reference SpiPhyUnitAlternateClockRef [0..1]: multiplicity set at pre-compile, origin=NXP, set at pre-compile, destination=McuClockReferencePoint  # Reference to the alternate clock configuration, retrieved from the MCU plugin. Use to enable Spi_SetClockMode() function, which allows dual MCU clock configuration settings.
        choice reference SpiPhyTxDmaChannel [0..1]: multiplicity set at pre-compile, origin=NXP, set at pre-compile, destination=DMAChannel  # LPSPI Master Transmit DMA Logical Channel as configured by MCL plug-in, used to prepare the LPSPI transmission dataframes starting from the TX buffer content. This parameter is required only if SpiPhyUnitAsyncMethod - 'DMA' is selected. NoteThis is an implementation specific parameter. The current LPSPI TX source needs be configured for enabling this DMA channel.
        choice reference SpiPhyRxDmaChannel [0..1]: multiplicity set at pre-compile, origin=NXP, set at pre-compile, destination=DMAChannel  # LPSPI Receive DMA Logical Channel as configured by MCL plug-in, used to read the deserialized dataframes into the RX buffers. This parameter is required only if SpiPhyUnitAsyncMethod - 'DMA' is selected. NoteThis is an implementation specific parameter.
    container SpiPublishedInformation  # Container holding all SPI specific published information parameters.
      integer SpiMaxHwUnit: 0..65535, set at published-information, default-value=0  # Number of different SPI hardware microcontroller peripherals (units/busses) available and handled by this SPI Handler/Driver module.
    container CommonPublishedInformation  # Common container, aggregated by all modules. It contains published information about vendor and versions.
      integer ArReleaseMajorVersion: 4..4, origin=NXP, set at link in variant link-time / post-build in variant post-build / pre-compile in variant pre-compile, default-value=4  # Major version number of AUTOSAR specification on which the appropriate implementation is based on.
      integer ArReleaseMinorVersion: 2..2, origin=NXP, set at link in variant link-time / post-build in variant post-build / pre-compile in variant pre-compile, default-value=2  # Minor version number of AUTOSAR specification on which the appropriate implementation is based on.
      integer ArReleaseRevisionVersion: 2..2, origin=NXP, set at link in variant link-time / post-build in variant post-build / pre-compile in variant pre-compile, default-value=2  # Patch level version number of AUTOSAR specification on which the appropriate implementation is based on.
      integer ModuleId: 83..83, origin=NXP, set at link in variant link-time / post-build in variant post-build / pre-compile in variant pre-compile, default-value=83  # Module ID of this module.
      integer SwMajorVersion: 1..1, origin=NXP, set at link in variant link-time / post-build in variant post-build / pre-compile in variant pre-compile, default-value=1  # Major version number of the vendor specific implementation of the module. The numbering is vendor specific.
      integer SwMinorVersion: 0..0, origin=NXP, set at link in variant link-time / post-build in variant post-build / pre-compile in variant pre-compile, default-value=0  # Minor version number of the vendor specific implementation of the module. The numbering is vendor specific.
      integer SwPatchVersion: 2..2, origin=NXP, set at link in variant link-time / post-build in variant post-build / pre-compile in variant pre-compile, default-value=2  # Patch level version number of the vendor specific implementation of the module. The numbering is vendor specific.
      string VendorApiInfix [0..1]: multiplicity set at link in variant link-time / post-build in variant post-build / pre-compile in variant pre-compile, origin=NXP, set at link in variant link-time / post-build in variant post-build / pre-compile in variant pre-compile  # In driver modules which can be instantiated several times on a single ECU, BSW00347 requires that the name of APIs is extended by the VendorId and a vendor specific name. This parameter is used to specify the vendor specific name. In total, the implementation specific name is generated as follows: <ModuleName>_>VendorId>_<VendorApiInfix>. E.g. assuming that the VendorId of the implementor is 123 and the implementer chose a VendorApiInfix of "v11r456" a api name Can_Write defined in the SWS will translate to Can_123_v11r456Write. This parameter is mandatory for all modules with upper multiplicity > 1. It shall not be used for modules with upper multiplicity =1.
      integer VendorId: 43..43, origin=NXP, set at link in variant link-time / post-build in variant post-build / pre-compile in variant pre-compile, default-value=43  # Vendor ID of the dedicated implementation of this module according to the AUTOSAR vendor list.
    container SpiNonAUTOSAR  # Enabling the settings of this section will configure the driver in a mode not compliant with AUTOSAR requirements.
      boolean SpiEnableUserModeSupport: origin=NXP, set at pre-compile, default-value=false  # When this parameter is enabled, the Spi module will adapt to run from User Mode. Note Spi module does not include registers protection. So, It is accessible to all registered in any public mode. SPI is not affected by this field.
      boolean SpiAllowBigSizeCollections: origin=NXP, set at pre-compile, default-value=false  # A feature to allow more than 256 sequences, jobs, and channels. Note Enabling this option will violate the following requirements: SPI166, SPI167, SPI168.
      boolean SpiEnableHWUnitAsyncMode: origin=NXP, set at pre-compile, default-value=false  # Enable Spi_SetHWUnitAsyncMode() function, which allows defining distinct operation mode (POLLING or INTERRUPT) for each HWUnit. Note This feature is not required by Autosar, which defines asynchronous mode configuration at driver level only.
      boolean SpiJobStartNotificationEnable: origin=NXP, post-build-variant-value=true, set at link in variant link-time / pre-compile in variant pre-compile / post-build in variant post-build, default-value=false  # settings. Note This feature is a non-Autosar feature to enable the start job notification.
      boolean SpiForceDataType: origin=NXP, set at pre-compile, default-value=false  # Enable SpiDataType generation as uint8 instead of default uint16. Note This feature is not required by Autosar.
      boolean SpiDisableDemReportErrorStatus: origin=NXP, set at pre-compile, default-value=false  # SpiDisableDemReportErrorStatus Switches the Diagnostic Error Reporting and Notification OFF.
      boolean SpiFlexIOsupport: origin=NXP, set at pre-compile, default-value=false  # SpiFlexIOsupport Select FlexIO support
